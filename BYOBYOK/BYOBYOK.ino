/*
 * BYOBYOK - a minimal text editor / electric typewriter for the M5PaperS3
 * ("Bring Your Own [keyboard to your] Bring Your Own Keyboard")
 * ------------------------------------------------------------------------
 * - Boots to a menu: "[ New file ]" + every *.txt on the microSD card.
 * - Plain-text editing with a real USB keyboard (USB-C OTG host).
 * - ESC opens an in-editor menu: Resume / Save / Save & exit / Discard & exit.
 * - Word/character count popup on Ctrl+W; battery + clock in the status bar.
 * - Auto-save every 20s for named files (clears the unsaved "*" marker).
 * - Rename (r) and delete (Del) files from the main menu.
 * - Files are stored on the microSD card root, FAT32.
 * - Novel-sized files: the document lives in a PSRAM gap buffer and edits
 *   re-wrap only the touched paragraph, so multi-MB files stay responsive.
 *   (Text-core logic is unit-tested on the host - see tests/.)
 * - Bluetooth (BLE) keyboards: pair from the menu ('b' or tap the BT button).
 *   Optional - needs NimBLE-Arduino >= 2.0, or set ENABLE_BLE_KEYBOARD 0.
 * - QWERTY / Dvorak / Colemak layouts; Enter auto-saves (5 s throttle).
 * - Reader can rotate to portrait ('r' in the reader, or the menu button).
 * - UTF-8 files are folded to ASCII on load (curly quotes -> ', em-dash ->
 *   --, cafe accents stripped): the built-in fonts are 7-bit.
 * - Spell check (Ctrl+K) against /wordlist.txt on the SD card.
 * - Cloud sync ('c'): joins WiFi from /sync.cfg, HTTP-PUTs drafts (WebDAV).
 * - USB drive mode ('u'): reboots into TinyUSB MSC, SD card appears as a
 *   USB stick. Optional - set ENABLE_USB_DRIVE 0 to compile without.
 *
 * Keys
 *   Type / Enter / Backspace / Tab .... edit text
 *   Arrows / Home / End / Delete ...... move & delete
 *   Shift (or Ctrl) + arrows .......... jump a whole word
 *   Shift (or Ctrl) + Bksp / Del ...... delete a whole word
 *   Ctrl+S ........................... quick save
 *   Ctrl+W ........................... word/character count popup
 *   Ctrl+Z ........................... undo
 *   Ctrl+F ........................... find (case-insensitive, wraps)
 *   Ctrl+G ........................... writing goal / sprint
 *   Ctrl+Home / Ctrl+End ............. jump to start / end of document
 *   Ctrl+A / Ctrl+E .................. start / end of paragraph
 *   PgUp / PgDn ...................... move a screenful (page shown in bar)
 *   Ctrl+P ........................... go to a page number
 *   Ctrl+R ........................... redraw any screen (manual de-ghost)
 *   Option/Alt combos ................ accents & Esperanto (see README)
 *   Tap the editor page .............. place the cursor there
 *   ESC .............................. menu (incl. Focus mode toggle)
 *   In the main menu:  j = today's journal,  s = writing stats
 *   Shortcuts follow the active layout (Dvorak/Colemak), not key position.
 *   In the menu:  r = rename,  Del/d = delete (on a selected file)
 *
 * Libraries (Arduino IDE):
 *   - M5Unified  (>= 0.2.5)
 *   - M5GFX      (>= 0.2.7  -> built-in e-ink driver, no EPDiy needed)
 *   - EspUsbHost (by Masayuki Tanaka)
 * Board: "M5PaperS3"   |   PSRAM: OPI PSRAM (enabled)
 *
 * See README.md for setup, flashing, and USB-power troubleshooting.
 */

#include <Arduino.h>
#include <SPI.h>
#include <SD.h>
#include <M5Unified.h>
#include <M5GFX.h>
#include <vector>
#include <algorithm>
#include <cstdio>
#include <cstring>
#include <WiFi.h>
#include <WebServer.h>
#include <HTTPClient.h>
#include <WiFiClientSecure.h>
#include <freertos/FreeRTOS.h>
#include <freertos/queue.h>
#include <esp_heap_caps.h>
#include <Preferences.h>
#include "EspUsbHost.h"

// ---- Bluetooth (BLE) keyboard support ------------------------------------
// Needs the NimBLE-Arduino library (by h2zero, >= 2.0). Set to 0 to compile
// without it - everything else works, only the BT keyboard feature vanishes.
#define ENABLE_BLE_KEYBOARD 1
#if ENABLE_BLE_KEYBOARD
#include <NimBLEDevice.h>
#endif

// ---- USB drive mode (SD card as a USB stick) ------------------------------
// Needs the board's USB mode set to USB-OTG / TinyUSB. Set to 0 to compile
// without it - everything else works, only the USB drive feature vanishes.
#define ENABLE_USB_DRIVE 1
#if ENABLE_USB_DRIVE && defined(ARDUINO_USB_MODE) && ARDUINO_USB_MODE == 1
#warning "USB drive mode needs Tools > USB Mode = USB-OTG (TinyUSB); feature disabled"
#undef ENABLE_USB_DRIVE
#define ENABLE_USB_DRIVE 0
#endif
// ---- Latin-1 display fonts (DejaVu Mono, generated) ------------------------
// fonts_latin1.h is generated by tools/make_fonts.py and provides real
// accented glyphs (0xA0-0xFF) in three sizes x four styles. Set to 0 (or
// delete the header) to fall back to the built-in 7-bit FreeMono fonts, with
// accents transliterated on load instead.
#define USE_LATIN1_FONTS 1
#if USE_LATIN1_FONTS
#include "fonts_latin1.h"
#endif

#if ENABLE_USB_DRIVE
#include <USB.h>
#include <USBMSC.h>
#if defined(ARDUINO_USB_CDC_ON_BOOT) && ARDUINO_USB_CDC_ON_BOOT
#warning "USB drive mode: ALSO set Tools > USB CDC On Boot = Disabled. CDC claims the USB descriptor before setup() runs, so the drive can never appear."
#endif
#endif

// NOTE: do NOT `using namespace m5gfx;` here - LovyanGFX defines its own
// millis()/delay()/fonts that then clash with the Arduino ones. We qualify the
// few enum values we need with m5gfx:: instead, and use the global ::fonts.

// ---- WiFi export (SoftAP) ------------------------------------------------
// The radio stays OFF until you start an export, and is fully shut down again
// when you leave it. Change these to taste (password must be >= 8 chars).
#define AP_SSID "BYOBYOK"
#define AP_PASS "byobyok1"

// Spell-check dictionary (see the spell section). Defined up here because the
// file browser hides it - it's a system file, and at 168k one-word lines it's
// exactly the kind of "document" that shouldn't be opened as one.
#define DICT_PATH "/wordlist.txt"
WebServer server(80);
File g_upFile;          // open file handle while an upload is streaming in

// ---- microSD SPI pins (from M5Stack PaperS3 docs) -----------------------
#define SD_SPI_CS_PIN   47
#define SD_SPI_SCK_PIN  39
#define SD_SPI_MOSI_PIN 38
#define SD_SPI_MISO_PIN 40

#define MARGIN_X 16

// ---- HID keycodes we care about -----------------------------------------
#define KC_ENTER  0x28
#define KC_ESC    0x29
#define KC_BKSP   0x2A
#define KC_TAB    0x2B
#define KC_HOME   0x4A
#define KC_END    0x4D
#define KC_DELETE 0x4C
#define KC_RIGHT  0x4F
#define KC_LEFT   0x50
#define KC_DOWN   0x51
#define KC_UP     0x52
#define KC_PGUP   0x4B
#define KC_PGDN   0x4E
#define KC_S      0x16
#define KC_W      0x1A
#define KC_Z      0x1D
#define KC_F      0x09
#define KC_G      0x0A
#define KC_K      0x0E

// ---- types used in function signatures -------------------------------------
// These must be defined before the sketch's FIRST function definition: the
// Arduino IDE auto-generates prototypes for every function and inserts them
// there, so any type a signature mentions has to already exist at that point.
// ==== BLEKB-TYPES BEGIN ==== (extracted verbatim into tests/ - keep in sync)
struct KeyEvt { uint8_t ascii, keycode, modifiers; bool caps; };
struct BleKbState { uint8_t mods = 0; uint8_t keys[6] = {0, 0, 0, 0, 0, 0}; bool caps = false; };
// ==== BLEKB-TYPES END ====

// Cloud sync settings, parsed from /sync.cfg on the SD card.
struct SyncCfg { String ssid, pass, url, user, pw; };

// Per-file reading place + pinned bookmark (persisted to /.ptmarks.tsv).
struct ReadMark { String path; int pos; int bm; };

// ---- application state ---------------------------------------------------
enum AppState { ST_MENU, ST_EDIT, ST_EDITMENU, ST_PROMPT, ST_CONFIRM, ST_EXPORT, ST_HELP, ST_READER, ST_BTPAIR, ST_COUNT, ST_GOAL, ST_STATS, ST_SPELL, ST_SYNC, ST_RMENU, ST_GOPAGE, ST_KEYTEST };
AppState g_state = ST_MENU;

enum PromptMode { PM_SAVENEW, PM_RENAME, PM_NEWDIR, PM_SEARCH, PM_GOPAGE };

// menu entry kinds (folders view)
enum EntryType { E_CONTINUE, E_NEWFILE, E_NEWDIR, E_UP, E_DIR, E_FILE, E_MOVEHERE, E_MOVECANCEL };
struct MenuEntry { EntryType type; String name; };

// ---- tunables ------------------------------------------------------------
const unsigned long AUTOSAVE_MS   = 20000;             // auto-save / battery refresh tick
const unsigned long IDLE_SLEEP_MS = 5UL * 60 * 1000;   // auto-standby after inactivity (0 = off)
const int           CPU_MHZ       = 240;               // 240 = stock; try 80 to save power
// e-ink de-ghosting: hard cap on partial updates before a full-quality
// repaint, plus an early one after a quiet pause (so the flash happens while
// you're thinking, not typing). Appending text repaints only the new cells,
// so ghosting accumulates slowly and these can be generous.
const int           DEGHOST_EVERY = 250;               // partial updates (hard cap)
const int           DEGHOST_IDLE_MIN = 40;             // partials before an idle de-ghost
const unsigned long DEGHOST_IDLE_MS  = 10000;          // quiet time that triggers it
const int           READER_QUALITY_EVERY = 8;          // fast page turns per clean one
const int           MENU_QUALITY_EVERY   = 40;         // fast menu updates per clean one

struct Line { int start; int len; };

// ==== TEXTCORE-1 BEGIN ==== (extracted verbatim into tests/ - keep in sync)
// Gap buffer: the document is one buffer with a movable "hole" (the gap) at
// the edit point. Typing/deleting at the cursor is O(1) instead of "copy the
// whole document three times", which is what lets novel-sized files stay
// responsive. The buffer is allocated from PSRAM (8 MB on the PaperS3).
#ifndef GB_MALLOC
#define GB_MALLOC(n) (psramFound() ? ps_malloc(n) : malloc(n))
#endif

class GapBuffer {
  char *buf = nullptr;
  int cap = 0, gs = 0, ge = 0;                 // text = [0,gs) + [ge,cap)

  bool grow(int minGap) {                      // re-alloc, keeping the gap at gs
    long need = (long)length() + minGap;
    long ncap = need + (need >> 1) + 4096;     // 1.5x + slack
    char *nb = (char *)GB_MALLOC((size_t)ncap);
    if (!nb) return false;
    int tail = cap - ge;
    if (buf) {
      memcpy(nb, buf, gs);
      memcpy(nb + ncap - tail, buf + ge, tail);
      free(buf);
    }
    buf = nb; ge = (int)ncap - tail; cap = (int)ncap;
    return true;
  }
  void moveGap(int pos) {
    if (pos < gs)      { memmove(buf + ge - (gs - pos), buf + pos, gs - pos); ge -= gs - pos; gs = pos; }
    else if (pos > gs) { memmove(buf + gs, buf + ge, pos - gs); ge += pos - gs; gs = pos; }
  }

public:
  int  length() const { return cap - (ge - gs); }
  char operator[](int i) const { return buf[i < gs ? i : i + (ge - gs)]; }

  bool reserve(int total) {                    // ensure room for `total` chars
    if (total <= cap) return true;
    return grow(total - length());
  }
  bool insert(int pos, const char *s, int n) {
    if (n <= 0) return true;
    if (pos < 0) pos = 0;
    if (pos > length()) pos = length();
    if (ge - gs < n && !grow(n)) return false;
    moveGap(pos);
    memcpy(buf + gs, s, n);
    gs += n;
    return true;
  }
  void erase(int pos, int n) {
    if (pos < 0) { n += pos; pos = 0; }
    if (n > length() - pos) n = length() - pos;
    if (n <= 0) return;
    if (pos + n == gs) { gs = pos; return; }   // backspace fast path
    moveGap(pos);
    ge += n;
  }
  void clear() { free(buf); buf = nullptr; cap = gs = ge = 0; }
  // The two contiguous halves, for streaming the doc out to a file.
  const char *part1() const { return buf; }              int part1Len() const { return gs; }
  const char *part2() const { return buf ? buf + ge : nullptr; } int part2Len() const { return cap - ge; }
  String substring(int a, int b) const {
    int len = length();
    if (a < 0) a = 0;
    if (b > len) b = len;
    String s;
    if (b <= a) return s;
    s.reserve(b - a);
    for (int i = a; i < b; i++) s += (*this)[i];
    return s;
  }
};

GapBuffer doc;                 // the document being edited
int g_docWords = 0;            // live word count (maintained by docReplace)
// ==== TEXTCORE-1 END ====

String filename = "";          // "" => unsaved new doc
int    cursorPos = 0;          // caret index into doc (0..doc.length())
int    desiredCol = -1;        // sticky column for up/down; -1 = recompute
bool   modified = false;

// layout
std::vector<Line> g_lines;
int g_caretRow = 0, g_caretCol = 0;
int topLine = 0;

// screen metrics
int W, H, statusH, charW, lineH, textX, textY, g_cols, g_rows;

// incremental render bookkeeping
std::vector<String> prevVisible;
int  prevTopLine = -1, prevCaretRow = 0, partialCount = 0;
bool prevModified = false, needDeghost = true;

// menu (folder browser)
std::vector<MenuEntry> g_entries;   // New file / New folder / .. / dirs / files
String g_cwd = "/";                 // current directory, always ends with '/'
int g_sel = 0, menuTop = 0;

// move mode ('m' on a file): browse to the target folder, then [ Move here ]
String g_moveSrc = "";              // full path being moved ("" = not moving)
String g_moveMsg = "";              // status/error line shown while moving

// keyboard layout
int g_layout = 0;                   // 0 = QWERTY, 1 = Dvorak, 2 = Colemak (NVS)

// two button rows in the menu; geometry set by drawMenu, hit-tested by menuTap
// row 1: layout / BT keyboard / font size / WiFi export / stats
// row 2: USB drive / cloud sync / sleep / help
const int MB_COUNT = 5;
int g_mBtnX[MB_COUNT], g_mBtnW = 176, g_mBtnY = 0, g_mBtn2Y = 0, g_mBtnH = 30;

// editor body font size: 0 = small, 1 = medium, 2 = large
int g_fontSize = 1;                 // persisted in NVS
const lgfx::GFXfont *bodyFont() {
#if USE_LATIN1_FONTS
  switch (g_fontSize) {
    case 0:  return &DejaVuMono9;
    case 2:  return &DejaVuMono18;
    default: return &DejaVuMono12;
  }
#else
  switch (g_fontSize) {
    case 0:  return &fonts::FreeMono9pt7b;
    case 2:  return &fonts::FreeMono18pt7b;
    default: return &fonts::FreeMono12pt7b;
  }
#endif
}

// Style variants for the Reader's markdown rendering - same mono advance, so
// bold/italic spans never disturb the character grid.
const lgfx::GFXfont *styleFont(bool b, bool i) {
#if USE_LATIN1_FONTS
  switch (g_fontSize) {
    case 0:  return b ? (i ? &DejaVuMono9BI  : &DejaVuMono9B)  : (i ? &DejaVuMono9I  : &DejaVuMono9);
    case 2:  return b ? (i ? &DejaVuMono18BI : &DejaVuMono18B) : (i ? &DejaVuMono18I : &DejaVuMono18);
    default: return b ? (i ? &DejaVuMono12BI : &DejaVuMono12B) : (i ? &DejaVuMono12I : &DejaVuMono12);
  }
#else
  switch (g_fontSize) {
    case 0:  return b ? (i ? &fonts::FreeMonoBoldOblique9pt7b  : &fonts::FreeMonoBold9pt7b)
                      : (i ? &fonts::FreeMonoOblique9pt7b      : &fonts::FreeMono9pt7b);
    case 2:  return b ? (i ? &fonts::FreeMonoBoldOblique18pt7b : &fonts::FreeMonoBold18pt7b)
                      : (i ? &fonts::FreeMonoOblique18pt7b     : &fonts::FreeMono18pt7b);
    default: return b ? (i ? &fonts::FreeMonoBoldOblique12pt7b : &fonts::FreeMonoBold12pt7b)
                      : (i ? &fonts::FreeMonoOblique12pt7b     : &fonts::FreeMono12pt7b);
  }
#endif
}

// LovyanGFX decodes strings as UTF-8; the document buffer stores Latin-1 as
// single bytes (keeping all grid math byte-per-cell), so expand high bytes
// only at the moment text is handed to the display.
String drawable(const String &s) {
#if USE_LATIN1_FONTS
  bool hi = false;
  for (unsigned i = 0; i < s.length(); i++)
    if ((uint8_t)s[i] >= 0x80) { hi = true; break; }
  if (!hi) return s;
  String o;
  o.reserve(s.length() + 8);
  for (unsigned i = 0; i < s.length(); i++) {
    uint8_t c = (uint8_t)s[i];
    if (c < 0x80) o += (char)c;
    else { o += (char)(0xC0 | (c >> 6)); o += (char)(0x80 | (c & 0x3F)); }
  }
  return o;
#else
  return s;
#endif
}

// focus mode: forward-only drafting (no cursor movement / forward delete)
bool g_focus = false;               // session-only, toggled in the ESC menu

// pending dead key for Option-composition (0 = none)
char g_pendingDead = 0;

// display orientation: the Reader can run portrait; menu and editor stay
// landscape (their layouts don't fit a 540 px width).
bool g_portrait = false;            // reader preference (persisted in NVS)
bool g_rotIsPortrait = false;       // what the panel is actually set to now

// Declared here as well as in the main forward-declaration block: a manual
// prototype anywhere suppresses the Arduino IDE's auto-generated one, so the
// declaration must not sit BELOW this caller.
void setupMetrics();

void applyRotation(bool portrait) {
  if (portrait == g_rotIsPortrait) return;
  g_rotIsPortrait = portrait;
  M5.Display.setRotation(portrait ? 0 : 1);
  W = M5.Display.width();
  H = M5.Display.height();
  setupMetrics();                   // new column/row grid for the new shape
}

// writing goal / sprint (Ctrl+G)
int g_goalMode = 0;                 // 0 = off, 1 = timed sprint, 2 = word goal
int g_goalTarget = 0;               // minutes (mode 1) or words (mode 2)
unsigned long g_goalStartMs = 0;
int g_goalStartWords = 0;
bool g_goalHit = false;             // completion popup pending/being shown
int g_goalSel = 0;

// search (Ctrl+F)
String g_searchTerm = "";
bool g_searchMiss = false;

// prompt feedback ("that name is already taken" and the like)
String g_promptMsg = "";

// resume-where-you-left-off (persisted in NVS)
String g_lastFile = "";             // full path of the last edited file
int    g_lastPos  = 0;              // caret position in it

// session word stats (logged to /.ptstats.csv on session end)
int g_sessStartWords = 0;
Preferences g_prefs;                // NVS store for the layout choice

// edit menu / prompt
int g_emSel = 0;
int g_afterSave = 0;           // 0 = resume, 1 = exit to menu
int g_promptMode = PM_SAVENEW; // PM_SAVENEW or PM_RENAME
String g_renameTarget = "";    // original name when renaming
String g_fname = "";

// confirm (delete) dialog
String g_confirmName = "";
int g_confirmSel = 1;          // 0 = Delete, 1 = Cancel (default)

// battery / autosave / clock
unsigned long g_lastTick = 0;
int  g_batPct = -1;            // last drawn battery percentage
bool g_charging = false;
bool g_rtcOk = false;          // RTC present & usable
int  g_lastMin = -1;           // last shown minute-of-day (for clock refresh)
unsigned long g_lastActivity = 0;   // millis() of last keypress/tap (for idle standby)

// keyboard presence + touch reader
bool g_kbConnected = false;    // a USB device (keyboard) is plugged in
int  g_readerTop = 0;          // first visible line in the reader
// menu touch geometry (set by drawMenu, used by menuTap)
int  g_mListTop = 100, g_mItemH = 40, g_mVisible = 1, g_mFooterY = 0;
bool g_mScrollable = false;

// ---- forward declarations ------------------------------------------------
void handleMenuKey(uint8_t ascii, uint8_t keycode);
void handleEditKey(uint8_t ascii, uint8_t keycode, uint8_t modifier);
void handleEditMenuKey(uint8_t ascii, uint8_t keycode);
void handlePromptKey(uint8_t ascii, uint8_t keycode);
void handleConfirmKey(uint8_t ascii, uint8_t keycode);
void handleExportKey(uint8_t ascii, uint8_t keycode);
void handleHelpKey(uint8_t ascii, uint8_t keycode);
void handleCountKey(uint8_t ascii, uint8_t keycode);
void enterCount();
void dismissCount();
void doEditMenuAction(int a);
void promptCancel();
void applyGoal(int i);
void saveWorkIfAny();
void handleGoalKey(uint8_t ascii, uint8_t keycode);
void enterGoal();
void handleStatsKey(uint8_t ascii, uint8_t keycode);
void enterStats();
void handleSpellKey(uint8_t ascii, uint8_t keycode);
void enterSpell();
void spellTap(int x, int y);
void handleSyncKey(uint8_t ascii, uint8_t keycode);
void enterSync();
void stopSync();
void enterUsbDrive();
void newlineAutosave();
void sessionEnd();
void saveResume();
void openForEditing(const String &path);
void openJournal();
void toggleLayout();
void toggleFont();
void toggleReaderRot();
void readerOpen(const String &path, int fallbackPos);
void readerSavePos();
void enterReaderMenu();
void handleReaderMenuKey(uint8_t ascii, uint8_t keycode);
void readerMenuTap(int x, int y);
void enterGoPage();
void handleGoPageKey(uint8_t ascii, uint8_t keycode);
void goPageTap(int x, int y);
void enterKeyTest();
void keyTestShow(uint8_t ascii, uint8_t keycode, uint8_t modifier, bool caps);
void redrawScreen();
char keyLetter(uint8_t keycode);
void handleReaderKey(uint8_t ascii, uint8_t keycode);
void enterReader();
void enterReaderAt(int pos);
void drawReader();
void readerNext();
void readerPrev();
void openForReading(const String &name);
void openFile(const String &name);
void newFile();
void handleTap(int x, int y);
void menuTap(int x, int y);
void readerTap(int x, int y);
void buildEntries();
void activate(int idx, bool edit);
void cdInto(const String &name);
void cdUp();
void toggleLayout();
String fullPath(const String &base);
String baseName(const String &path);
void enterExport();
void stopExport();
void enterHelp();
void drawHelp();
void goStandby();
String autoName();
void handleUpload();
void handleUploadDone();
void setupMetrics();
void drawMenu();
void drawEditMenu();
void drawPrompt();
void drawConfirm();
void renderEditor(bool full);
void enterEditor();
void enterEditMenu();
void enterPrompt(int mode, int after, const String &prefill);
void enterConfirmDelete(const String &name);
void resumeEditor();
void gotoMenu();
void refreshStatusBar();
void drawBattery(int rightX, int y);
void readBattery();
void setupRtc();
String clockStr();
int  countWords();
void layout();
void caretRowCol(int pos, int &row, int &col);
int  posFromRowCol(int row, int col);

// ---- keyboard layouts (Dvorak / Colemak remaps) ---------------------------
// A USB keyboard sends position-based HID codes (physical QWERTY key). For
// other layouts we remap the keycode to the right character ourselves. Keys
// identical to QWERTY (numbers, space...) are left to the library's ascii.
struct DvKey { uint8_t kc; char lo, hi; };
static const DvKey DVORAK[] = {
  {0x04,'a','A'},{0x05,'x','X'},{0x06,'j','J'},{0x07,'e','E'},{0x08,'.','>'},
  {0x09,'u','U'},{0x0A,'i','I'},{0x0B,'d','D'},{0x0C,'c','C'},{0x0D,'h','H'},
  {0x0E,'t','T'},{0x0F,'n','N'},{0x10,'m','M'},{0x11,'b','B'},{0x12,'r','R'},
  {0x13,'l','L'},{0x14,'\'','"'},{0x15,'p','P'},{0x16,'o','O'},{0x17,'y','Y'},
  {0x18,'g','G'},{0x19,'k','K'},{0x1A,',','<'},{0x1B,'q','Q'},{0x1C,'f','F'},
  {0x1D,';',':'},
  {0x2D,'[','{'},{0x2E,']','}'},{0x2F,'/','?'},{0x30,'=','+'},
  {0x33,'s','S'},{0x34,'-','_'},{0x36,'w','W'},{0x37,'v','V'},{0x38,'z','Z'},
};

static const DvKey COLEMAK[] = {
  {0x08,'f','F'},{0x15,'p','P'},{0x17,'g','G'},{0x1C,'j','J'},{0x18,'l','L'},
  {0x0C,'u','U'},{0x12,'y','Y'},{0x13,';',':'},
  {0x16,'r','R'},{0x07,'s','S'},{0x09,'t','T'},{0x0A,'d','D'},
  {0x0D,'n','N'},{0x0E,'e','E'},{0x0F,'i','I'},{0x33,'o','O'},
  {0x11,'k','K'},
};

const int LAYOUT_COUNT = 3;
const char *LAYOUT_NAMES[LAYOUT_COUNT] = { "QWERTY", "DVORAK", "COLEMAK" };

char layoutChar(uint8_t kc, bool shift) {
  const DvKey *tab; int n;
  if (g_layout == 1)      { tab = DVORAK;  n = (int)(sizeof(DVORAK)  / sizeof(DVORAK[0]));  }
  else if (g_layout == 2) { tab = COLEMAK; n = (int)(sizeof(COLEMAK) / sizeof(COLEMAK[0])); }
  else return 0;
  for (int i = 0; i < n; i++) if (tab[i].kc == kc) return shift ? tab[i].hi : tab[i].lo;
  return 0;   // not remapped -> caller keeps the library ascii
}

// ==== BLEKB-CORE BEGIN ==== (extracted verbatim into tests/ - keep in sync)
// BLE HID keyboards hand us raw input reports; unlike EspUsbHost there's no
// library doing the keycode->character work, so we decode them ourselves.
// (KeyEvt / BleKbState are defined near the top, in the BLEKB-TYPES block.)

// HID usage -> ASCII, US layout. Letters honor shift^caps; symbols shift only.
char hidToAscii(uint8_t kc, bool shift, bool caps) {
  if (kc >= 0x04 && kc <= 0x1D) {                 // a..z
    char c = (char)('a' + (kc - 0x04));
    return (shift != caps) ? (char)(c - 32) : c;
  }
  if (kc >= 0x1E && kc <= 0x27) {                 // 1..9,0
    static const char base[] = "1234567890";
    static const char shf[]  = "!@#$%^&*()";
    return shift ? shf[kc - 0x1E] : base[kc - 0x1E];
  }
  switch (kc) {
    case 0x28: return 13;                         // Enter
    case 0x2A: return 8;                          // Backspace
    case 0x2B: return 9;                          // Tab
    case 0x2C: return ' ';
    case 0x2D: return shift ? '_'  : '-';
    case 0x2E: return shift ? '+'  : '=';
    case 0x2F: return shift ? '{'  : '[';
    case 0x30: return shift ? '}'  : ']';
    case 0x31: return shift ? '|'  : '\\';
    case 0x33: return shift ? ':'  : ';';
    case 0x34: return shift ? '"'  : '\'';
    case 0x35: return shift ? '~'  : '`';
    case 0x36: return shift ? '<'  : ',';
    case 0x37: return shift ? '>'  : '.';
    case 0x38: return shift ? '?'  : '/';
  }
  return 0;                                       // arrows/F-keys...: keycode only
}

// A keyboard input report lists the keys *currently held* (standard 8-byte
// format: [modifiers, reserved, k1..k6]). Diffing against the previous report
// yields the newly pressed keys. Returns the number of KeyEvt produced.
int bleKbDecode(BleKbState &st, const uint8_t *rep, int len, KeyEvt *out, int maxOut) {
  if (!rep || len < 8) return 0;
  const uint8_t *keys = rep + 2;
  for (int i = 0; i < 6; i++)
    if (keys[i] == 0x01) return 0;                // phantom/rollover: ignore whole report
  uint8_t mods = rep[0];
  int nOut = 0;
  for (int i = 0; i < 6; i++) {
    uint8_t kc = keys[i];
    if (kc < 0x04) continue;                      // 0 = no key
    bool isNew = true;
    for (int j = 0; j < 6; j++) if (st.keys[j] == kc) { isNew = false; break; }
    if (!isNew) continue;
    if (kc == 0x39) { st.caps = !st.caps; continue; }   // CapsLock toggles, no event
    if (nOut < maxOut) {
      bool shift = (mods & 0x22) != 0;            // left/right shift
      KeyEvt e;
      e.ascii = (uint8_t)hidToAscii(kc, shift, st.caps);
      e.keycode = kc;
      e.modifiers = mods;
      e.caps = st.caps;
      out[nOut++] = e;
    }
  }
  st.mods = mods;
  memcpy(st.keys, keys, 6);
  return nOut;
}
// ==== BLEKB-CORE END ====

// The letter a physical key types under the ACTIVE layout (lowercase, 0 if
// none). Shortcuts use this, so Ctrl+W is the key that TYPES 'w' on Dvorak
// or Colemak - not the physical QWERTY position.
char keyLetter(uint8_t keycode) {
  char c = (g_layout != 0) ? layoutChar(keycode, false) : 0;
  if (!c) c = hidToAscii(keycode, false, false);
  return (c >= 'a' && c <= 'z') ? c : 0;
}

// The queue that both keyboard paths (USB + BLE) feed into; loop() drains it.
QueueHandle_t g_keyQueue = nullptr;

// =========================================================================
//  Bluetooth (BLE) keyboard host - optional (see ENABLE_BLE_KEYBOARD)
// =========================================================================
#if ENABLE_BLE_KEYBOARD
void drawBtPair();

enum BleState { BLE_OFF, BLE_IDLE, BLE_SCAN_PAIR, BLE_SCAN_RECONNECT, BLE_CONNECTING, BLE_CONNECTED };
volatile BleState g_bleState = BLE_OFF;
bool     g_bleEnabled = false;             // a keyboard is paired (persisted)
bool     g_bleInited  = false;             // NimBLE stack is up
bool     g_blePairing = false;             // a pairing session is in progress
uint32_t g_blePasskey = 0;                 // code shown during pairing
String   g_bleName    = "";                // paired keyboard's name (persisted)
NimBLEClient *g_bleClient = nullptr;
NimBLEAddress g_bleFoundAddr;              // set by the scan callback...
String        g_bleFoundName = "";
volatile bool g_bleDoConnect = false;      // ...then loop() connects (main task)
volatile bool g_bleUiDirty   = false;      // BLE task asks the UI to redraw
BleKbState g_bleKeys;

bool g_bleUserOff = false;                 // paired, but radio paused (persisted)

bool bleConnected() { return g_bleState == BLE_CONNECTED; }
const char *bleStatusStr() {
  if (g_bleEnabled && g_bleUserOff) return "paused";
  switch (g_bleState) {
    case BLE_CONNECTED:  return "connected";
    case BLE_CONNECTING: return "connecting";
    case BLE_SCAN_PAIR:  return "pairing";
    case BLE_IDLE:
    case BLE_SCAN_RECONNECT: return "waiting";
    default:             return "off";
  }
}

void bleSavePrefs() {
  g_prefs.begin("paper", false);
  g_prefs.putBool("bleon", g_bleEnabled);
  g_prefs.putBool("bleoff", g_bleUserOff);
  g_prefs.putString("blename", g_bleName);
  g_prefs.end();
}

// Pause / resume Bluetooth without losing the pairing: deinit(false) keeps
// the stored bond, so resuming reconnects without re-pairing.
void bleTogglePower() {
  if (!g_bleEnabled) return;               // nothing paired: use Pair instead
  g_bleUserOff = !g_bleUserOff;
  if (g_bleUserOff) {
    if (g_bleInited) {
      NimBLEDevice::getScan()->stop();
      if (g_bleClient && g_bleClient->isConnected()) g_bleClient->disconnect();
      NimBLEDevice::deinit(false);         // radio off, bond KEPT
      g_bleInited = false;
      g_bleClient = nullptr;
    }
    g_bleState = BLE_OFF;
  } else {
    bleInit();
    g_bleState = BLE_IDLE;                 // loop() re-arms the scan
  }
  bleSavePrefs();
}

// Keys arrive on NimBLE's own task: decode and queue only - never draw here.
void bleNotifyCB(NimBLERemoteCharacteristic *chr, uint8_t *data, size_t len, bool isNotify) {
  (void)chr; (void)isNotify;
  KeyEvt evs[8];
  int n = bleKbDecode(g_bleKeys, data, (int)len, evs, 8);
  for (int i = 0; i < n && g_keyQueue; i++) xQueueSend(g_keyQueue, &evs[i], 0);
}

class BleScanCB : public NimBLEScanCallbacks {
  void onResult(const NimBLEAdvertisedDevice *adv) override {
    if (!adv->isAdvertisingService(NimBLEUUID((uint16_t)0x1812))) return;  // HID only
    if (g_bleState == BLE_SCAN_RECONNECT) {
      // A sleeping keyboard often wakes advertising a rotating private
      // address, so a strict bond-address check misses it and forces a
      // from-scratch re-pair. Accept a bonded address OR a name match; the
      // stored keys still gate the connection (encryption fails on impostors).
      bool ours = NimBLEDevice::isBonded(adv->getAddress()) ||
                  (g_bleName.length() && g_bleName == adv->getName().c_str());
      if (!ours) return;
    }
    g_bleFoundAddr = adv->getAddress();
    g_bleFoundName = adv->getName().c_str();
    NimBLEDevice::getScan()->stop();
    g_bleDoConnect = true;                       // loop() takes it from here
  }
  void onScanEnd(const NimBLEScanResults &results, int reason) override {
    (void)results; (void)reason;
    if (g_bleDoConnect) return;                  // stopped on purpose, to connect
    if (g_bleState == BLE_SCAN_PAIR) {           // 30 s pairing window ran out
      g_blePairing = false;
      g_bleState = g_bleEnabled ? BLE_IDLE : BLE_OFF;
      g_bleUiDirty = true;
    } else if (g_bleState == BLE_SCAN_RECONNECT) {
      g_bleState = BLE_IDLE;                     // loop() re-arms the scan
    }
  }
};
BleScanCB g_bleScanCB;

class BleClientCB : public NimBLEClientCallbacks {
  void onDisconnect(NimBLEClient *c, int reason) override {
    (void)c; (void)reason;                       // keyboard slept or went away
    g_bleState = g_bleEnabled ? BLE_IDLE : BLE_OFF;   // loop() re-arms the scan
    g_bleUiDirty = true;
  }
};
BleClientCB g_bleClientCB;

void bleInit() {
  if (g_bleInited) return;
  NimBLEDevice::init("BYOBYOK");
  NimBLEDevice::setSecurityAuth(true, true, true);        // bond + MITM + LE SC
  NimBLEDevice::setSecurityIOCap(BLE_HS_IO_DISPLAY_ONLY); // we show a code, kb types it
  NimBLEDevice::getScan()->setScanCallbacks(&g_bleScanCB, false);
  NimBLEDevice::getScan()->setActiveScan(true);
  g_bleInited = true;
}

void bleStartScan(bool pairMode) {
  NimBLEScan *sc = NimBLEDevice::getScan();
  if (sc->isScanning()) sc->stop();
  if (pairMode) {                                // eager scan while the user waits
    sc->setInterval(100); sc->setWindow(100);
    g_bleState = BLE_SCAN_PAIR;
    sc->start(30 * 1000, false, true);           // 30 s pairing window
  } else {                                       // sipping scan: wait for kb to wake
    sc->setInterval(2000); sc->setWindow(50);    // low duty cycle, ~1-2 mA
    g_bleState = BLE_SCAN_RECONNECT;
    sc->start(0, false, true);                   // forever (until stopped)
  }
}

void bleBeginPair() {
  bleInit();
  if (g_bleClient && g_bleClient->isConnected()) g_bleClient->disconnect();
  NimBLEDevice::deleteAllBonds();
  g_bleEnabled = false; g_bleName = "";
  g_blePairing = true;
  g_blePasskey = 100000 + (esp_random() % 900000);   // always 6 digits
  NimBLEDevice::setSecurityPasskey(g_blePasskey);
  bleStartScan(true);
}

void bleForget() {
  g_blePairing = false;
  if (g_bleInited) {
    NimBLEDevice::getScan()->stop();
    if (g_bleClient && g_bleClient->isConnected()) g_bleClient->disconnect();
    NimBLEDevice::deleteAllBonds();
    NimBLEDevice::deinit(true);                  // radio fully off again
    g_bleInited = false;
    g_bleClient = nullptr;
  }
  g_bleEnabled = false; g_bleName = "";
  g_bleState = BLE_OFF;
  bleSavePrefs();
}

// Runs on the loop() task (connecting can block for a second or two).
void bleConnectNow() {
  g_bleState = BLE_CONNECTING; g_bleUiDirty = true;
  if (!g_bleClient) {
    g_bleClient = NimBLEDevice::createClient();
    g_bleClient->setClientCallbacks(&g_bleClientCB, false);
  }
  bool ok = g_bleClient->connect(g_bleFoundAddr);
  if (ok) ok = g_bleClient->secureConnection();  // pair/bond + encrypt (HID requires it)
  NimBLERemoteService *hid = ok ? g_bleClient->getService(NimBLEUUID((uint16_t)0x1812)) : nullptr;
  int subs = 0;
  if (hid) {
    // Report-protocol input reports: 0x2A4D whose 0x2908 descriptor says "input".
    for (auto *ch : hid->getCharacteristics(true)) {
      if (ch->getUUID() != NimBLEUUID((uint16_t)0x2A4D) || !ch->canNotify()) continue;
      auto *rr = ch->getDescriptor(NimBLEUUID((uint16_t)0x2908));
      if (rr) { auto v = rr->readValue(); if (v.size() >= 2 && v[1] != 0x01) continue; }
      if (ch->subscribe(true, bleNotifyCB)) subs++;
    }
    if (subs == 0) {                             // fall back to boot protocol
      auto *pm = hid->getCharacteristic(NimBLEUUID((uint16_t)0x2A4E));
      auto *bi = hid->getCharacteristic(NimBLEUUID((uint16_t)0x2A22));
      if (pm && bi && bi->canNotify()) {
        uint8_t boot = 0;                        // 0 = boot protocol mode
        pm->writeValue(&boot, 1, false);
        if (bi->subscribe(true, bleNotifyCB)) subs++;
      }
    }
  }
  if (subs == 0) {                               // not a usable keyboard
    if (g_bleClient->isConnected()) g_bleClient->disconnect();
    g_bleState = g_bleEnabled ? BLE_IDLE : BLE_OFF;    // loop() re-arms the scan
    g_bleUiDirty = true;
    return;
  }
  g_bleKeys = BleKbState();                      // fresh key-diff state
  if (g_blePairing) {                            // first success: persist it
    g_blePairing = false;
    g_bleEnabled = true;
    g_bleName = g_bleFoundName.length() ? g_bleFoundName : String("keyboard");
    bleSavePrefs();
  }
  g_blePasskey = 0;
  g_bleState = BLE_CONNECTED;
  g_bleUiDirty = true;
}

void bleBoot() {                                 // called once from setup()
  g_prefs.begin("paper", true);
  g_bleEnabled = g_prefs.getBool("bleon", false);
  g_bleUserOff = g_prefs.getBool("bleoff", false);
  g_bleName    = g_prefs.getString("blename", "");
  g_prefs.end();
  if (g_bleEnabled && !g_bleUserOff) { bleInit(); g_bleState = BLE_IDLE; }
}

void bleLoopTick() {                             // called every loop()
  if (g_bleDoConnect) { g_bleDoConnect = false; bleConnectNow(); }
  if (g_bleEnabled && g_bleInited && g_bleState == BLE_IDLE) bleStartScan(false);
  if (g_bleUiDirty) {
    g_bleUiDirty = false;
    if (g_state == ST_BTPAIR)    drawBtPair();
    else if (g_state == ST_MENU) drawMenu();     // refresh the status label
  }
}

// ---- pairing screen (ST_BTPAIR) - fully touch-operable --------------------
const int BT_ROWS = 5;
const int BT_ROW_H = 42, BT_ROW_GAP = 8, BT_ROW_W = 560;
int g_btRowYs[BT_ROWS];                    // -1 = row not shown this draw

void drawBtPair() {
  M5.Display.setEpdMode(m5gfx::epd_quality);
  M5.Display.startWrite();
  M5.Display.fillScreen(TFT_WHITE);
  M5.Display.setTextColor(TFT_BLACK, TFT_WHITE);
  M5.Display.setTextDatum(m5gfx::top_left);
  M5.Display.setFont(&fonts::FreeMonoBold18pt7b);
  M5.Display.drawString("Bluetooth keyboard", MARGIN_X, 24);

  M5.Display.setFont(&fonts::FreeMono12pt7b);
  String nm = g_bleName.length() ? g_bleName : String("keyboard");
  String st;
  switch (g_bleState) {
    case BLE_CONNECTED:      st = "Connected: " + nm; break;
    case BLE_CONNECTING:     st = "Connecting..."; break;
    case BLE_SCAN_PAIR:      st = "Scanning - put the keyboard in pairing mode."; break;
    case BLE_IDLE:
    case BLE_SCAN_RECONNECT: st = "Paired: " + nm + "  (press any key on it to wake)"; break;
    default:                 st = "Off."; break;
  }
  M5.Display.drawString(st, MARGIN_X, 92);

  if (g_blePasskey && (g_bleState == BLE_SCAN_PAIR || g_bleState == BLE_CONNECTING)) {
    M5.Display.setFont(&fonts::FreeMono9pt7b);
    M5.Display.drawString("If the keyboard asks for a code, type this on it, then Enter:",
                          MARGIN_X, 136);
    M5.Display.setFont(&fonts::FreeMonoBold18pt7b);
    char pk[8];
    snprintf(pk, sizeof(pk), "%06u", (unsigned)g_blePasskey);
    M5.Display.drawString(pk, MARGIN_X, 166);
    M5.Display.setFont(&fonts::FreeMono12pt7b);
  }

  const char *lbl[BT_ROWS] = {
    "Pair new keyboard",
    !g_bleEnabled ? nullptr
                  : (g_bleUserOff ? "Turn Bluetooth on" : "Turn Bluetooth off (keep pairing)"),
    "Key test (shows what each key sends)",
    g_bleEnabled ? "Forget this keyboard" : nullptr,
    "Back",
  };
  int y = 244;
  for (int i = 0; i < BT_ROWS; i++) {
    g_btRowYs[i] = -1;
    if (!lbl[i]) continue;
    g_btRowYs[i] = y;
    M5.Display.drawRect(MARGIN_X, y, BT_ROW_W, BT_ROW_H, TFT_BLACK);
    M5.Display.drawString(lbl[i], MARGIN_X + 16, y + 9);
    y += BT_ROW_H + BT_ROW_GAP;
  }

  M5.Display.setFont(&fonts::FreeMono9pt7b);
  M5.Display.drawString("BLE keyboards only (Bluetooth 4/5).  p pair  o on/off  t key test  f forget  ESC back",
                        MARGIN_X, H - 26);
  M5.Display.endWrite();
}

void enterBtPair() { g_state = ST_BTPAIR; drawBtPair(); }

void btPairLeave() {
  if (g_bleInited && g_bleState == BLE_SCAN_PAIR) {   // cancel a pairing session
    g_blePairing = false;
    NimBLEDevice::getScan()->stop();
    g_bleState = g_bleEnabled ? BLE_IDLE : BLE_OFF;
  }
  gotoMenu();
}

void doBtPairAction(int i) {
  switch (i) {
    case 0: bleBeginPair(); drawBtPair(); break;
    case 1: bleTogglePower(); drawBtPair(); break;
    case 2: enterKeyTest(); break;
    case 3: if (g_bleEnabled) { bleForget(); drawBtPair(); } break;
    case 4: btPairLeave(); break;
  }
}

void handleBtPairKey(uint8_t ascii, uint8_t keycode) {
  if (keycode == KC_ESC) { btPairLeave(); return; }
  if (ascii == 'p' || ascii == 'P') { doBtPairAction(0); return; }
  if (ascii == 'o' || ascii == 'O') { doBtPairAction(1); return; }
  if (ascii == 't' || ascii == 'T') { doBtPairAction(2); return; }
  if (ascii == 'f' || ascii == 'F') { doBtPairAction(3); return; }
}

void btPairTap(int x, int y) {
  if (x < MARGIN_X || x > MARGIN_X + BT_ROW_W) return;
  for (int i = 0; i < BT_ROWS; i++) {
    if (g_btRowYs[i] < 0) continue;
    if (y >= g_btRowYs[i] && y <= g_btRowYs[i] + BT_ROW_H) { doBtPairAction(i); return; }
  }
}

#else   // ENABLE_BLE_KEYBOARD == 0 -> no-op stubs so the sketch still compiles
inline bool bleConnected() { return false; }
inline const char *bleStatusStr() { return "off"; }
inline void enterBtPair() {}
inline void drawBtPair() {}
inline void btPairTap(int, int) {}
inline void handleBtPairKey(uint8_t, uint8_t) {}
inline void bleBoot() {}
inline void bleLoopTick() {}
#endif  // ENABLE_BLE_KEYBOARD

// =========================================================================
//  Key test - shows the raw event every keypress produces (USB and BLE).
//  Invaluable when a keyboard "doesn't work": you can see exactly what it
//  sends (keycode / modifier byte / decoded ascii) instead of guessing.
// =========================================================================
int g_ktCount = 0;

void enterKeyTest() {
  g_state = ST_KEYTEST;
  g_ktCount = 0;
  M5.Display.setEpdMode(m5gfx::epd_quality);
  M5.Display.startWrite();
  M5.Display.fillScreen(TFT_WHITE);
  M5.Display.setTextColor(TFT_BLACK, TFT_WHITE);
  M5.Display.setTextDatum(m5gfx::top_left);
  M5.Display.setFont(&fonts::FreeMonoBold18pt7b);
  M5.Display.drawString("Key test", MARGIN_X, 24);
  M5.Display.setFont(&fonts::FreeMono12pt7b);
  M5.Display.drawString("Press keys; each event shows below.", MARGIN_X, 90);
  M5.Display.drawString("mods bits: 01/10 Ctrl  02/20 Shift", MARGIN_X, 130);
  M5.Display.drawString("           04/40 Alt   08/80 Cmd/Win", MARGIN_X, 164);
  M5.Display.setFont(&fonts::FreeMono9pt7b);
  M5.Display.drawString("ESC or tap to go back.", MARGIN_X, H - 28);
  M5.Display.endWrite();
}

void keyTestShow(uint8_t ascii, uint8_t keycode, uint8_t modifier, bool caps) {
  char pr = (ascii >= 32 && ascii < 127) ? (char)ascii : '.';
  char b[72];
  snprintf(b, sizeof(b), "#%-3d key=0x%02X  mods=0x%02X  ascii=0x%02X '%c'  caps=%d",
           ++g_ktCount, keycode, modifier, ascii, pr, caps ? 1 : 0);
  M5.Display.setEpdMode(m5gfx::epd_fast);
  M5.Display.startWrite();
  M5.Display.fillRect(0, 220, W, 44, TFT_WHITE);
  M5.Display.setFont(&fonts::FreeMono12pt7b);
  M5.Display.setTextColor(TFT_BLACK, TFT_WHITE);
  M5.Display.setTextDatum(m5gfx::top_left);
  M5.Display.drawString(b, MARGIN_X, 228);
  M5.Display.endWrite();
}

// =========================================================================
//  USB drive mode - show the SD card to a computer as a USB stick
// =========================================================================
// The single USB-C port can't be a keyboard host and a USB drive at once, so
// this works as a reboot-into mode: picking "USB drive" sets a one-shot flag
// and restarts; on that boot the keyboard host is skipped and TinyUSB MSC
// serves raw SD sectors instead. Tap / power button / eject restarts back.
bool g_usbDriveMode = false;     // true only on an MSC boot (skips the editor)

#if ENABLE_USB_DRIVE
USBMSC g_msc;
volatile bool g_mscEject = false;

static int32_t mscRead(uint32_t lba, uint32_t offset, void *buffer, uint32_t bufsize) {
  (void)offset;
  for (uint32_t i = 0; i < bufsize / 512; i++)
    if (!SD.readRAW((uint8_t *)buffer + i * 512, lba + i)) return -1;
  return (int32_t)bufsize;
}
static int32_t mscWrite(uint32_t lba, uint32_t offset, uint8_t *buffer, uint32_t bufsize) {
  (void)offset;
  for (uint32_t i = 0; i < bufsize / 512; i++)
    if (!SD.writeRAW(buffer + i * 512, lba + i)) return -1;
  return (int32_t)bufsize;
}
static bool mscStartStop(uint8_t power, bool start, bool eject) {
  (void)power; (void)start;
  if (eject) g_mscEject = true;  // the computer "safely removed" the drive
  return true;
}

void usbDriveFlag(bool on) {
  g_prefs.begin("paper", false);
  g_prefs.putBool("usbdrv", on);
  g_prefs.end();
}
bool usbDriveFlagged() {
  g_prefs.begin("paper", true);
  bool on = g_prefs.getBool("usbdrv", false);
  g_prefs.end();
  return on;
}

// Called from setup() when the one-shot flag is set: no keyboard host, no
// menu - just MSC and a screen. The firmware must not touch the SD
// filesystem while the computer owns it, so loop() short-circuits too.
void usbDriveBoot(bool sdok) {
  g_usbDriveMode = true;
  usbDriveFlag(false);           // one-shot: any restart returns to normal
  M5.Display.setEpdMode(m5gfx::epd_quality);
  M5.Display.startWrite();
  M5.Display.fillScreen(TFT_WHITE);
  M5.Display.setTextColor(TFT_BLACK, TFT_WHITE);
  M5.Display.setTextDatum(m5gfx::top_left);
  M5.Display.setFont(&fonts::FreeMonoBold18pt7b);
  M5.Display.drawString("USB drive mode", MARGIN_X, 24);
  M5.Display.setFont(&fonts::FreeMono12pt7b);
  int y = 100;
  if (sdok) {
    M5.Display.drawString("Plug the USB-C cable into a computer.", MARGIN_X, y);       y += 38;
    M5.Display.drawString("The SD card appears as a removable drive -", MARGIN_X, y);  y += 38;
    M5.Display.drawString("large cards can take a minute to show up", MARGIN_X, y);    y += 38;
    M5.Display.drawString("(the computer checks the disk first).", MARGIN_X, y);       y += 50;
    M5.Display.drawString("EJECT it on the computer when done: that", MARGIN_X, y);    y += 38;
    M5.Display.drawString("restarts the device and keeps mounts fast.", MARGIN_X, y);  y += 50;
  } else {
    M5.Display.drawString("microSD not found - nothing to share.", MARGIN_X, y);       y += 60;
  }
  M5.Display.drawString("Tap the screen to restart back to writing.", MARGIN_X, y);
  M5.Display.endWrite();
  if (!sdok) return;
  g_msc.vendorID("M5Stack");
  g_msc.productID("BYOBYOK_SD");
  g_msc.productRevision("1.0");
  g_msc.onRead(mscRead);
  g_msc.onWrite(mscWrite);
  g_msc.onStartStop(mscStartStop);
  g_msc.mediaPresent(true);
  bool up = g_msc.begin((uint32_t)(SD.cardSize() / 512), 512);
  if (up) up = USB.begin();

  // Diagnose the two ways this silently fails, right on the screen.
  M5.Display.startWrite();
  M5.Display.setFont(&fonts::FreeMono9pt7b);
  M5.Display.setTextColor(TFT_BLACK, TFT_WHITE);
  if (!up)
    M5.Display.drawString("USB device stack failed to start - tap to go back.",
                          MARGIN_X, H - 76);
#if defined(ARDUINO_USB_CDC_ON_BOOT) && ARDUINO_USB_CDC_ON_BOOT
  M5.Display.drawString("This build has 'USB CDC On Boot' ENABLED - the drive can NOT appear.",
                        MARGIN_X, H - 52);
  M5.Display.drawString("Set Tools > USB CDC On Boot = Disabled and re-flash.",
                        MARGIN_X, H - 28);
#endif
  M5.Display.endWrite();
}

void enterUsbDrive() {           // from the menu: arm the flag and restart
  usbDriveFlag(true);
  ESP.restart();
}

// The whole loop() body while serving MSC: watch for the three exit signals.
void usbDriveLoopTick() {
  M5.update();
  bool leave = g_mscEject || M5.BtnPWR.wasClicked();
  if (!leave && M5.Touch.isEnabled()) {
    auto &t = M5.Touch.getDetail(0);
    leave = t.wasClicked();
  }
  if (leave) { delay(300); ESP.restart(); }
  delay(10);
}
#else
inline void enterUsbDrive() {}
inline bool usbDriveFlagged() { return false; }
inline void usbDriveBoot(bool) {}
inline void usbDriveLoopTick() {}
#endif  // ENABLE_USB_DRIVE

// ---- USB keyboard host ---------------------------------------------------
EspUsbHost usbHost;

// This EspUsbHost runs USB on its own FreeRTOS task and reports keys via a
// callback (not a virtual). The callback fires off the loop() task, so it must
// not draw - it just queues the keypress (KeyEvt + g_keyQueue are defined with
// the BLE decode core above), and loop() processes it on the main task where
// all the e-ink drawing happens (single-threaded display access).

void onKbEvent(const EspUsbHostKeyboardEvent &e) {
  if (!e.pressed) return;                       // key-down events only
  KeyEvt k{ e.ascii, e.keycode, e.modifiers, e.capsLock };
  if (g_keyQueue) xQueueSend(g_keyQueue, &k, 0);
}

void dispatchKey(uint8_t ascii, uint8_t keycode, uint8_t modifier, bool caps) {
  g_lastActivity = millis();                    // any key resets the idle timer

  if (g_state == ST_KEYTEST) {                  // diagnostics: show raw events
    if (keycode == KC_ESC) {
      if (ENABLE_BLE_KEYBOARD) { g_state = ST_BTPAIR; drawBtPair(); }
      else gotoMenu();
    } else keyTestShow(ascii, keycode, modifier, caps);
    return;
  }

  // Ctrl+R on ANY screen: repaint it at full quality (manual de-ghost).
  if ((modifier & (0x11 | 0x88)) && keyLetter(keycode) == 'r' && g_state != ST_KEYTEST) {
    redrawScreen();
    return;
  }

  // Remap printable keys for Dvorak/Colemak; QWERTY keeps the library ascii.
  uint8_t ch = ascii;
  if (g_layout != 0) {
    bool shift = modifier & 0x22;               // left/right shift
    char d = layoutChar(keycode, shift);
    if (d) {
      if (caps && ((d >= 'a' && d <= 'z') || (d >= 'A' && d <= 'Z'))) d ^= 0x20;
      ch = (uint8_t)d;
    }
  }

  switch (g_state) {
    case ST_MENU:     handleMenuKey(ch, keycode); break;
    case ST_EDIT:     handleEditKey(ch, keycode, modifier); break;
    case ST_EDITMENU: handleEditMenuKey(ch, keycode); break;
    case ST_PROMPT:   handlePromptKey(ch, keycode); break;
    case ST_CONFIRM:  handleConfirmKey(ch, keycode); break;
    case ST_EXPORT:   handleExportKey(ch, keycode); break;
    case ST_HELP:     handleHelpKey(ch, keycode); break;
    case ST_READER:   handleReaderKey(ch, keycode); break;
    case ST_BTPAIR:   handleBtPairKey(ch, keycode); break;
    case ST_COUNT:    handleCountKey(ch, keycode); break;
    case ST_GOAL:     handleGoalKey(ch, keycode); break;
    case ST_STATS:    handleStatsKey(ch, keycode); break;
    case ST_SPELL:    handleSpellKey(ch, keycode); break;
    case ST_SYNC:     handleSyncKey(ch, keycode); break;
    case ST_RMENU:    handleReaderMenuKey(ch, keycode); break;
    case ST_GOPAGE:   handleGoPageKey(ch, keycode); break;
  }
}

// =========================================================================
//  Text layout (word-wrap) + caret mapping
// =========================================================================
// ==== TEXTCORE-2 BEGIN ==== (extracted verbatim into tests/ - keep in sync)
void layout() {
  g_lines.clear();
  int n = doc.length();
  // Pre-size the line index in ONE allocation: hard newlines plus a soft-wrap
  // estimate. Without this, growth-by-doubling on a many-line file (e.g. a
  // word list) transiently needs old+new copies at once - an OOM spike.
  {
    int est = 16 + n / (g_cols > 0 ? g_cols : 8);
    for (int k = 0; k < n; k++) if (doc[k] == '\n') est++;
    if ((int)g_lines.capacity() < est) g_lines.reserve(est);
  }
  int lineStart = 0, lastSpace = -1, col = 0, i = 0;
  bool wrappedStart = false;                 // did this line begin from a wrap?
  while (i < n) {
    char c = doc[i];
    if (c == '\n') {
      // A newline right after a wrap shouldn't add a spurious blank line.
      if (!(i == lineStart && wrappedStart)) g_lines.push_back({lineStart, i - lineStart});
      i++; lineStart = i; col = 0; lastSpace = -1; wrappedStart = false;
      continue;
    }
    if (col >= g_cols) {
      if (c == ' ') {                       // absorb a trailing space, then break
        g_lines.push_back({lineStart, i + 1 - lineStart});
        i++; lineStart = i; col = 0; lastSpace = -1; wrappedStart = true;
        continue;
      }
      if (lastSpace >= lineStart) {         // soft break at last space
        int brk = lastSpace + 1;
        g_lines.push_back({lineStart, brk - lineStart});
        lineStart = brk; lastSpace = -1;
        col = i - lineStart;                // keep current i; recount column
        wrappedStart = true;
        continue;
      }
      g_lines.push_back({lineStart, i - lineStart});  // hard break (long word)
      lineStart = i; col = 0; lastSpace = -1; wrappedStart = true;
      continue;
    }
    if (c == ' ') lastSpace = i;
    i++; col++;
  }
  g_lines.push_back({lineStart, n - lineStart});      // final line (may be empty)
}

String lineStr(int idx) {
  const Line &L = g_lines[idx];
  return doc.substring(L.start, L.start + L.len);
}

void caretRowCol(int pos, int &row, int &col) {
  int n = doc.length();
  for (int i = 0; i < (int)g_lines.size(); i++) {
    int s = g_lines[i].start, e = s + g_lines[i].len;
    if (pos < e) { row = i; col = pos - s; return; }
    if (pos == e) {
      bool lastLine   = (i == (int)g_lines.size() - 1);
      bool newlineHere = (e < n) && (doc[e] == '\n');
      if (lastLine || newlineHere) { row = i; col = pos - s; return; }
      // soft-wrap boundary: caret belongs to the start of the next line
    }
  }
  row = (int)g_lines.size() - 1;
  col = g_lines[row].len;
}

int posFromRowCol(int row, int col) {
  if (g_lines.empty()) return 0;
  if (row < 0) row = 0;
  if (row >= (int)g_lines.size()) row = (int)g_lines.size() - 1;
  int c = col;
  if (c < 0) c = 0;
  if (c > g_lines[row].len) c = g_lines[row].len;
  return g_lines[row].start + c;
}

// ---- word count, kept incrementally -------------------------------------
static inline bool wordSpace(char c) { return c == ' ' || c == '\n' || c == '\t' || c == '\r'; }

// Count "word starts" at indices [a,b): a non-space whose predecessor is a
// space (or the start of the document). Summed over the whole doc this equals
// the word count; after an edit only a small window can change.
int countWordStarts(int a, int b) {
  int n = doc.length();
  if (a < 0) a = 0;
  if (b > n) b = n;
  int w = 0;
  for (int i = a; i < b; i++)
    if (!wordSpace(doc[i]) && (i == 0 || wordSpace(doc[i - 1]))) w++;
  return w;
}
int recountWords() { return countWordStarts(0, doc.length()); }

// ---- word-wise caret movement ----------------------------------------------
// One "word" hop: skip separators, then a whole run of non-separators (going
// left), or the mirror image going right - the classic editor behavior.
int wordLeftPos(int pos) {
  if (pos > (int)doc.length()) pos = doc.length();
  while (pos > 0 && wordSpace(doc[pos - 1])) pos--;
  while (pos > 0 && !wordSpace(doc[pos - 1])) pos--;
  return pos;
}
int wordRightPos(int pos) {
  int n = doc.length();
  if (pos < 0) pos = 0;
  while (pos < n && !wordSpace(doc[pos])) pos++;
  while (pos < n && wordSpace(doc[pos])) pos++;
  return pos;
}

// ---- UTF-8 -> ASCII folding -------------------------------------------------
// The built-in FreeMono fonts are 7-bit, so typographic characters in UTF-8
// files (curly quotes, em-dashes, accents...) would render as blank boxes.
// Files are folded to their ASCII equivalents as they load.

// Incremental UTF-8 decoder: feed one byte at a time (sequences may straddle
// read chunks); returns the completed code point, or -1 while mid-sequence
// (invalid bytes are silently dropped).
struct Utf8Fold {
  uint32_t cp = 0;
  int need = 0;
  long feed(uint8_t b) {
    if (b < 0x80) { need = 0; return (long)b; }
    if ((b & 0xC0) == 0x80) {                  // continuation byte
      if (need > 0) {
        cp = (cp << 6) | (b & 0x3F);
        if (--need == 0) return (long)cp;
      }
      return -1;
    }
    if ((b & 0xE0) == 0xC0) { cp = b & 0x1F; need = 1; return -1; }
    if ((b & 0xF0) == 0xE0) { cp = b & 0x0F; need = 2; return -1; }
    if ((b & 0xF8) == 0xF0) { cp = b & 0x07; need = 3; return -1; }
    need = 0;
    return -1;
  }
};

// When Latin-1 capable fonts are compiled in (USE_LATIN1_FONTS), code points
// A0..FF pass through as single Latin-1 bytes instead of being transliterated
// - the grid math stays byte-per-cell, and the fonts have the glyphs.
bool g_keepLatin1 = false;

// ASCII replacement for a non-ASCII code point ("" = drop, "?" = unknown).
const char *asciiFold(uint32_t cp) {
  if (g_keepLatin1 && cp >= 0xA0 && cp <= 0xFF) {
    static char raw[2] = {0, 0};
    raw[0] = (char)cp;
    return raw;
  }
  // Esperanto circumflex/breve letters: internal slots 0x80.. when the fonts
  // carry the glyphs, standard x-notation otherwise.
  static const uint16_t EO_CP[12] = {0x109,0x108,0x11D,0x11C,0x125,0x124,
                                     0x135,0x134,0x15D,0x15C,0x16D,0x16C};
  static const char *EO_X[12] = {"cx","Cx","gx","Gx","hx","Hx",
                                 "jx","Jx","sx","Sx","ux","Ux"};
  for (int k = 0; k < 12; k++) {
    if (cp != EO_CP[k]) continue;
    if (!g_keepLatin1) return EO_X[k];
    static char slot[2] = {0, 0};
    slot[0] = (char)(0x80 + k);
    return slot;
  }
  switch (cp) {
    case 0x2018: case 0x2019: case 0x201A: case 0x201B:
    case 0x2039: case 0x203A: case 0x02BC: return "'";
    case 0x201C: case 0x201D: case 0x201E: case 0x201F:
    case 0x00AB: case 0x00BB: return "\"";
    case 0x2010: case 0x2011: case 0x2013: case 0x2212: return "-";
    case 0x2014: case 0x2015: return "--";
    case 0x2026: return "...";
    case 0x00A0: case 0x2002: case 0x2003: case 0x2007:
    case 0x2009: case 0x200A: case 0x202F: return " ";
    case 0x00AD: case 0x200B: case 0x200C: case 0x200D: case 0xFEFF: return "";
    case 0x2022: case 0x00B7: case 0x25CF: return "*";
    case 0x00A9: return "(c)"; case 0x00AE: return "(R)"; case 0x2122: return "(TM)";
    case 0x00BC: return "1/4"; case 0x00BD: return "1/2"; case 0x00BE: return "3/4";
    case 0x00D7: return "x";   case 0x00F7: return "/";
    case 0x00DF: return "ss";  case 0x00DE: case 0x00FE: return "th";
    case 0x00C6: return "AE";  case 0x00E6: return "ae";
    case 0x0152: return "OE";  case 0x0153: return "oe";
  }
  if (cp >= 0x00C0 && cp <= 0x00FF) {          // Latin-1 letters: drop accents
    static const char *tab =
      "AAAAAA CEEEEIIII"                       // 0xC0..0xCF
      "DNOOOOO OUUUUY  "                       // 0xD0..0xDF
      "aaaaaa ceeeeiiii"                       // 0xE0..0xEF
      "dnooooo ouuuuy y";                      // 0xF0..0xFF
    static char one[2] = {0, 0};
    one[0] = tab[cp - 0x00C0];
    return (one[0] == ' ') ? "?" : one;
  }
  return "?";                                  // visible, unlike a tofu box
}

// ---- incremental re-wrap --------------------------------------------------
// Index of the line whose .start == s (starts are strictly increasing).
static int findLineByStart(int s) {
  int lo = 0, hi = (int)g_lines.size() - 1;
  while (lo <= hi) {
    int mid = (lo + hi) >> 1;
    if (g_lines[mid].start == s) return mid;
    if (g_lines[mid].start < s) lo = mid + 1; else hi = mid - 1;
  }
  return -1;
}

// Re-wrap only what an edit could have changed. The edit replaced delLen
// chars at pos with insLen chars (doc is already updated). The wrap state is
// fully reset by every '\n', so we recompute lines from the start of the
// paragraph containing pos up to the first '\n' past the end of the edit;
// every line before that is untouched and every line after it is the old
// line, shifted by the length delta. Falls back to a full layout() if the
// line list looks inconsistent (defensive - should not happen).
void layoutEdit(int pos, int delLen, int insLen) {
  if (g_lines.empty()) { layout(); return; }
  int n = doc.length(), delta = insLen - delLen, editEnd = pos + insLen;

  int p0 = pos;                                  // paragraph start = a line start
  while (p0 > 0 && doc[p0 - 1] != '\n') p0--;
  int L0 = findLineByStart(p0);
  if (L0 < 0) { layout(); return; }

  // Same wrapping loop as layout(), started fresh at p0.
  std::vector<Line> fresh;
  int lineStart = p0, lastSpace = -1, col = 0, i = p0, tailNew = -1;
  bool wrappedStart = false;
  while (i < n) {
    char c = doc[i];
    if (c == '\n') {
      if (!(i == lineStart && wrappedStart)) fresh.push_back({lineStart, i - lineStart});
      i++; lineStart = i; col = 0; lastSpace = -1; wrappedStart = false;
      if (i > editEnd) { tailNew = i; break; }   // '\n' past the edit: old lines resume
      continue;
    }
    if (col >= g_cols) {
      if (c == ' ') {                            // absorb a trailing space, then break
        fresh.push_back({lineStart, i + 1 - lineStart});
        i++; lineStart = i; col = 0; lastSpace = -1; wrappedStart = true;
        continue;
      }
      if (lastSpace >= lineStart) {              // soft break at last space
        int brk = lastSpace + 1;
        fresh.push_back({lineStart, brk - lineStart});
        lineStart = brk; lastSpace = -1;
        col = i - lineStart;
        wrappedStart = true;
        continue;
      }
      fresh.push_back({lineStart, i - lineStart});  // hard break (long word)
      lineStart = i; col = 0; lastSpace = -1; wrappedStart = true;
      continue;
    }
    if (c == ' ') lastSpace = i;
    i++; col++;
  }

  if (tailNew < 0) {                             // re-wrapped to the very end
    fresh.push_back({lineStart, n - lineStart});
    g_lines.resize(L0);
    g_lines.insert(g_lines.end(), fresh.begin(), fresh.end());
    return;
  }
  int T = findLineByStart(tailNew - delta);      // old line where the tail resumes
  if (T < 0) { layout(); return; }
  std::vector<Line> tail(g_lines.begin() + T, g_lines.end());
  for (auto &L : tail) L.start += delta;
  g_lines.resize(L0);
  g_lines.insert(g_lines.end(), fresh.begin(), fresh.end());
  g_lines.insert(g_lines.end(), tail.begin(), tail.end());
}

// ---- macOS-style character composition ---------------------------------------
// Option + dead key, then a base letter: Option+u,a -> ä. Dead keys follow the
// macOS convention (u diaeresis, e acute, ` grave, i circumflex, n tilde) plus
// b (breve) for Esperanto's ŭ; circumflex composes c/g/h/j/s to ĉĝĥĵŝ (the
// internal 0x80.. slots). Returns the internal byte, 0 if the pair doesn't
// compose. Direct Option characters (å ø ß æ ç) need no second key.
struct ComposeEntry { char dk, base; uint8_t out; };
static const ComposeEntry COMPOSE[] = {
  {'u','a',0xE4},{'u','o',0xF6},{'u','u',0xFC},{'u','e',0xEB},{'u','i',0xEF},{'u','y',0xFF},
  {'u','A',0xC4},{'u','O',0xD6},{'u','U',0xDC},{'u','E',0xCB},{'u','I',0xCF},
  {'e','a',0xE1},{'e','e',0xE9},{'e','i',0xED},{'e','o',0xF3},{'e','u',0xFA},{'e','y',0xFD},
  {'e','A',0xC1},{'e','E',0xC9},{'e','I',0xCD},{'e','O',0xD3},{'e','U',0xDA},{'e','Y',0xDD},
  {'`','a',0xE0},{'`','e',0xE8},{'`','i',0xEC},{'`','o',0xF2},{'`','u',0xF9},
  {'`','A',0xC0},{'`','E',0xC8},{'`','I',0xCC},{'`','O',0xD2},{'`','U',0xD9},
  {'i','a',0xE2},{'i','e',0xEA},{'i','i',0xEE},{'i','o',0xF4},{'i','u',0xFB},
  {'i','A',0xC2},{'i','E',0xCA},{'i','I',0xCE},{'i','O',0xD4},{'i','U',0xDB},
  {'i','c',0x80},{'i','C',0x81},{'i','g',0x82},{'i','G',0x83},{'i','h',0x84},
  {'i','H',0x85},{'i','j',0x86},{'i','J',0x87},{'i','s',0x88},{'i','S',0x89},
  {'n','n',0xF1},{'n','N',0xD1},{'n','a',0xE3},{'n','A',0xC3},{'n','o',0xF5},{'n','O',0xD5},
  {'b','u',0x8A},{'b','U',0x8B},
};
uint8_t composeChar(char dk, char base) {
  for (auto &e : COMPOSE) if (e.dk == dk && e.base == base) return e.out;
  return 0;
}
uint8_t optionChar(char key) {
  switch (key) {
    case 'a': return 0xE5; case 'A': return 0xC5;   // å Å
    case 'o': return 0xF8; case 'O': return 0xD8;   // ø Ø
    case 'c': return 0xE7; case 'C': return 0xC7;   // ç Ç
    case 's': return 0xDF;                          // ß
    case '\'': return 0xE6; case '"': return 0xC6;  // æ Æ
  }
  return 0;
}
bool composeDead(char k) {
  return k == 'u' || k == 'e' || k == 'i' || k == 'n' || k == 'b' || k == '`';
}

// ---- markdown emphasis (rendered by the Reader) -----------------------------
// **text** toggles bold, *text* toggles italic (a "* " bullet at the very
// start of a paragraph stays literal), and a paragraph starting with '#' is a
// heading (whole line bold). Emphasis resets at every hard newline. Markers
// stay visible - only the text between them changes style - so the character
// grid and wrap math are untouched.
// Computes the style state at `pos` by scanning from its paragraph start;
// parStart is returned for the renderer's bullet check. (A ** split across a
// soft wrap may momentarily mis-style one line - cosmetic, self-corrects.)
void mdStateAt(int pos, int &parStart, bool &bold, bool &ital, bool &heading) {
  int p0 = pos;
  while (p0 > 0 && doc[p0 - 1] != '\n') p0--;
  parStart = p0;
  bold = ital = false;
  heading = (p0 < (int)doc.length() && doc[p0] == '#');
  int i = p0;
  while (i < pos) {
    if (doc[i] != '*') { i++; continue; }
    if (i + 1 < pos && doc[i + 1] == '*') { bold = !bold; i += 2; continue; }
    bool bullet = (i == p0 && i + 1 < (int)doc.length() &&
                   (doc[i + 1] == ' ' || doc[i + 1] == '\t'));
    if (!bullet) ital = !ital;
    i++;
  }
}

// ---- search ---------------------------------------------------------------
// Case-insensitive find, starting at `from`, wrapping around the document.
// Returns the match index or -1.
int searchDoc(const String &needle, int from) {
  int n = doc.length(), m = (int)needle.length();
  if (m == 0 || m > n) return -1;
  if (from < 0 || from >= n) from = 0;
  auto low = [](char c) { return (c >= 'A' && c <= 'Z') ? (char)(c + 32) : c; };
  for (int k = 0; k < n; k++) {
    int i = (from + k) % n;
    if (i + m > n) continue;
    bool hit = true;
    for (int j = 0; j < m; j++)
      if (low(doc[i + j]) != low(needle[j])) { hit = false; break; }
    if (hit) return i;
  }
  return -1;
}

// ---- undo journal -----------------------------------------------------------
// Every edit goes through docReplace, so undo is a journal of inverses:
// "insLen chars were inserted at pos, replacing del". Runs of single-char
// typing / backspacing coalesce into one entry so Ctrl+Z steps feel chunky.
struct UndoOp { int pos; int insLen; String del; };
std::vector<UndoOp> g_undo;
bool g_undoSuppress = false;         // true while undoLast applies an inverse
const int UNDO_MAX = 200;            // entries kept (typing coalesces, so ~generous)

void undoClear() { g_undo.clear(); }

void recordUndo(int pos, const String &del, int insLen) {
  if (g_undoSuppress) return;
  int delLen = (int)del.length();
  if (!g_undo.empty()) {
    UndoOp &last = g_undo.back();
    // coalesce a run of typing: single insert right after the previous one
    if (delLen == 0 && insLen == 1 && (int)last.del.length() == 0 &&
        last.insLen > 0 && last.insLen < 32 && pos == last.pos + last.insLen) {
      last.insLen++;
      return;
    }
    // coalesce a run of backspacing: single deletes walking left
    if (insLen == 0 && delLen == 1 && last.insLen == 0 &&
        (int)last.del.length() > 0 && (int)last.del.length() < 32 &&
        pos == last.pos - 1) {
      String t; t += del[0]; t += last.del;
      last.del = t;
      last.pos = pos;
      return;
    }
  }
  UndoOp op; op.pos = pos; op.insLen = insLen; op.del = del;
  g_undo.push_back(op);
  if ((int)g_undo.size() > UNDO_MAX) g_undo.erase(g_undo.begin());
}

// Single entry point for all edits: replaces delLen chars at pos with the
// insLen bytes at s, updates the word count by re-examining only the window
// whose word-boundary status could have changed, re-wraps incrementally, and
// records the inverse in the undo journal.
// Returns how many chars were actually inserted (0 if out of memory).
int docReplace(int pos, int delLen, const char *s, int insLen) {
  int n = doc.length();
  if (pos < 0) pos = 0;
  if (pos > n) pos = n;
  if (delLen < 0) delLen = 0;
  if (delLen > n - pos) delLen = n - pos;
  String deleted;
  if (delLen > 0 && !g_undoSuppress) deleted = doc.substring(pos, pos + delLen);
  g_docWords -= countWordStarts(pos, pos + delLen + 1);
  doc.erase(pos, delLen);
  if (insLen > 0 && !doc.insert(pos, s, insLen)) insLen = 0;
  g_docWords += countWordStarts(pos, pos + insLen + 1);
  layoutEdit(pos, delLen, insLen);
  recordUndo(pos, deleted, insLen);
  return insLen;
}

// Revert the newest undo entry. Returns the caret position to move to after
// the revert, or -1 if there was nothing to undo.
int undoLast() {
  if (g_undo.empty()) return -1;
  UndoOp op = g_undo.back();
  g_undo.pop_back();
  g_undoSuppress = true;
  docReplace(op.pos, op.insLen, op.del.c_str(), (int)op.del.length());
  g_undoSuppress = false;
  return op.pos + (int)op.del.length();
}
// ==== TEXTCORE-2 END ====

// ==== SPELLCORE BEGIN ==== (extracted verbatim into tests/ - keep in sync)
// Spell check against a plain word list, one word per line - any standard
// dictionary file works as-is (mixed case, possessives, accents, any sort
// order: the list is normalized at load). Held in memory, binary-searched
// over line offsets.
char *g_dict = nullptr;
int   g_dictLen = 0;
std::vector<int> g_dictOff;              // offset of each line in g_dict

void dictIndex() {
  g_dictOff.clear();
  bool atStart = true;
  for (int i = 0; i < g_dictLen; i++) {
    char c = g_dict[i];
    if (atStart && c != '\n' && c != '\r') { g_dictOff.push_back(i); atStart = false; }
    if (c == '\n') atStart = true;
  }
}

// Normalize the indexed list so binary search works no matter how the file
// was formatted: lowercase everything in place, then sort the line offsets
// into byte order. Standard lists (macOS/Linux words, SCOWL) mix cases and
// collations, and lowercasing changes the byte order anyway - documents are
// compared as lowercase ASCII, so the list must be too. One-time cost at load.
void dictNormalize() {
  for (int i = 0; i < g_dictLen; i++) {
    char c = g_dict[i];
    if (c >= 'A' && c <= 'Z') g_dict[i] = (char)(c + 32);
  }
  std::sort(g_dictOff.begin(), g_dictOff.end(), [](int a, int b) {
    for (int j = 0; ; j++) {
      char ca = (a + j < g_dictLen) ? g_dict[a + j] : '\n';
      char cb = (b + j < g_dictLen) ? g_dict[b + j] : '\n';
      if (ca == '\r' || ca == '\n') ca = 0;
      if (cb == '\r' || cb == '\n') cb = 0;
      if (ca != cb) return (unsigned char)ca < (unsigned char)cb;
      if (ca == 0) return false;
    }
  });
}

// compare a lowercase word of length wl against the dictionary line at off
static int dictCmp(const char *w, int wl, int off) {
  for (int j = 0; ; j++) {
    char d = (off + j < g_dictLen) ? g_dict[off + j] : '\n';
    if (d == '\r' || d == '\n') d = 0;
    char c = (j < wl) ? w[j] : 0;
    if (c != d) return ((unsigned char)c < (unsigned char)d) ? -1 : 1;
    if (c == 0) return 0;
  }
}

// Words learned at runtime ('l' on the spell screen). The sketch also appends
// them to the list file, so they're in the sorted index from the next boot.
std::vector<String> g_dictLearned;
void dictLearn(const char *w) { g_dictLearned.push_back(String(w)); }

bool dictHas(const char *w, int wl) {
  int lo = 0, hi = (int)g_dictOff.size() - 1;
  while (lo <= hi) {
    int mid = (lo + hi) >> 1;
    int c = dictCmp(w, wl, g_dictOff[mid]);
    if (c == 0) return true;
    if (c < 0) hi = mid - 1; else lo = mid + 1;
  }
  for (auto &lw : g_dictLearned)               // small linear overlay
    if ((int)lw.length() == wl && memcmp(lw.c_str(), w, wl) == 0) return true;
  return false;
}

static inline bool wordLetter(char c) { return (c >= 'a' && c <= 'z') || (c >= 'A' && c <= 'Z'); }

// Next word in the doc at/after `from`: fills out[] lowercased (truncated to
// maxLen-1), returns the index just past the word, or -1 at end of document.
// Apostrophes inside a word (don't, dog's) are part of it.
int docNextWord(int from, char *out, int maxLen, int &wl) {
  int n = doc.length(), i = from;
  while (i < n && !wordLetter(doc[i])) i++;
  if (i >= n) return -1;
  wl = 0;
  while (i < n) {
    char c = doc[i];
    bool apos = (c == '\'' && wl > 0 && i + 1 < n && wordLetter(doc[i + 1]));
    if (!wordLetter(c) && !apos) break;
    if (wl < maxLen - 1) {
      if (c >= 'A' && c <= 'Z') c += 32;
      out[wl++] = c;
    }
    i++;
  }
  out[wl] = 0;
  return i;
}

// Scan the whole document; collect up to maxOut unique words that are missing
// from the dictionary, with occurrence counts. Single letters are skipped and
// possessives fall back to the base word. Returns the number collected, or -1
// if no dictionary is loaded.
int spellScan(String *words, int *counts, int maxOut) {
  if (!g_dict || g_dictOff.empty()) return -1;
  char w[32];
  int wl = 0, found = 0, pos = 0;
  while ((pos = docNextWord(pos, w, (int)sizeof(w), wl)) >= 0) {
    if (wl < 2) continue;
    bool ok = dictHas(w, wl);
    if (!ok && wl > 2 && w[wl - 2] == '\'' && w[wl - 1] == 's')
      ok = dictHas(w, wl - 2);                 // dog's -> dog
    if (ok) continue;
    int k = 0;
    for (; k < found; k++) if (words[k] == w) { counts[k]++; break; }
    if (k < found) continue;
    if (found < maxOut) { words[found] = w; counts[found] = 1; found++; }
  }
  return found;
}
// ==== SPELLCORE END ====

// =========================================================================
//  Paths & SD helpers (folder-aware)
// =========================================================================
// g_cwd always ends in '/'. fullPath("todo.txt") -> "/notes/todo.txt".
String fullPath(const String &base) { return g_cwd + base; }
String baseName(const String &path) {
  int s = path.lastIndexOf('/');
  return (s >= 0) ? path.substring(s + 1) : path;
}
// Path to hand SD.open for the current directory (no trailing '/' except root).
String dirOpenPath() {
  if (g_cwd == "/") return "/";
  String p = g_cwd;
  if (p.endsWith("/")) p.remove(p.length() - 1);
  return p;
}

// Rebuild the menu entry list for the current directory.
void buildEntries() {
  g_entries.clear();
  if (g_moveSrc.length()) {                    // move mode: drop / cancel on top
    g_entries.push_back({E_MOVEHERE, ""});
    g_entries.push_back({E_MOVECANCEL, ""});
  } else {
    if (g_cwd == "/" && g_lastFile.length() && SD.exists(g_lastFile.c_str()))
      g_entries.push_back({E_CONTINUE, ""});   // resume where you left off
    if (g_kbConnected) {                       // creating files needs keys to
      g_entries.push_back({E_NEWFILE, ""});    // type a name - don't show what
      g_entries.push_back({E_NEWDIR,  ""});    // can't be used
    }
  }
  if (g_cwd != "/") g_entries.push_back({E_UP, ""});

  std::vector<String> dirs, files;
  File root = SD.open(dirOpenPath().c_str());
  if (root) {
    for (File f = root.openNextFile(); f; f = root.openNextFile()) {
      String nm = baseName(String(f.name()));
      // Hide OS litter: dot-entries cover macOS's .DS_Store / ._AppleDouble /
      // .Spotlight-V100 / .Trashes etc. (and our own dot-files).
      if (nm.length() == 0 || nm[0] == '.') continue;
      if (f.isDirectory()) {
        if (nm == "System Volume Information") continue;   // Windows litter
        dirs.push_back(nm);
      } else {
        String low = nm; low.toLowerCase();
        if (g_cwd == "/" && ("/" + low) == DICT_PATH) continue;  // spell dict
        if (low.endsWith(".txt")) files.push_back(nm);
      }
    }
    root.close();
  }
  for (auto &d : dirs)  g_entries.push_back({E_DIR,  d});
  for (auto &f : files) g_entries.push_back({E_FILE, f});
}

// Write a run of buffer text as valid UTF-8: the buffer stores Latin-1 as
// single bytes (grid math), but files on disk must stay UTF-8, or the next
// load's decoder would drop the accented characters as malformed sequences.
static void writeUtf8Run(File &f, const char *p, int n) {
  uint8_t out[512];
  int m = 0;
  for (int i = 0; i < n; i++) {
    uint8_t c = (uint8_t)p[i];
    if (m >= (int)sizeof(out) - 2) { f.write(out, m); m = 0; }
    if (c < 0x80) { out[m++] = c; continue; }
    uint16_t cp = c;
    if (c >= 0x80 && c < 0x8C) {               // Esperanto slots -> real code points
      static const uint16_t eo[12] = {0x109,0x108,0x11D,0x11C,0x125,0x124,
                                      0x135,0x134,0x15D,0x15C,0x16D,0x16C};
      cp = eo[c - 0x80];
    }
    out[m++] = 0xC0 | (cp >> 6);
    out[m++] = 0x80 | (cp & 0x3F);
  }
  if (m) f.write(out, m);
}

bool saveFile() {
  if (filename.length() == 0) return false;
  File f = SD.open(filename.c_str(), FILE_WRITE, true);   // filename is a full path
  if (!f) return false;
  // The gap buffer is two contiguous runs of text - stream both out.
  if (doc.part1Len() > 0) writeUtf8Run(f, doc.part1(), doc.part1Len());
  if (doc.part2Len() > 0) writeUtf8Run(f, doc.part2(), doc.part2Len());
  f.close();
  modified = false;
  return true;
}

void loadDoc(const String &path) {
  filename = path;                                        // store the full path
  doc.clear();
  File f = SD.open(path.c_str(), FILE_READ);
  if (f) {
    doc.reserve((int)f.size() + 4096);
    // Strip CRs and fold UTF-8 typography to ASCII (see asciiFold). keep[] is
    // oversized because folding can expand (em-dash -> "--", etc.).
    char buf[512], keep[1024];
    Utf8Fold u8;
    while (f.available()) {
      int n = f.readBytes(buf, 512), m = 0;
      for (int i = 0; i < n; i++) {
        long cp = u8.feed((uint8_t)buf[i]);
        if (cp < 0 || cp == '\r') continue;              // pending / CRLF -> LF
        if (cp < 0x80) { keep[m++] = (char)cp; continue; }
        for (const char *r = asciiFold((uint32_t)cp); *r; r++) keep[m++] = *r;
      }
      doc.insert(doc.length(), keep, m);
      yield();                                           // feed the watchdog
    }
    f.close();
  }
  g_docWords = recountWords();
  undoClear();
  g_sessStartWords = g_docWords;               // baseline for the stats log
  cursorPos = 0; desiredCol = -1; modified = false; topLine = 0;
}

// Stream-copy src -> dst (rolling .bak backup taken when a file is opened).
bool copyFile(const String &src, const String &dst) {
  File in = SD.open(src.c_str(), FILE_READ);
  if (!in) return false;
  File out = SD.open(dst.c_str(), FILE_WRITE, true);
  if (!out) { in.close(); return false; }
  uint8_t buf[512];
  while (in.available()) {
    int n = in.read(buf, sizeof(buf));
    if (n <= 0) break;
    out.write(buf, n);
    yield();                                   // large backups: feed the watchdog
  }
  out.close(); in.close();
  return true;
}

// ---- resume-where-you-left-off (persisted in NVS) -------------------------
void loadResume() {
  g_prefs.begin("paper", true);
  g_lastFile = g_prefs.getString("lastfile", "");
  g_lastPos  = g_prefs.getInt("lastpos", 0);
  g_prefs.end();
}
void saveResume() {
  if (filename.length() == 0) return;          // unnamed buffers can't resume
  g_lastFile = filename; g_lastPos = cursorPos;
  g_prefs.begin("paper", false);
  g_prefs.putString("lastfile", g_lastFile);
  g_prefs.putInt("lastpos", g_lastPos);
  g_prefs.end();
}

// ---- session stats: append "YYYY-MM-DD,words" to /.ptstats.csv ------------
// (dot-file: invisible to the .txt-only menu and WiFi export listings)
void sessionEnd() {
  int delta = g_docWords - g_sessStartWords;
  g_sessStartWords = g_docWords;               // never double-log a session
  if (delta <= 0 || !g_rtcOk) return;
  auto dt = M5.Rtc.getDateTime();
  char line[40];
  snprintf(line, sizeof(line), "%04d-%02d-%02d,%d\n",
           (int)dt.date.year, (int)dt.date.month, (int)dt.date.date, delta);
  File f = SD.open("/.ptstats.csv", FILE_APPEND);
  if (f) { f.print(line); f.close(); }
}

// Can a file of this size be opened comfortably? The text costs ~1.5x its
// size in the gap buffer plus the line index and transients. Refusing here
// beats a hard out-of-memory abort (exceptions are off on this platform).
bool docFits(const String &path, uint32_t &szOut) {
  File f = SD.open(path.c_str(), FILE_READ);
  szOut = f ? (uint32_t)f.size() : 0;
  if (f) f.close();
  uint32_t need = szOut * 2 + szOut / 2 + 262144;
  uint32_t have = heap_caps_get_free_size(MALLOC_CAP_SPIRAM);
  if (have < 65536)                              // no PSRAM: internal only
    have = heap_caps_get_free_size(MALLOC_CAP_8BIT) / 2;
  return need < have;
}

// Full-screen message that any key or tap dismisses (borrows the help state).
void msgScreen(const String &l1, const String &l2) {
  applyRotation(false);
  M5.Display.setEpdMode(m5gfx::epd_quality);
  M5.Display.startWrite();
  M5.Display.fillScreen(TFT_WHITE);
  M5.Display.setTextColor(TFT_BLACK, TFT_WHITE);
  M5.Display.setTextDatum(m5gfx::top_left);
  M5.Display.setFont(&fonts::FreeMonoBold18pt7b);
  M5.Display.drawString("Hmm.", MARGIN_X, 24);
  M5.Display.setFont(&fonts::FreeMono12pt7b);
  M5.Display.drawString(l1, MARGIN_X, 110);
  M5.Display.drawString(l2, MARGIN_X, 150);
  M5.Display.setFont(&fonts::FreeMono9pt7b);
  M5.Display.drawString("Press any key or tap to go back.", MARGIN_X, H - 28);
  M5.Display.endWrite();
  g_state = ST_HELP;                             // any key / tap -> menu
}

// Open a file (full path) for editing: snapshot a .bak of it first (cheap
// insurance against a bad session - restore by renaming), and put the caret
// back where it was if this is the file we last worked on.
void openForEditing(const String &path) {
  uint32_t sz;
  if (!docFits(path, sz)) {
    msgScreen("\"" + baseName(path) + "\" is too large to open here",
              "(" + String(sz / 1024) + " KB - not enough free memory).");
    return;
  }
  copyFile(path, path + ".bak");
  loadDoc(path);
  if (path == g_lastFile && g_lastPos > 0 && g_lastPos <= (int)doc.length())
    cursorPos = g_lastPos;
  enterEditor();
}

void openFile(const String &name)       { openForEditing(fullPath(name)); }            // edit
void openForReading(const String &name) { readerOpen(fullPath(name), 0); }             // read

// 'j' in the menu: today's journal, /journal/YYYY-MM-DD.txt, caret at the end.
void openJournal() {
  if (!g_kbConnected) return;                  // writing needs a keyboard
  SD.mkdir("/journal");
  String path = "/journal/journal.txt";        // fallback if the RTC is dead
  if (g_rtcOk) {
    auto dt = M5.Rtc.getDateTime();
    char b[36];
    snprintf(b, sizeof(b), "/journal/%04d-%02d-%02d.txt",
             (int)dt.date.year, (int)dt.date.month, (int)dt.date.date);
    path = b;
  }
  copyFile(path, path + ".bak");               // no-op if it doesn't exist yet
  loadDoc(path);                               // empty buffer if it's new
  filename = path;                             // first save creates it
  cursorPos = doc.length();                    // append to the day
  enterEditor();
}

// Empty the buffer and everything tied to its contents (word count, undo).
// GapBuffer::clear also frees the PSRAM allocation.
void clearDoc() {
  doc.clear();
  g_docWords = 0;
  g_sessStartWords = 0;
  undoClear();
}

void newFile() {
  clearDoc();
  filename = ""; cursorPos = 0; desiredCol = -1; modified = false; topLine = 0;
  enterEditor();
}

void cdInto(const String &name) { g_cwd += name + "/"; g_sel = 0; menuTop = 0; buildEntries(); drawMenu(); }
void cdUp() {
  if (g_cwd == "/") return;
  String p = g_cwd;
  if (p.endsWith("/")) p.remove(p.length() - 1);
  int s = p.lastIndexOf('/');
  g_cwd = (s <= 0) ? String("/") : p.substring(0, s + 1);
  g_sel = 0; menuTop = 0; buildEntries(); drawMenu();
}

// Finish a move: rename the source into the folder being browsed. The .bak
// sidecar and the [ Continue ] pointer follow the file.
void moveDrop() {
  String dst = fullPath(baseName(g_moveSrc));
  if (dst == g_moveSrc) { gotoMenu(); return; }          // same folder: done
  if (SD.exists(dst.c_str())) {
    g_moveMsg = "A file with that name is already here - pick another folder. ESC = cancel";
    drawMenu();
    return;
  }
  if (!SD.rename(g_moveSrc.c_str(), dst.c_str())) {
    g_moveMsg = "Move failed - pick another folder. ESC = cancel";
    drawMenu();
    return;
  }
  if (SD.exists((g_moveSrc + ".bak").c_str()))
    SD.rename((g_moveSrc + ".bak").c_str(), (dst + ".bak").c_str());
  if (g_lastFile == g_moveSrc) {                         // [ Continue ] follows
    g_lastFile = dst;
    g_prefs.begin("paper", false);
    g_prefs.putString("lastfile", g_lastFile);
    g_prefs.end();
  }
  gotoMenu();                                            // clears the move state
}

// =========================================================================
//  Editor rendering
// =========================================================================
void readBattery() {
  // No fuel-gauge chip on this board: the percentage is derived from battery
  // VOLTAGE, so it reads ~20-30 points high while charging and sags under
  // load. Average a few samples to stop the number fluttering; the charging
  // inflation itself can't be fixed in firmware (the UI marks it with '~').
  long sum = 0; int n = 0;
  for (int i = 0; i < 4; i++) {
    int p = M5.Power.getBatteryLevel();       // 0..100, or <0 if unknown
    if (p >= 0) { sum += p; n++; }
  }
  int p = n ? (int)(sum / n) : -1;
  if (p > 100) p = 100;
  g_batPct = p;
  g_charging = (M5.Power.isCharging() == 1);
}

// Seed the BM8563 RTC from the build time the first time only (year unset).
// Afterward the battery-backed RTC keeps ticking on its own across resets.
void setupRtc() {
  g_rtcOk = M5.Rtc.isEnabled();
  if (!g_rtcOk) return;
  auto dt = M5.Rtc.getDateTime();
  if (dt.date.year < 2025) {
    static const char *mons = "JanFebMarAprMayJunJulAugSepOctNovDec";
    char ms[4] = {0};
    int d = 1, y = 2025, hh = 0, mm = 0, ss = 0;
    sscanf(__DATE__, "%3s %d %d", ms, &d, &y);
    sscanf(__TIME__, "%d:%d:%d", &hh, &mm, &ss);
    const char *p = strstr(mons, ms);
    int mon = p ? (int)((p - mons) / 3) + 1 : 1;
    m5::rtc_datetime_t set;
    set.date.year = y; set.date.month = mon; set.date.date = d; set.date.weekDay = 0;
    set.time.hours = hh; set.time.minutes = mm; set.time.seconds = ss;
    M5.Rtc.setDateTime(set);
  }
}

String clockStr() {
  auto dt = M5.Rtc.getDateTime();
  char buf[6];
  snprintf(buf, sizeof(buf), "%02d:%02d", (int)dt.time.hours, (int)dt.time.minutes);
  return String(buf);
}

// The live count is maintained incrementally by docReplace(); loads recount
// once via recountWords(). No full-document scan per keystroke.
int countWords() { return g_docWords; }

// Draws a battery glyph whose right edge (incl. terminal nub) sits at rightX.
void drawBattery(int rightX, int y) {
  const int w = 26, h = 13, nub = 3;
  int x = rightX - w - nub;
  M5.Display.drawRect(x, y, w, h, TFT_BLACK);
  M5.Display.fillRect(x + w, y + 4, nub, h - 8, TFT_BLACK);   // + terminal
  if (g_batPct >= 0) {
    int innerW = w - 4;
    int fw = innerW * g_batPct / 100;
    if (fw < 0) fw = 0;
    if (fw > innerW) fw = innerW;
    M5.Display.fillRect(x + 2, y + 2, fw, h - 4, TFT_BLACK);
  }
}

// Battery icon + percentage, right edge at rightX. Reads the gauge itself and
// returns the x coordinate just left of the cluster (for right-aligned text).
// Shared by the status bar and the main menu header.
int drawBatteryCluster(int rightX, int iconY, int textY) {
  readBattery();
  drawBattery(rightX, iconY);
  String pctS = (g_batPct >= 0 ? String(g_batPct) : String("--")) + "%";
  if (g_charging) pctS = "~" + pctS + "+";    // '~': voltage reads high on charge
  M5.Display.setFont(&fonts::FreeMono9pt7b);
  M5.Display.setTextColor(TFT_BLACK, TFT_WHITE);
  M5.Display.setTextDatum(m5gfx::top_right);
  int pctRight = rightX - 26 - 3 - 8;              // just left of the icon
  M5.Display.drawString(pctS, pctRight, textY);
  M5.Display.setTextDatum(m5gfx::top_left);
  return pctRight - M5.Display.textWidth(pctS);
}

// Standard modal dialog frame: white fill, double border, bold title.
// Returns the top-left corner via bx/by; callers add their content below.
void modalFrame(int bw, int bh, const char *title, int &bx, int &by) {
  bx = (W - bw) / 2; by = (H - bh) / 2;
  M5.Display.fillRect(bx, by, bw, bh, TFT_WHITE);
  M5.Display.drawRect(bx, by, bw, bh, TFT_BLACK);
  M5.Display.drawRect(bx + 1, by + 1, bw - 2, bh - 2, TFT_BLACK);
  M5.Display.setTextColor(TFT_BLACK, TFT_WHITE);
  M5.Display.setTextDatum(m5gfx::top_left);
  M5.Display.setFont(&fonts::FreeMonoBold18pt7b);
  M5.Display.drawString(title, bx + 30, by + 22);
}

// A modal selection list (frame + highlighted rows). Geometry is recorded so
// tap handlers can map a touch back to a row - every dialog stays operable by
// touch alone, in case the only keyboard just went to sleep.
int g_mlX = 0, g_mlY = 0, g_mlW = 0, g_mlH = 0;       // frame
int g_mlListY = 0, g_mlItemH = 0, g_mlCount = 0;      // rows
String (*g_mlLabelFn)(int) = nullptr;                 // for selection moves

void drawModalRow(int i, bool sel) {
  int y = g_mlListY + i * g_mlItemH;
  M5.Display.setFont(&fonts::FreeMono12pt7b);
  M5.Display.setTextDatum(m5gfx::top_left);
  M5.Display.fillRect(g_mlX + 16, y - 4, g_mlW - 32, g_mlItemH,
                      sel ? TFT_BLACK : TFT_WHITE);
  M5.Display.setTextColor(sel ? TFT_WHITE : TFT_BLACK, sel ? TFT_BLACK : TFT_WHITE);
  M5.Display.drawString(g_mlLabelFn(i), g_mlX + 30, y);
  M5.Display.setTextColor(TFT_BLACK, TFT_WHITE);
}

// Arrow moves inside a modal list: repaint just the two rows, no flash.
void modalListMoveSel(int from, int to) {
  if (!g_mlLabelFn || from == to || to < 0 || to >= g_mlCount) return;
  M5.Display.setEpdMode(m5gfx::epd_fast);
  M5.Display.startWrite();
  drawModalRow(from, false);
  drawModalRow(to, true);
  M5.Display.endWrite();
}

void drawModalList(const char *title, int bw, int bh, String (*label)(int), int count, int sel) {
  M5.Display.setEpdMode(m5gfx::epd_quality);
  M5.Display.startWrite();
  int bx, by;
  modalFrame(bw, bh, title, bx, by);
  M5.Display.setFont(&fonts::FreeMono12pt7b);
  g_mlX = bx; g_mlY = by; g_mlW = bw; g_mlH = bh;
  g_mlListY = by + 84;
  g_mlItemH = M5.Display.fontHeight() + 16;
  g_mlCount = count;
  g_mlLabelFn = label;
  for (int i = 0; i < count; i++) drawModalRow(i, i == sel);
  M5.Display.endWrite();
}

// Map a tap to a list row: -1 = outside the dialog, -2 = inside but no row.
int modalListHit(int x, int y) {
  if (x < g_mlX || x > g_mlX + g_mlW || y < g_mlY || y > g_mlY + g_mlH) return -1;
  int r = (y - (g_mlListY - 4)) / g_mlItemH;
  if (y < g_mlListY - 4 || r < 0 || r >= g_mlCount) return -2;
  return r;
}

void drawStatusBar() {
  M5.Display.fillRect(0, 0, W, statusH, TFT_WHITE);
  M5.Display.drawFastHLine(0, statusH - 1, W, TFT_BLACK);
  M5.Display.setFont(&fonts::FreeMono9pt7b);
  M5.Display.setTextColor(TFT_BLACK, TFT_WHITE);
  int ty = 5;
  int iconY = (statusH - 13) / 2; if (iconY < 0) iconY = 0;

  // left: filename + unsaved marker (+ goal progress + focus flag)
  M5.Display.setTextDatum(m5gfx::top_left);
  String left = (filename.length() ? baseName(filename) : String("[new]"));
  if (modified) left += " *";
  if (g_goalMode == 1) {                       // sprint: minutes remaining
    long rem = (long)g_goalTarget * 60000L - (long)(millis() - g_goalStartMs);
    if (rem < 0) rem = 0;
    left += " [" + String((int)((rem + 59999L) / 60000L)) + "m left]";
  } else if (g_goalMode == 2) {                // word goal: progress
    int got = g_docWords - g_goalStartWords;
    if (got < 0) got = 0;
    left += " [" + String(got) + "/" + String(g_goalTarget) + "w]";
  }
  if (g_focus) left += " [focus]";
  M5.Display.drawString(left, MARGIN_X, ty);

  // right cluster (right-aligned):  hints ... pct% ... [icon]
  // No live word/char count here: keeping it off the bar means the bar only
  // redraws when the "*" flips or on the 20 s tick, so a keystroke's e-ink
  // refresh stays confined to the line being typed. Ctrl+W shows the counts.
  int hintsRight = drawBatteryCluster(W - MARGIN_X, iconY, ty) - 14;
  String hints;
  if (g_rtcOk) hints = clockStr() + "   ";
  int pgT = ((int)g_lines.size() + g_rows - 1) / g_rows;
  if (pgT < 1) pgT = 1;
  hints += "p." + String(g_caretRow / g_rows + 1) + "/" + String(pgT) +
           "   Ctrl+W count   ESC menu";
  M5.Display.setTextDatum(m5gfx::top_right);
  M5.Display.drawString(hints, hintsRight, ty);
  M5.Display.setTextDatum(m5gfx::top_left);
}

void refreshStatusBar() {
  M5.Display.setEpdMode(m5gfx::epd_fast);
  M5.Display.startWrite();
  drawStatusBar();
  M5.Display.endWrite();
}

void drawCaret(int screenRow, int col) {
  int x = textX + col * charW;
  int y = textY + screenRow * lineH;
  M5.Display.fillRect(x, y, 2, lineH - 4, TFT_BLACK);
}

// Composition feedback: while a dead key is pending, the caret cell shows the
// accent inverted (like macOS's highlighted accent). Called again after the
// pending state clears to restore a plain caret.
void drawPendingAccent() {
  int r = g_caretRow - topLine;
  if (r < 0 || r >= g_rows) return;
  int x = textX + g_caretCol * charW, y = textY + r * lineH;
  M5.Display.setEpdMode(m5gfx::epd_fast);
  M5.Display.startWrite();
  if (g_pendingDead) {
    char m;
    switch (g_pendingDead) {
      case 'u': m = (char)0xA8; break;   // diaeresis
      case 'e': m = (char)0xB4; break;   // acute
      case 'i': m = '^';        break;   // circumflex (incl. Esperanto)
      case 'n': m = '~';        break;   // tilde
      case 'b': m = 'b';        break;   // breve (no standalone glyph)
      default:  m = '`';        break;   // grave
    }
    M5.Display.fillRect(x, y, charW, lineH - 4, TFT_BLACK);
    M5.Display.setFont(bodyFont());
    M5.Display.setTextColor(TFT_WHITE, TFT_BLACK);
    M5.Display.setTextDatum(m5gfx::top_left);
    M5.Display.drawString(drawable(String(m)), x, y);
    M5.Display.setTextColor(TFT_BLACK, TFT_WHITE);
  } else {
    M5.Display.fillRect(x, y, charW, lineH - 4, TFT_WHITE);
    drawCaret(r, g_caretCol);
  }
  M5.Display.endWrite();
}

void renderEditor(bool full) {
  M5.Display.setFont(bodyFont());
  M5.Display.setTextColor(TFT_BLACK, TFT_WHITE);
  M5.Display.setTextDatum(m5gfx::top_left);

  bool scrolled = (topLine != prevTopLine);

  if (full || scrolled) {
    if (needDeghost) { M5.Display.setEpdMode(m5gfx::epd_quality); needDeghost = false; partialCount = 0; }
    else             { M5.Display.setEpdMode(m5gfx::epd_fast); }

    M5.Display.startWrite();
    // Fill from statusH, not textY: the few pixel rows between the bar and
    // the text area otherwise keep fragments of whatever screen came before
    // (ghost battery icons, menu row bottoms - see the seam artifacts).
    M5.Display.fillRect(0, statusH, W, H - statusH, TFT_WHITE);
    drawStatusBar();
    M5.Display.setFont(bodyFont());
    M5.Display.setTextColor(TFT_BLACK, TFT_WHITE);
    M5.Display.setTextDatum(m5gfx::top_left);
    for (int r = 0; r < g_rows; r++) {
      int idx = topLine + r;
      String content = (idx < (int)g_lines.size()) ? lineStr(idx) : String();
      if (idx < (int)g_lines.size()) M5.Display.drawString(drawable(content), textX, textY + r * lineH);
      if (idx == g_caretRow) drawCaret(r, g_caretCol);
      prevVisible[r] = content;
    }
    M5.Display.endWrite();
    prevTopLine = topLine; prevCaretRow = g_caretRow;
    prevModified = modified;
    return;
  }

  // ---- incremental: only redraw rows whose text or caret changed ----
  M5.Display.setEpdMode(m5gfx::epd_fast);
  M5.Display.startWrite();
  if (prevModified != modified) {              // only the "*" marker needs the bar
    drawStatusBar();
    prevModified = modified;
    M5.Display.setFont(bodyFont());
    M5.Display.setTextColor(TFT_BLACK, TFT_WHITE);
    M5.Display.setTextDatum(m5gfx::top_left);
  }
  int prevCaretScreen = prevCaretRow - topLine;
  int caretScreen     = g_caretRow  - topLine;

  // Fast path: characters were APPENDED at the end of the caret row and no
  // other row changed - the overwhelmingly common case while typing. Repaint
  // only the new cells (a couple of character widths of e-ink) instead of a
  // full-width line stripe. Deletions and mid-line edits shift the tail of
  // the line, so they fall through to the per-line repaint below.
  if (caretScreen == prevCaretScreen && caretScreen >= 0 && caretScreen < g_rows) {
    int idx = topLine + caretScreen;
    String content = (idx < (int)g_lines.size()) ? lineStr(idx) : String();
    const String &prev = prevVisible[caretScreen];
    bool append = (int)content.length() > (int)prev.length() &&
                  g_caretCol == (int)content.length() &&
                  content.startsWith(prev);
    for (int r = 0; append && r < g_rows; r++) {
      if (r == caretScreen) continue;
      int i2 = topLine + r;
      String c2 = (i2 < (int)g_lines.size()) ? lineStr(i2) : String();
      if (c2 != prevVisible[r]) append = false;
    }
    if (append) {
      int oldLen = prev.length();
      int x0 = textX + oldLen * charW;
      int y  = textY + caretScreen * lineH;
      M5.Display.fillRect(x0, y, ((int)content.length() - oldLen) * charW + 4, lineH, TFT_WHITE);
      M5.Display.drawString(drawable(content.substring(oldLen)), x0, y);
      drawCaret(caretScreen, g_caretCol);
      prevVisible[caretScreen] = content;
      M5.Display.endWrite();
      prevCaretRow = g_caretRow;
      if (++partialCount >= DEGHOST_EVERY) { needDeghost = true; renderEditor(true); }
      return;
    }
  }

  for (int r = 0; r < g_rows; r++) {
    int idx = topLine + r;
    String content = (idx < (int)g_lines.size()) ? lineStr(idx) : String();
    bool dirty = (content != prevVisible[r]) || (r == prevCaretScreen) || (r == caretScreen);
    if (dirty) {
      M5.Display.fillRect(textX, textY + r * lineH, W - textX, lineH, TFT_WHITE);
      if (idx < (int)g_lines.size()) M5.Display.drawString(drawable(content), textX, textY + r * lineH);
      if (idx == g_caretRow) drawCaret(r, g_caretCol);
      prevVisible[r] = content;
    }
  }
  M5.Display.endWrite();
  prevCaretRow = g_caretRow;

  if (++partialCount >= DEGHOST_EVERY) { needDeghost = true; renderEditor(true); }
}

void ensureVisible() {
  if (g_caretRow < topLine)            topLine = g_caretRow;
  if (g_caretRow >= topLine + g_rows)  topLine = g_caretRow - g_rows + 1;
  if (topLine < 0) topLine = 0;
}

void enterEditor() {
  g_state = ST_EDIT;
  M5.Display.setFont(bodyFont());
  layout();
  caretRowCol(cursorPos, g_caretRow, g_caretCol);
  ensureVisible();
  needDeghost = true;
  prevTopLine = -1;
  prevVisible.assign(g_rows, String("\x01"));
  renderEditor(true);
}

void resumeEditor() {
  g_state = ST_EDIT;
  needDeghost = true;
  prevTopLine = -1;
  prevVisible.assign(g_rows, String("\x01"));
  layout();
  caretRowCol(cursorPos, g_caretRow, g_caretCol);
  ensureVisible();
  renderEditor(true);
}

// recompute caret + scroll + draw after an edit or cursor move
int g_edPage = 1;                    // page shown in the status bar
void afterChange(bool relayout) {
  if (relayout) layout();
  caretRowCol(cursorPos, g_caretRow, g_caretCol);
  ensureVisible();
  renderEditor(false);
  int pg = g_caretRow / g_rows + 1;  // refresh the bar's page counter on change
  if (pg != g_edPage) { g_edPage = pg; refreshStatusBar(); }
}

// =========================================================================
//  Editing operations
// =========================================================================
// Auto-save when a paragraph ends (Enter), at most once per NL_SAVE_MS so a
// large file doesn't stall on every keystroke. Named files only.
const unsigned long NL_SAVE_MS = 5000;   // 0 disables newline auto-save
unsigned long g_lastNlSave = 0;
void newlineAutosave() {
  if (NL_SAVE_MS == 0 || filename.length() == 0 || !modified) return;
  if (millis() - g_lastNlSave < NL_SAVE_MS) return;
  g_lastNlSave = millis();
  saveFile();
  renderEditor(false);                   // clear the unsaved "*"
}

void insertStr(const String &s) {
  // docReplace updates the buffer, word count and line wrap in one pass;
  // the layout work is already done, so afterChange must not re-layout.
  cursorPos += docReplace(cursorPos, 0, s.c_str(), (int)s.length());
  modified = true; desiredCol = -1;
  afterChange(false);
}
void insertChar(char c) { insertStr(String(c)); }

void deleteBack() {
  if (cursorPos <= 0) return;
  docReplace(cursorPos - 1, 1, nullptr, 0);
  cursorPos--; modified = true; desiredCol = -1;
  afterChange(false);
}
void deleteForward() {
  if (cursorPos >= (int)doc.length()) return;
  docReplace(cursorPos, 1, nullptr, 0);
  modified = true; desiredCol = -1;
  afterChange(false);
}

// Word-wise deletes (Shift/Ctrl + Backspace/Delete). Each is a single
// docReplace, so one Ctrl+Z brings the whole word back.
void deleteWordBack() {
  int p = wordLeftPos(cursorPos);
  if (p >= cursorPos) return;
  docReplace(p, cursorPos - p, nullptr, 0);
  cursorPos = p; modified = true; desiredCol = -1;
  afterChange(false);
}
void deleteWordForward() {
  int e = wordRightPos(cursorPos);
  if (e <= cursorPos) return;
  docReplace(cursorPos, e - cursorPos, nullptr, 0);
  modified = true; desiredCol = -1;
  afterChange(false);
}
void moveLeft()  { if (cursorPos > 0) cursorPos--; desiredCol = -1; afterChange(false); }
void moveRight() { if (cursorPos < (int)doc.length()) cursorPos++; desiredCol = -1; afterChange(false); }
void moveUp() {
  int row, col; caretRowCol(cursorPos, row, col);
  if (desiredCol < 0) desiredCol = col;
  if (row > 0) cursorPos = posFromRowCol(row - 1, desiredCol);
  else { cursorPos = 0; desiredCol = -1; }               // top line: its start
  afterChange(false);
}
void moveDown() {
  int row, col; caretRowCol(cursorPos, row, col);
  if (desiredCol < 0) desiredCol = col;
  if (row < (int)g_lines.size() - 1) cursorPos = posFromRowCol(row + 1, desiredCol);
  else {                                                 // bottom line: its end
    cursorPos = g_lines[row].start + g_lines[row].len;
    desiredCol = -1;
  }
  afterChange(false);
}
void moveHome() { int row, col; caretRowCol(cursorPos, row, col); cursorPos = g_lines[row].start; desiredCol = -1; afterChange(false); }
void moveEnd()  { int row, col; caretRowCol(cursorPos, row, col); cursorPos = g_lines[row].start + g_lines[row].len; desiredCol = -1; afterChange(false); }

void handleEditKey(uint8_t ascii, uint8_t keycode, uint8_t modifier) {
  // Ctrl = either Ctrl bit OR either GUI (Cmd/Win) bit: keyboards with a
  // Mac/Windows switch send Cmd from the ctrl position in Mac mode, and
  // there's no operating system here to claim Cmd for itself.
  bool ctrl = (modifier & (0x11 | 0x88)) != 0;
  bool alt  = (modifier & 0x44) != 0;          // Option / Alt

  // macOS-style composition (needs the Latin-1 fonts to display the result).
  if (g_pendingDead && !ctrl) {                // second key of a composition
    char dk = g_pendingDead;
    g_pendingDead = 0;
    if (!alt && ascii >= 32 && ascii < 127) {
      uint8_t o = composeChar(dk, (char)ascii);
      if (o) { insertChar((char)o); return; }  // the insert repaints the cell
    }
    drawPendingAccent();                       // clear the accent marker...
    // ...then fall through: the key acts normally
  }
  if (alt && !ctrl && g_keepLatin1 && ascii >= 32 && ascii < 127) {
    if (composeDead((char)ascii)) {
      g_pendingDead = (char)ascii;
      drawPendingAccent();                     // show the waiting accent
      return;
    }
    uint8_t o = optionChar((char)ascii);
    if (o) insertChar((char)o);
    return;                                    // unknown Option combo: swallow
  }
  // Shortcuts are layout-aware: kl is the letter this key TYPES (so Ctrl+W
  // is w-as-typed on Dvorak/Colemak, not the physical QWERTY position).
  char kl = keyLetter(keycode);
  if (ctrl && kl == 's') {                     // Ctrl+S quick save
    if (filename.length() == 0) enterPrompt(PM_SAVENEW, 0, "");
    else { saveFile(); renderEditor(false); }
    return;
  }
  if (ctrl && kl == 'w') { enterCount(); return; }         // Ctrl+W word count
  if (ctrl && kl == 'z') {                     // Ctrl+Z undo
    int p = undoLast();
    if (p >= 0) {
      if (p > (int)doc.length()) p = doc.length();
      cursorPos = p; modified = true; desiredCol = -1;
      afterChange(false);
    }
    return;
  }
  if (ctrl && kl == 'g') { enterGoal(); return; }          // Ctrl+G goal / sprint
  if (ctrl && kl == 'k') { enterSpell(); return; }         // Ctrl+K spell check
  if (ctrl && kl == 'p') {                     // Ctrl+P: go to page
    enterPrompt(PM_GOPAGE, 0, "");
    return;
  }
  if (ctrl && kl == 'f' && !g_focus) {                     // Ctrl+F find
    enterPrompt(PM_SEARCH, 0, g_searchTerm);
    return;
  }
  // Focus mode: draft forward only - no cursor movement, no forward delete.
  if (g_focus) {
    switch (keycode) {
      case KC_LEFT: case KC_RIGHT: case KC_UP: case KC_DOWN:
      case KC_HOME: case KC_END: case KC_DELETE: case KC_PGUP: case KC_PGDN:
        return;
    }
  }
  if (ctrl && keycode == KC_HOME) { cursorPos = 0;            desiredCol = -1; afterChange(false); return; }
  if (ctrl && keycode == KC_END)  { cursorPos = doc.length(); desiredCol = -1; afterChange(false); return; }
  // Ctrl+A / Ctrl+E: start / end of the current paragraph (macOS/emacs style)
  if (ctrl && kl == 'a') {
    while (cursorPos > 0 && doc[cursorPos - 1] != '\n') cursorPos--;
    desiredCol = -1; afterChange(false); return;
  }
  if (ctrl && kl == 'e') {
    int n = doc.length();
    while (cursorPos < n && doc[cursorPos] != '\n') cursorPos++;
    desiredCol = -1; afterChange(false); return;
  }
  // Word-wise: Shift (or Ctrl) + arrows jump a word; + Backspace/Delete
  // remove a word. (Focus mode already filtered the movement keys above.)
  bool wordMod = ((modifier & 0x22) != 0) || ctrl;   // any shift, or ctrl
  if (wordMod && keycode == KC_LEFT)   { cursorPos = wordLeftPos(cursorPos);  desiredCol = -1; afterChange(false); return; }
  if (wordMod && keycode == KC_RIGHT)  { cursorPos = wordRightPos(cursorPos); desiredCol = -1; afterChange(false); return; }
  if (wordMod && keycode == KC_BKSP)   { deleteWordBack();    return; }
  if (wordMod && keycode == KC_DELETE) { deleteWordForward(); return; }
  switch (keycode) {
    case KC_ESC:    enterEditMenu();  return;
    case KC_LEFT:   moveLeft();       return;
    case KC_RIGHT:  moveRight();      return;
    case KC_UP:     moveUp();         return;
    case KC_DOWN:   moveDown();       return;
    case KC_HOME:   moveHome();       return;
    case KC_END:    moveEnd();        return;
    case KC_PGUP: case KC_PGDN: {                // move a full screen of text
      int row, col;
      caretRowCol(cursorPos, row, col);
      if (desiredCol < 0) desiredCol = col;
      cursorPos = posFromRowCol(row + (keycode == KC_PGDN ? g_rows : -g_rows), desiredCol);
      afterChange(false);
      return;
    }
    case KC_DELETE: deleteForward();  return;
    case KC_BKSP:   deleteBack();     return;
    case KC_TAB:    insertStr("  ");  return;
    case KC_ENTER:  insertChar('\n'); newlineAutosave(); return;
  }
  if (ascii == 8)  { deleteBack(); return; }                 // backspace (if ascii-coded)
  if (ascii == 9)  { insertStr("  "); return; }              // tab -> 2 spaces
  if (ascii == 10 || ascii == 13) { insertChar('\n'); newlineAutosave(); return; }
  if (ascii >= 32 && ascii < 127)  { insertChar((char)ascii); return; }
}

// =========================================================================
//  Main menu (folder browser)
// =========================================================================
String entryLabel(const MenuEntry &e) {
  switch (e.type) {
    case E_MOVEHERE:   return "[ Move \"" + baseName(g_moveSrc) + "\" here ]";
    case E_MOVECANCEL: return String("[ Cancel move ]");
    case E_CONTINUE: return "[ Continue: " + baseName(g_lastFile) + " ]";
    case E_NEWFILE: return String("[ New file ]");
    case E_NEWDIR:  return String("[ New folder ]");
    case E_UP:      return String("../  (up one folder)");
    case E_DIR:     return e.name + "/";       // drawn bold - see drawMenuRow
    case E_FILE:    return e.name;
  }
  return String();
}

// One list row (used by the full draw and by selection moves). Fills its own
// background so it can repaint over a previously selected (black) row.
void drawMenuRow(int idx, bool sel) {
  int r = idx - menuTop;
  if (r < 0 || r >= g_mVisible || idx >= (int)g_entries.size()) return;
  int y = g_mListTop + r * g_mItemH;
  // Folders are bold (same monospace metrics), files regular - a clearer
  // distinction than a prefix character.
  EntryType t = g_entries[idx].type;
  bool boldRow = (t == E_DIR || t == E_UP);
  M5.Display.setFont(boldRow ? &fonts::FreeMonoBold12pt7b : &fonts::FreeMono12pt7b);
  M5.Display.setTextDatum(m5gfx::top_left);
  M5.Display.fillRect(MARGIN_X - 6, y - 2, W - 2 * MARGIN_X + 12, g_mItemH,
                      sel ? TFT_BLACK : TFT_WHITE);
  M5.Display.setTextColor(sel ? TFT_WHITE : TFT_BLACK, sel ? TFT_BLACK : TFT_WHITE);
  M5.Display.drawString(entryLabel(g_entries[idx]), MARGIN_X, y);
  M5.Display.setTextColor(TFT_BLACK, TFT_WHITE);
}

bool g_menuFastOnce = false;   // next full drawMenu may use epd_fast (paging)
int  g_menuFastCount = 0;      // fast menu updates since the last clean draw

// ---- button rows: labels, drawing, keyboard focus, activation -------------
int g_btnSel = -1;             // -1 = focus in the list; 0..4 row 1, 5..9 row 2

String menuBtnLabel(int row, int i) {
  if (row == 1) switch (i) {
    case 0: return String("Layout: ") + LAYOUT_NAMES[g_layout];
    case 1: return ENABLE_BLE_KEYBOARD ? String("BT: ") + bleStatusStr() : String("");
    case 2: return String("Font size: ") +
                   ((g_fontSize == 0) ? "S" : (g_fontSize == 2) ? "L" : "M");
    case 3: return String("WiFi export");
    case 4: return String("Stats");
  } else switch (i) {
    case 0: return ENABLE_USB_DRIVE ? String("USB drive") : String("");
    case 1: return String("Cloud sync");
    case 2: return String("Sleep");
    case 3: return String("Help");
    case 4: return g_portrait ? String("Read: portrait") : String("Read: wide");
  }
  return String();
}

// Inverted = keyboard focus, or the moment it's pressed (tap or Enter) - the
// "pushed" look stays up while a slow action (WiFi, sync...) gets going.
void drawMenuBtn(int row, int i, bool inv) {
  String lbl = menuBtnLabel(row, i);
  if (!lbl.length()) return;                   // slot compiled out
  int x = g_mBtnX[i], y = (row == 1) ? g_mBtnY : g_mBtn2Y;
  M5.Display.setFont(&fonts::FreeMono9pt7b);
  M5.Display.setTextDatum(m5gfx::top_left);
  M5.Display.fillRect(x, y, g_mBtnW, g_mBtnH, inv ? TFT_BLACK : TFT_WHITE);
  M5.Display.drawRect(x, y, g_mBtnW, g_mBtnH, TFT_BLACK);
  M5.Display.setTextColor(inv ? TFT_WHITE : TFT_BLACK, inv ? TFT_BLACK : TFT_WHITE);
  M5.Display.drawString(lbl, x + 8, y + 8);
  M5.Display.setTextColor(TFT_BLACK, TFT_WHITE);
}

bool menuBtnValid(int b) {
  if (b < 0 || b >= 2 * MB_COUNT) return false;
  return menuBtnLabel(b < MB_COUNT ? 1 : 2, b % MB_COUNT).length() > 0;
}

void menuBtnPaint(int b, bool inv) {
  if (b >= 0) drawMenuBtn(b < MB_COUNT ? 1 : 2, b % MB_COUNT, inv);
}

// Move keyboard focus between the list and a button (fast, no flash).
void menuBtnFocus(int b) {
  int old = g_btnSel;
  g_btnSel = b;
  M5.Display.setEpdMode(m5gfx::epd_fast);
  M5.Display.startWrite();
  menuBtnPaint(old, false);
  menuBtnPaint(b, true);
  drawMenuRow(g_sel, b < 0);                   // list highlight follows focus
  M5.Display.endWrite();
}

void menuBtnMove(int dx, int dy) {
  int col = g_btnSel % MB_COUNT;
  bool top = g_btnSel < MB_COUNT;
  if (dy != 0) {
    if (dy > 0 && !top) { menuBtnFocus(-1); return; }   // down into the list
    if (dy < 0 && top) return;                          // already on the top row
    int base = top ? MB_COUNT : 0, nb = -1;             // the other row, same-ish column
    for (int off = 0; off < MB_COUNT && nb < 0; off++) {
      if (col - off >= 0 && menuBtnValid(base + col - off)) nb = base + col - off;
      else if (col + off < MB_COUNT && menuBtnValid(base + col + off)) nb = base + col + off;
    }
    if (nb >= 0) menuBtnFocus(nb);
    return;
  }
  int lo = top ? 0 : MB_COUNT, hi = lo + MB_COUNT - 1, nb = g_btnSel + dx;
  while (nb >= lo && nb <= hi && !menuBtnValid(nb)) nb += dx;
  if (nb >= lo && nb <= hi) menuBtnFocus(nb);
}

// Press a button: show it pushed at once, then run the action. Toggles redraw
// the (updated) menu themselves; screen-changing actions replace the view.
void menuBtnActivate(int b) {
  if (!menuBtnValid(b)) return;
  M5.Display.setEpdMode(m5gfx::epd_fast);
  M5.Display.startWrite();
  menuBtnPaint(b, true);
  M5.Display.endWrite();
  int i = b % MB_COUNT;
  if (b < MB_COUNT) switch (i) {
    case 0: g_menuFastOnce = true; toggleLayout(); break;
    case 1: if (ENABLE_BLE_KEYBOARD) enterBtPair(); break;
    case 2: g_menuFastOnce = true; toggleFont(); break;
    case 3: enterExport(); break;
    case 4: enterStats(); break;
  } else switch (i) {
    case 0: if (ENABLE_USB_DRIVE) enterUsbDrive(); break;
    case 1: enterSync(); break;
    case 2: goStandby(); break;
    case 3: enterHelp(); break;
    case 4: g_menuFastOnce = true; toggleReaderRot(); break;
  }
}

// Move the selection: same page = repaint just the two affected rows in fast
// mode (no flash); crossing a page boundary = full redraw, also fast.
void menuMoveSel(int to) {
  if (to < 0 || to >= (int)g_entries.size() || to == g_sel) return;
  int from = g_sel;
  g_sel = to;
  if (++g_menuFastCount >= MENU_QUALITY_EVERY) {         // periodic clean draw
    g_menuFastCount = 0;
    drawMenu();
    return;
  }
  if (to < menuTop || to >= menuTop + g_mVisible) {      // page flip
    g_menuFastOnce = true;
    drawMenu();
    return;
  }
  M5.Display.setEpdMode(m5gfx::epd_fast);
  M5.Display.startWrite();
  drawMenuRow(from, false);
  drawMenuRow(to, true);
  M5.Display.endWrite();
}

void drawMenu() {
  g_state = ST_MENU;
  M5.Display.setEpdMode(g_menuFastOnce ? m5gfx::epd_fast : m5gfx::epd_quality);
  g_menuFastOnce = false;
  M5.Display.startWrite();
  M5.Display.fillScreen(TFT_WHITE);
  M5.Display.setTextColor(TFT_BLACK, TFT_WHITE);
  M5.Display.setTextDatum(m5gfx::top_left);

  M5.Display.setFont(&fonts::FreeMonoBold18pt7b);
  M5.Display.drawString("BYOBYOK", MARGIN_X, 16);

  // battery indicator (top-right)
  drawBatteryCluster(W - MARGIN_X, 18, 17);

  // current folder + hint (move mode gets its own banner)
  M5.Display.drawString(String("Folder: ") + g_cwd, MARGIN_X, 52);
  if (g_moveSrc.length())
    M5.Display.drawString(g_moveMsg.length() ? g_moveMsg
                            : "Moving \"" + baseName(g_moveSrc) +
                              "\": open the target folder, then [ Move here ]. ESC = cancel",
                          MARGIN_X, 70);
  else if (g_kbConnected)
    M5.Display.drawString("Up/Dn + Enter, or tap.  r rename   m move   Del delete   j journal   ? help",
                          MARGIN_X, 70);
  else
    M5.Display.drawString("Reader mode - tap to open folders / read files.",
                          MARGIN_X, 70);

  // two button rows (tappable, and arrow-navigable from the top of the list)
  g_mBtnY = 88; g_mBtn2Y = 124; g_mBtnH = 30;
  for (int i = 0; i < MB_COUNT; i++) {
    g_mBtnX[i] = MARGIN_X + i * (g_mBtnW + 12);
    drawMenuBtn(1, i, g_btnSel == i);
    drawMenuBtn(2, i, g_btnSel == MB_COUNT + i);
  }

  // list
  M5.Display.setFont(&fonts::FreeMono12pt7b);
  g_mItemH   = M5.Display.fontHeight() + 8;
  g_mListTop = 164;                            // below both button rows
  int footerH = 44;
  int total   = (int)g_entries.size();
  g_mVisible  = (H - g_mListTop - footerH - 6) / g_mItemH;
  if (g_mVisible < 1) g_mVisible = 1;
  g_mScrollable = total > g_mVisible;
  g_mFooterY = H - footerH;

  if (g_sel < menuTop)                menuTop = g_sel;
  if (g_sel >= menuTop + g_mVisible)  menuTop = g_sel - g_mVisible + 1;
  if (menuTop < 0) menuTop = 0;

  for (int r = 0; r < g_mVisible && (menuTop + r) < total; r++)
    drawMenuRow(menuTop + r, (menuTop + r) == g_sel && g_btnSel < 0);

  // touch paging footer (only when the list overflows one screen)
  if (g_mScrollable) {
    M5.Display.drawFastHLine(0, g_mFooterY, W, TFT_BLACK);
    M5.Display.drawFastVLine(W / 2, g_mFooterY, footerH, TFT_BLACK);
    M5.Display.setFont(&fonts::FreeMono12pt7b);
    M5.Display.setTextColor(TFT_BLACK, TFT_WHITE);
    M5.Display.setTextDatum(m5gfx::middle_center);
    M5.Display.drawString("< Prev", W / 4,     g_mFooterY + footerH / 2);
    M5.Display.drawString("Next >", W * 3 / 4, g_mFooterY + footerH / 2);
    M5.Display.setTextDatum(m5gfx::top_left);
  }
  M5.Display.endWrite();
}

void toggleLayout();   // defined with the persistence helpers

// Do the action for a menu entry. edit=true (keyboard Enter) opens files in the
// editor; edit=false (touch) opens them in the reader.
void activate(int idx, bool edit) {
  if (idx < 0 || idx >= (int)g_entries.size()) return;
  const MenuEntry e = g_entries[idx];
  switch (e.type) {
    case E_MOVEHERE:   moveDrop(); break;
    case E_MOVECANCEL: gotoMenu(); break;      // gotoMenu clears the move state
    case E_CONTINUE:
      if (edit && g_kbConnected) openForEditing(g_lastFile);
      else readerOpen(g_lastFile, g_lastPos);   // touch = read at reading place
      break;
    case E_NEWFILE: if (g_kbConnected) newFile();                      else drawMenu(); break;
    case E_NEWDIR:  if (g_kbConnected) enterPrompt(PM_NEWDIR, 0, "");  else drawMenu(); break;
    case E_UP:      cdUp();          break;
    case E_DIR:     cdInto(e.name);  break;
    case E_FILE:    if (g_moveSrc.length()) break;               // just context
                    if (edit) openFile(e.name); else openForReading(e.name); break;
  }
}

// Touch in the menu: layout button, footer paging, then a row.
void menuTap(int x, int y) {
  int row = 0;
  if (y >= g_mBtnY && y <= g_mBtnY + g_mBtnH) row = 1;
  else if (y >= g_mBtn2Y && y <= g_mBtn2Y + g_mBtnH) row = 2;
  if (row) {
    for (int i = 0; i < MB_COUNT; i++) {
      if (x < g_mBtnX[i] || x > g_mBtnX[i] + g_mBtnW) continue;
      menuBtnActivate((row == 1 ? 0 : MB_COUNT) + i);   // incl. pressed feedback
      return;
    }
    return;
  }
  int total = (int)g_entries.size();
  if (g_mScrollable && y >= g_mFooterY) {
    if (x < W / 2) { g_sel -= g_mVisible; if (g_sel < 0) g_sel = 0; }
    else           { g_sel += g_mVisible; if (g_sel > total - 1) g_sel = total - 1; }
    if (++g_menuFastCount < MENU_QUALITY_EVERY) g_menuFastOnce = true;
    else g_menuFastCount = 0;                  // periodic clean draw
    drawMenu();
    return;
  }
  if (y < g_mListTop) return;
  int r = (y - g_mListTop) / g_mItemH;
  if (r < 0 || r >= g_mVisible) return;
  int idx = menuTop + r;
  if (idx < 0 || idx >= total) return;
  g_sel = idx;
  activate(idx, false);          // touch = read / navigate
}

void gotoMenu() {
  sessionEnd();                    // log this session's words (if any)
  saveResume();                    // remember file + caret for [ Continue ]
  clearDoc();                      // so a later standby won't re-save the buffer
  g_goalMode = 0; g_goalHit = false;
  g_moveSrc = ""; g_moveMsg = "";  // abandon any half-finished move
  g_btnSel = -1;                   // fresh menu: focus starts in the list
  applyRotation(false);            // menu is always landscape
  filename = ""; modified = false; cursorPos = 0; desiredCol = -1;
  buildEntries(); g_sel = 0; menuTop = 0; drawMenu();
}

void handleMenuKey(uint8_t ascii, uint8_t keycode) {
  int total = (int)g_entries.size();
  bool onFile = (g_btnSel < 0 && g_sel >= 0 && g_sel < total && g_entries[g_sel].type == E_FILE);
  if (g_moveSrc.length()) {                    // move mode: navigate + drop only
    if (keycode == KC_ESC) { gotoMenu(); return; }
    if (keycode == KC_UP)        menuMoveSel(g_sel - 1);
    else if (keycode == KC_DOWN) menuMoveSel(g_sel + 1);
    else if (ascii == 10 || ascii == 13 || keycode == KC_ENTER) activate(g_sel, true);
    return;
  }
  if (g_btnSel >= 0) {                         // focus is on the button rows
    if (keycode == KC_ESC)   { menuBtnFocus(-1); return; }
    if (keycode == KC_LEFT)  { menuBtnMove(-1, 0); return; }
    if (keycode == KC_RIGHT) { menuBtnMove(+1, 0); return; }
    if (keycode == KC_UP)    { menuBtnMove(0, -1); return; }
    if (keycode == KC_DOWN)  { menuBtnMove(0, +1); return; }
    if (ascii == 10 || ascii == 13 || keycode == KC_ENTER) { menuBtnActivate(g_btnSel); return; }
  } else if (keycode == KC_UP) {
    if (g_sel > 0) { menuMoveSel(g_sel - 1); return; }
    int b = MB_COUNT;                          // top of the list: climb into row 2
    while (b < 2 * MB_COUNT && !menuBtnValid(b)) b++;
    if (menuBtnValid(b)) menuBtnFocus(b);
    return;
  }
  else if (keycode == KC_DOWN) menuMoveSel(g_sel + 1);
  else if (ascii == 10 || ascii == 13 || keycode == KC_ENTER) { activate(g_sel, true); }
  else if (onFile && (ascii == 'r' || ascii == 'R')) {
    enterPrompt(PM_RENAME, 0, g_entries[g_sel].name);
  }
  else if (onFile && (ascii == 'm' || ascii == 'M')) {   // start a move
    g_moveSrc = fullPath(g_entries[g_sel].name);
    g_moveMsg = "";
    g_sel = 0; menuTop = 0; buildEntries(); drawMenu();
  }
  else if (onFile && (keycode == KC_DELETE || ascii == 'd' || ascii == 'D')) {
    enterConfirmDelete(g_entries[g_sel].name);
  }
  else if (ascii == 'e' || ascii == 'E') enterExport();
  else if (ascii == 'b' || ascii == 'B') { if (ENABLE_BLE_KEYBOARD) enterBtPair(); }
  else if (ascii == 'j' || ascii == 'J') openJournal();
  else if (ascii == 's' || ascii == 'S') enterStats();
  else if (ascii == 'c' || ascii == 'C') enterSync();
  else if (ascii == 'u' || ascii == 'U') { if (ENABLE_USB_DRIVE) enterUsbDrive(); }
  else if (ascii == 'z' || ascii == 'Z') goStandby();
  else if (ascii == '?')                 enterHelp();
}

// =========================================================================
//  In-editor menu (ESC)
// =========================================================================
// Each row shows its shortcut letter on the right, so the keys are
// discoverable on-screen instead of memorized.
const int EM_COUNT = 6;
String emLabel(int i) {
  switch (i) {
    case 0: return String("Resume editing            Esc");
    case 1: return String("Save                        s");
    case 2: return String("Save & exit to menu         w");
    case 3: return String("Discard & exit to menu      d");
    case 4: return g_focus ? String("Focus mode: ON              f")
                           : String("Focus mode: off             f");
    case 5: return String("Sleep (save, power off)     z");
  }
  return String();
}

void drawEditMenu() { drawModalList("Menu", 600, 430, emLabel, EM_COUNT, g_emSel); }

void enterEditMenu() { g_state = ST_EDITMENU; g_emSel = 0; drawEditMenu(); }

// Tap on a row = pick it; tap outside the dialog = resume editing.
void editMenuTap(int x, int y) {
  int r = modalListHit(x, y);
  if (r == -1) { resumeEditor(); return; }
  if (r >= 0) doEditMenuAction(r);
}

void doEditMenuAction(int a) {
  switch (a) {
    case 0: resumeEditor(); break;
    case 1: if (filename.length() == 0) enterPrompt(PM_SAVENEW, 0, ""); else { saveFile(); resumeEditor(); } break;
    case 2: if (filename.length() == 0) enterPrompt(PM_SAVENEW, 1, ""); else { saveFile(); gotoMenu();    } break;
    case 3: gotoMenu(); break;
    case 4:                                    // toggle focus mode
      g_focus = !g_focus;
      if (g_focus) { cursorPos = doc.length(); desiredCol = -1; }
      resumeEditor();
      break;
    case 5: goStandby(); break;
  }
}

void handleEditMenuKey(uint8_t ascii, uint8_t keycode) {
  if (keycode == KC_ESC)  { resumeEditor(); return; }
  if (keycode == KC_UP)   { if (g_emSel > 0) { g_emSel--; modalListMoveSel(g_emSel + 1, g_emSel); } return; }
  if (keycode == KC_DOWN) { if (g_emSel < EM_COUNT - 1) { g_emSel++; modalListMoveSel(g_emSel - 1, g_emSel); } return; }
  if (ascii == 10 || ascii == 13 || keycode == KC_ENTER) { doEditMenuAction(g_emSel); return; }
  if (ascii == 'r' || ascii == 'R') doEditMenuAction(0);
  else if (ascii == 's' || ascii == 'S') doEditMenuAction(1);
  else if (ascii == 'w' || ascii == 'W') doEditMenuAction(2);
  else if (ascii == 'd' || ascii == 'D' || ascii == 'q' || ascii == 'Q') doEditMenuAction(3);
  else if (ascii == 'f' || ascii == 'F') doEditMenuAction(4);
  else if (ascii == 'z' || ascii == 'Z') doEditMenuAction(5);
}

// =========================================================================
//  Word count popup (Ctrl+W in the editor; any key or tap dismisses)
// =========================================================================
void drawCountPopup() {
  M5.Display.setEpdMode(m5gfx::epd_quality);
  M5.Display.startWrite();
  int bw = 560, bh = 340, bx, by;
  modalFrame(bw, bh, g_goalHit ? "Goal reached!" : "Count", bx, by);

  int screens = ((int)g_lines.size() + g_rows - 1) / g_rows;
  if (screens < 1) screens = 1;
  char l1[48], l2[48], l3[48], l4[48] = "";
  snprintf(l1, sizeof(l1), "Words:      %d", countWords());
  snprintf(l2, sizeof(l2), "Characters: %d", (int)doc.length());
  snprintf(l3, sizeof(l3), "Screens:    %d", screens);
  if (g_goalHit || g_goalMode) {               // sprint / goal progress line
    int got = g_docWords - g_goalStartWords;   if (got < 0) got = 0;
    int mins = (int)((millis() - g_goalStartMs) / 60000UL);
    if (g_goalHit || g_goalMode == 1)
      snprintf(l4, sizeof(l4), "This sprint: +%d words in %d min", got, mins);
    else
      snprintf(l4, sizeof(l4), "Goal:       %d / %d words", got, g_goalTarget);
  }
  M5.Display.setFont(&fonts::FreeMono12pt7b);
  int y = by + 90, dy = 42;
  M5.Display.drawString(l1, bx + 30, y);       y += dy;
  M5.Display.drawString(l2, bx + 30, y);       y += dy;
  M5.Display.drawString(l3, bx + 30, y);       y += dy;
  if (l4[0]) { M5.Display.drawString(l4, bx + 30, y); }

  M5.Display.setFont(&fonts::FreeMono9pt7b);
  M5.Display.drawString("Any key (or tap) to keep writing.", bx + 30, by + bh - 36);
  M5.Display.endWrite();
}

void enterCount() { g_state = ST_COUNT; drawCountPopup(); }
void dismissCount() { g_goalHit = false; resumeEditor(); }
void handleCountKey(uint8_t ascii, uint8_t keycode) {
  (void)ascii; (void)keycode;                  // any key (or tap) dismisses
  dismissCount();
}

// =========================================================================
//  Writing goal / sprint menu (Ctrl+G in the editor)
// =========================================================================
const int GOAL_COUNT = 6;
const char *GOAL_ITEMS[GOAL_COUNT] = {
  "Off", "Sprint 15 min", "Sprint 30 min",
  "Goal 250 words", "Goal 500 words", "Goal 1000 words"
};

String goalLabel(int i) { return String(GOAL_ITEMS[i]); }

void drawGoal() { drawModalList("Writing goal", 560, 420, goalLabel, GOAL_COUNT, g_goalSel); }

void enterGoal() { g_state = ST_GOAL; g_goalSel = 0; drawGoal(); }

// Tap on a row = pick it; tap outside the dialog = back to writing.
void goalTap(int x, int y) {
  int r = modalListHit(x, y);
  if (r == -1) { resumeEditor(); return; }
  if (r >= 0) applyGoal(r);
}

void applyGoal(int i) {
  switch (i) {
    case 0: g_goalMode = 0; break;
    case 1: g_goalMode = 1; g_goalTarget = 15;   break;
    case 2: g_goalMode = 1; g_goalTarget = 30;   break;
    case 3: g_goalMode = 2; g_goalTarget = 250;  break;
    case 4: g_goalMode = 2; g_goalTarget = 500;  break;
    case 5: g_goalMode = 2; g_goalTarget = 1000; break;
  }
  g_goalStartMs = millis();
  g_goalStartWords = g_docWords;
  g_goalHit = false;
  resumeEditor();
}

void handleGoalKey(uint8_t ascii, uint8_t keycode) {
  if (keycode == KC_ESC) { resumeEditor(); return; }
  if (keycode == KC_UP)   { if (g_goalSel > 0) { g_goalSel--; modalListMoveSel(g_goalSel + 1, g_goalSel); } return; }
  if (keycode == KC_DOWN) { if (g_goalSel < GOAL_COUNT - 1) { g_goalSel++; modalListMoveSel(g_goalSel - 1, g_goalSel); } return; }
  if (ascii == 10 || ascii == 13 || keycode == KC_ENTER) applyGoal(g_goalSel);
}

// =========================================================================
//  Writing stats screen ('s' in the menu) - reads /.ptstats.csv
// =========================================================================
// days-since-epoch from a civil date (Howard Hinnant's algorithm)
long dayNum(int y, int m, int d) {
  y -= m <= 2;
  long era = (y >= 0 ? y : y - 399) / 400;
  unsigned yoe = (unsigned)(y - era * 400);
  unsigned doy = (153u * (unsigned)(m + (m > 2 ? -3 : 9)) + 2) / 5 + (unsigned)d - 1;
  unsigned doe = yoe * 365 + yoe / 4 - yoe / 100 + doy;
  return era * 146097 + (long)doe - 719468;
}

void drawStats() {
  // aggregate the log: one "YYYY-MM-DD,words" line per session, chronological
  long lifetime = 0, best = 0, todayWords = 0;
  long prevDay = -1, daySum = 0, chain = 0;
  long today = -1;
  if (g_rtcOk) {
    auto dt = M5.Rtc.getDateTime();
    today = dayNum(dt.date.year, dt.date.month, dt.date.date);
  }
  File f = SD.open("/.ptstats.csv", FILE_READ);
  if (f) {
    while (f.available()) {
      String line = f.readStringUntil('\n');
      int y, m, d, w;
      if (sscanf(line.c_str(), "%d-%d-%d,%d", &y, &m, &d, &w) != 4) continue;
      long day = dayNum(y, m, d);
      if (day != prevDay) {                    // close out the previous day
        if (daySum > best) best = daySum;
        chain = (prevDay >= 0 && day == prevDay + 1) ? chain + 1 : 1;
        prevDay = day; daySum = 0;
      }
      daySum += w;
      lifetime += w;
    }
    f.close();
    if (daySum > best) best = daySum;
    if (prevDay == today) todayWords = daySum;
  }
  long streak = 0;
  if (today >= 0 && prevDay >= 0 && prevDay >= today - 1) streak = chain;

  M5.Display.setEpdMode(m5gfx::epd_quality);
  M5.Display.startWrite();
  M5.Display.fillScreen(TFT_WHITE);
  M5.Display.setTextColor(TFT_BLACK, TFT_WHITE);
  M5.Display.setTextDatum(m5gfx::top_left);
  M5.Display.setFont(&fonts::FreeMonoBold18pt7b);
  M5.Display.drawString("Writing stats", MARGIN_X, 24);

  char l1[48], l2[48], l3[48], l4[48];
  snprintf(l1, sizeof(l1), "Today:     %ld words", todayWords);
  snprintf(l2, sizeof(l2), "Streak:    %ld day%s", streak, streak == 1 ? "" : "s");
  snprintf(l3, sizeof(l3), "Best day:  %ld words", best);
  snprintf(l4, sizeof(l4), "Lifetime:  %ld words", lifetime);
  M5.Display.setFont(&fonts::FreeMono12pt7b);
  int y = 100, dy = 46;
  M5.Display.drawString(l1, MARGIN_X, y);  y += dy;
  M5.Display.drawString(l2, MARGIN_X, y);  y += dy;
  M5.Display.drawString(l3, MARGIN_X, y);  y += dy;
  M5.Display.drawString(l4, MARGIN_X, y);  y += dy;

  M5.Display.setFont(&fonts::FreeMono9pt7b);
  M5.Display.drawString("Words are logged when you leave the editor or the device sleeps.",
                        MARGIN_X, y + 14);
  M5.Display.drawString("Press any key or tap to go back.", MARGIN_X, H - 28);
  M5.Display.endWrite();
}

void enterStats() { g_state = ST_STATS; drawStats(); }
void handleStatsKey(uint8_t ascii, uint8_t keycode) {
  (void)ascii; (void)keycode;
  gotoMenu();
}

// =========================================================================
//  Spell check (Ctrl+K in the editor) - needs DICT_PATH on the SD card
// =========================================================================
const int SPELL_MAX = 100;
String g_spellWords[SPELL_MAX];
int    g_spellCounts[SPELL_MAX];
int    g_spellFound = 0;                 // -1 = no usable dictionary
int    g_spellTop = 0;
int    g_spellSel = 0;
void drawSpellRow(int i, bool sel);

// Load the word list once per power-on (kept in PSRAM afterwards). The file
// is folded through the same UTF-8 -> ASCII pipeline as documents (so
// "étude" matches a folded doc), lowercased, and re-sorted - any standard
// word list works without preprocessing.
bool dictLoad() {
  if (g_dict && !g_dictOff.empty()) return true;
  File f = SD.open(DICT_PATH, FILE_READ);
  if (!f) return false;
  int len = (int)f.size();
  int cap = len + 256;                 // folding almost always shrinks; slack for the rest
  char *buf = (char *)GB_MALLOC((size_t)cap);
  if (!buf) { f.close(); return false; }
  int out = 0;
  char chunk[512];
  Utf8Fold u8;
  while (f.available()) {
    int n = (int)f.readBytes(chunk, sizeof(chunk));
    for (int i = 0; i < n; i++) {
      long cp = u8.feed((uint8_t)chunk[i]);
      if (cp < 0) continue;
      if (cp < 0x80) { if (out < cap - 1) buf[out++] = (char)cp; continue; }
      for (const char *r = asciiFold((uint32_t)cp); *r && out < cap - 1; r++)
        buf[out++] = *r;
    }
    yield();                                   // ~2 MB list: feed the watchdog
  }
  f.close();
  buf[out] = 0;
  g_dict = buf; g_dictLen = out;
  dictIndex();
  dictNormalize();
  return !g_dictOff.empty();
}

const int SPELL_ROWS = 11;

void drawSpell() {
  M5.Display.setEpdMode(m5gfx::epd_quality);
  M5.Display.startWrite();
  M5.Display.fillScreen(TFT_WHITE);
  M5.Display.setTextColor(TFT_BLACK, TFT_WHITE);
  M5.Display.setTextDatum(m5gfx::top_left);
  M5.Display.setFont(&fonts::FreeMonoBold18pt7b);
  M5.Display.drawString("Spell check", MARGIN_X, 24);
  M5.Display.setFont(&fonts::FreeMono12pt7b);

  if (g_spellFound < 0) {
    M5.Display.drawString("No word list found.", MARGIN_X, 100);
    M5.Display.setFont(&fonts::FreeMono9pt7b);
    M5.Display.drawString("Put a plain-text dictionary at " DICT_PATH " on the SD card,",
                          MARGIN_X, 150);
    M5.Display.drawString("one word per line. Any standard list works as-is - mixed case,",
                          MARGIN_X, 174);
    M5.Display.drawString("possessives and accents are normalized automatically.",
                          MARGIN_X, 198);
  } else if (g_spellFound == 0) {
    M5.Display.drawString("No unknown words. Nice.", MARGIN_X, 100);
  } else {
    int pages = (g_spellFound + SPELL_ROWS - 1) / SPELL_ROWS;
    int pg = g_spellTop / SPELL_ROWS + 1;
    M5.Display.setFont(&fonts::FreeMono9pt7b);
    M5.Display.setTextDatum(m5gfx::top_right);
    M5.Display.drawString(String(g_spellFound) + (g_spellFound == SPELL_MAX ? "+" : "") +
                          " unknown   page " + pg + "/" + pages, W - MARGIN_X, 30);
    M5.Display.setTextDatum(m5gfx::top_left);
    for (int r = 0; r < SPELL_ROWS; r++) {
      int i = g_spellTop + r;
      if (i >= g_spellFound) break;
      drawSpellRow(i, i == g_spellSel);
    }
  }
  M5.Display.setFont(&fonts::FreeMono9pt7b);
  M5.Display.drawString("Up/Down select   Enter = jump to it   l = learn (add to word list)   ESC back",
                        MARGIN_X, H - 28);
  M5.Display.endWrite();
}

void drawSpellRow(int i, bool sel) {
  int r = i - g_spellTop;
  if (r < 0 || r >= SPELL_ROWS || i >= g_spellFound) return;
  int y = 76 + r * 36;
  String line = g_spellWords[i];
  if (g_spellCounts[i] > 1) line += "   x" + String(g_spellCounts[i]);
  M5.Display.setFont(&fonts::FreeMono12pt7b);
  M5.Display.setTextDatum(m5gfx::top_left);
  M5.Display.fillRect(MARGIN_X - 6, y - 2, W - 2 * MARGIN_X + 12, 34,
                      sel ? TFT_BLACK : TFT_WHITE);
  M5.Display.setTextColor(sel ? TFT_WHITE : TFT_BLACK, sel ? TFT_BLACK : TFT_WHITE);
  M5.Display.drawString(drawable(line), MARGIN_X, y);
  M5.Display.setTextColor(TFT_BLACK, TFT_WHITE);
}

void spellMoveSel(int to) {
  if (to < 0 || to >= g_spellFound || to == g_spellSel) return;
  int from = g_spellSel;
  g_spellSel = to;
  if (to < g_spellTop || to >= g_spellTop + SPELL_ROWS) {
    g_spellTop = (to / SPELL_ROWS) * SPELL_ROWS;
    drawSpell();
    return;
  }
  M5.Display.setEpdMode(m5gfx::epd_fast);
  M5.Display.startWrite();
  drawSpellRow(from, false);
  drawSpellRow(to, true);
  M5.Display.endWrite();
}

void enterSpell() {
  // scanning a whole novel takes a couple of seconds - say so
  M5.Display.setEpdMode(m5gfx::epd_fast);
  M5.Display.startWrite();
  M5.Display.fillRect(0, 0, W, statusH, TFT_WHITE);
  M5.Display.setFont(&fonts::FreeMono9pt7b);
  M5.Display.setTextColor(TFT_BLACK, TFT_WHITE);
  M5.Display.setTextDatum(m5gfx::top_left);
  M5.Display.drawString("Checking spelling... (first use also loads the word list)",
                        MARGIN_X, 5);
  M5.Display.endWrite();
  g_spellFound = dictLoad() ? spellScan(g_spellWords, g_spellCounts, SPELL_MAX) : -1;
  g_spellTop = 0;
  g_spellSel = 0;
  g_state = ST_SPELL;
  drawSpell();
}

void handleSpellKey(uint8_t ascii, uint8_t keycode) {
  if (keycode == KC_ESC) { resumeEditor(); return; }
  if (g_spellFound <= 0) return;
  if (keycode == KC_UP)   { spellMoveSel(g_spellSel - 1); return; }
  if (keycode == KC_DOWN) { spellMoveSel(g_spellSel + 1); return; }
  if (keycode == KC_LEFT || keycode == KC_PGUP)  { spellMoveSel(g_spellSel - SPELL_ROWS); return; }
  if (keycode == KC_RIGHT || keycode == KC_PGDN || ascii == ' ') {
    int to = g_spellSel + SPELL_ROWS;
    spellMoveSel(to >= g_spellFound ? g_spellFound - 1 : to);
    return;
  }
  if (ascii == 10 || ascii == 13 || keycode == KC_ENTER) {   // jump to the word
    int hit = searchDoc(g_spellWords[g_spellSel], 0);
    if (hit >= 0) { cursorPos = hit; desiredCol = -1; resumeEditor(); }
    return;
  }
  if (ascii == 'l' || ascii == 'L') {                        // learn the word
    String w = g_spellWords[g_spellSel];
    File f = SD.open(DICT_PATH, FILE_APPEND);
    if (f) {                       // UTF-8 on disk (Esperanto slots re-encoded)
      writeUtf8Run(f, w.c_str(), (int)w.length());
      f.print('\n');
      f.close();
    }
    dictLearn(w.c_str());
    for (int i = g_spellSel; i < g_spellFound - 1; i++) {    // drop from results
      g_spellWords[i]  = g_spellWords[i + 1];
      g_spellCounts[i] = g_spellCounts[i + 1];
    }
    g_spellFound--;
    if (g_spellSel >= g_spellFound) g_spellSel = g_spellFound > 0 ? g_spellFound - 1 : 0;
    if (g_spellTop > g_spellSel) g_spellTop = (g_spellSel / SPELL_ROWS) * SPELL_ROWS;
    drawSpell();
    return;
  }
}

void spellTap(int x, int y) {
  if (y < statusH + 20) { resumeEditor(); return; }   // top band exits
  if (x < W / 3) handleSpellKey(0, KC_LEFT);
  else           handleSpellKey(0, KC_RIGHT);
}

// =========================================================================
//  Text prompt - used to name a new file (PM_SAVENEW) or rename one (PM_RENAME)
// =========================================================================
void drawPrompt() {
  M5.Display.setEpdMode(m5gfx::epd_quality);
  M5.Display.startWrite();
  int bw = 680, bh = 210, bx = (W - bw) / 2, by = (H - bh) / 2;
  M5.Display.fillRect(bx, by, bw, bh, TFT_WHITE);
  M5.Display.drawRect(bx, by, bw, bh, TFT_BLACK);
  M5.Display.setTextColor(TFT_BLACK, TFT_WHITE);
  M5.Display.setTextDatum(m5gfx::top_left);
  M5.Display.setFont(&fonts::FreeMono12pt7b);
  const char *title = (g_promptMode == PM_RENAME)
                        ? "Rename to  (Enter = ok, ESC = cancel):"
                        : (g_promptMode == PM_NEWDIR)
                          ? "New folder name  (Enter = ok, ESC = cancel):"
                          : (g_promptMode == PM_SEARCH)
                            ? "Find  (Enter = next, ESC = back):"
                            : (g_promptMode == PM_GOPAGE)
                              ? "Go to page  (Enter = go, ESC = back):"
                              : "Save as  (Enter = ok, ESC = cancel):";
  M5.Display.drawString(title, bx + 24, by + 26);
  M5.Display.setFont(&fonts::FreeMonoBold18pt7b);
  M5.Display.drawString(g_fname + "_", bx + 24, by + 90);
  M5.Display.setFont(&fonts::FreeMono9pt7b);
  String note;
  if (g_promptMsg.length())           note = g_promptMsg;   // e.g. name collision
  else if (g_promptMode == PM_NEWDIR) note = String("created inside ") + g_cwd;
  else if (g_promptMode == PM_SEARCH) note = g_searchMiss ? "no match found"
                                                          : "case-insensitive; wraps around";
  else if (g_promptMode == PM_GOPAGE)
    note = "1 to " + String(((int)g_lines.size() + g_rows - 1) / g_rows);
  else                                note = "\".txt\" is added automatically if you omit it";
  M5.Display.drawString(note, bx + 24, by + 150);
  M5.Display.endWrite();
}

void enterPrompt(int mode, int after, const String &prefill) {
  g_state = ST_PROMPT;
  g_promptMode = mode;
  g_afterSave = after;
  g_renameTarget = (mode == PM_RENAME) ? prefill : String("");
  g_fname = prefill;
  g_searchMiss = false;
  g_promptMsg = "";
  drawPrompt();
}

// Cancel a prompt, returning to wherever it was opened from. Shared by the
// ESC key and by tapping anywhere (so touch can always back out).
void promptCancel() {
  if (g_promptMode == PM_SAVENEW)      enterEditMenu();  // came from the editor
  else if (g_promptMode == PM_SEARCH ||
           g_promptMode == PM_GOPAGE)  resumeEditor();   // back to the text
  else                                 gotoMenu();       // rename / new-folder
}

void handlePromptKey(uint8_t ascii, uint8_t keycode) {
  if (keycode == KC_ESC) { promptCancel(); return; }
  if (ascii == 8 || keycode == KC_BKSP) {        // backspace
    if (g_fname.length() > 0) g_fname.remove(g_fname.length() - 1);
    g_searchMiss = false;
    g_promptMsg = "";
    drawPrompt();
    return;
  }
  if (ascii == 10 || ascii == 13 || keycode == KC_ENTER) {
    if (g_fname.length() == 0) return;

    if (g_promptMode == PM_SEARCH) {
      g_searchTerm = g_fname;
      int hit = searchDoc(g_searchTerm, cursorPos + 1);
      if (hit >= 0) { cursorPos = hit; desiredCol = -1; resumeEditor(); }
      else          { g_searchMiss = true; drawPrompt(); }
      return;
    }
    if (g_promptMode == PM_GOPAGE) {
      int pages = ((int)g_lines.size() + g_rows - 1) / g_rows;
      int p = g_fname.toInt();
      if (p < 1) p = 1;
      if (p > pages) p = pages;
      int row = (p - 1) * g_rows;
      if (row >= (int)g_lines.size()) row = (int)g_lines.size() - 1;
      cursorPos = g_lines.empty() ? 0 : g_lines[row].start;
      desiredCol = -1;
      resumeEditor();
      return;
    }

    if (g_promptMode == PM_NEWDIR) {
      if (SD.exists(fullPath(g_fname).c_str())) {          // file OR folder
        g_promptMsg = "\"" + g_fname + "\" already exists here - pick another name";
        drawPrompt();
        return;
      }
      SD.mkdir(fullPath(g_fname).c_str());
      cdInto(g_fname);                           // hop into the new folder
      return;
    }

    String low = g_fname; low.toLowerCase();
    String newBase = low.endsWith(".txt") ? g_fname : g_fname + ".txt";

    // Never silently clobber an existing file (FAT is case-insensitive, and
    // the target may even be one the browser hides, like the spell list).
    // Renaming a file to its own name is the harmless no-op exception.
    bool sameName = (g_promptMode == PM_RENAME && newBase == g_renameTarget);
    if (!sameName && SD.exists(fullPath(newBase).c_str())) {
      g_promptMsg = "\"" + newBase + "\" already exists here - pick another name";
      drawPrompt();
      return;
    }

    if (g_promptMode == PM_RENAME) {
      if (!sameName) {
        SD.rename(fullPath(g_renameTarget).c_str(), fullPath(newBase).c_str());
      }
      gotoMenu();
    } else {                                     // PM_SAVENEW
      filename = fullPath(newBase);              // save into the current folder
      saveFile();
      if (g_afterSave == 1) gotoMenu(); else resumeEditor();
    }
    return;
  }
  if (ascii >= 32 && ascii < 127 && ascii != '/' && ascii != '\\') {
    g_fname += (char)ascii;
    g_promptMsg = "";
    drawPrompt();
  }
}

// =========================================================================
//  Confirm dialog (delete a file)
// =========================================================================
int g_cfBtnX[2], g_cfBtnY, g_cfBtnW = 200, g_cfBtnH = 40;   // tap targets
void drawConfirmBtn(int i);

void drawConfirm() {
  M5.Display.setEpdMode(m5gfx::epd_quality);
  M5.Display.startWrite();
  int bw = 640, bh = 240, bx, by;
  modalFrame(bw, bh, "Delete this file?", bx, by);
  M5.Display.setFont(&fonts::FreeMono12pt7b);
  M5.Display.drawString(g_confirmName, bx + 30, by + 72);
  M5.Display.setFont(&fonts::FreeMono9pt7b);
  M5.Display.drawString("This cannot be undone.", bx + 30, by + 112);

  // two buttons (tappable): Delete / Cancel
  M5.Display.setFont(&fonts::FreeMono12pt7b);
  g_cfBtnY = by + bh - 60;
  int gap = 40, sx = bx + (bw - (g_cfBtnW * 2 + gap)) / 2;
  g_cfBtnX[0] = sx;
  g_cfBtnX[1] = sx + g_cfBtnW + gap;
  drawConfirmBtn(0);
  drawConfirmBtn(1);
  M5.Display.setTextDatum(m5gfx::top_left);
  M5.Display.endWrite();
}

void drawConfirmBtn(int i) {
  static const char *btn[2] = {"Delete", "Cancel"};
  bool sel = (i == g_confirmSel);
  int x = g_cfBtnX[i];
  M5.Display.setFont(&fonts::FreeMono12pt7b);
  M5.Display.fillRect(x, g_cfBtnY, g_cfBtnW, g_cfBtnH, sel ? TFT_BLACK : TFT_WHITE);
  if (!sel) M5.Display.drawRect(x, g_cfBtnY, g_cfBtnW, g_cfBtnH, TFT_BLACK);
  M5.Display.setTextColor(sel ? TFT_WHITE : TFT_BLACK, sel ? TFT_BLACK : TFT_WHITE);
  M5.Display.setTextDatum(m5gfx::middle_center);
  M5.Display.drawString(btn[i], x + g_cfBtnW / 2, g_cfBtnY + g_cfBtnH / 2);
  M5.Display.setTextColor(TFT_BLACK, TFT_WHITE);
  M5.Display.setTextDatum(m5gfx::top_left);
}

// Tap Delete/Cancel directly; a tap anywhere else safely cancels.
void confirmTap(int x, int y) {
  if (y >= g_cfBtnY && y <= g_cfBtnY + g_cfBtnH &&
      x >= g_cfBtnX[0] && x <= g_cfBtnX[0] + g_cfBtnW) {
    SD.remove(fullPath(g_confirmName).c_str());
  }
  gotoMenu();
}

void enterConfirmDelete(const String &name) {
  g_state = ST_CONFIRM;
  g_confirmName = name;
  g_confirmSel = 1;                 // default to Cancel
  drawConfirm();
}

void handleConfirmKey(uint8_t ascii, uint8_t keycode) {
  if (keycode == KC_ESC) { gotoMenu(); return; }
  if (keycode == KC_LEFT || keycode == KC_RIGHT) {
    g_confirmSel = 1 - g_confirmSel;
    M5.Display.setEpdMode(m5gfx::epd_fast);    // just the two buttons, no flash
    M5.Display.startWrite();
    drawConfirmBtn(0);
    drawConfirmBtn(1);
    M5.Display.endWrite();
    return;
  }
  if (ascii == 'y' || ascii == 'Y') { SD.remove(fullPath(g_confirmName).c_str()); gotoMenu(); return; }
  if (ascii == 'n' || ascii == 'N') { gotoMenu(); return; }
  if (ascii == 10 || ascii == 13 || keycode == KC_ENTER) {
    if (g_confirmSel == 0) SD.remove(fullPath(g_confirmName).c_str());
    gotoMenu();
  }
}

// =========================================================================
//  WiFi export (SoftAP + tiny web server). Radio is only on while here.
// =========================================================================
String urlEncode(const String &s) {
  static const char *hex = "0123456789ABCDEF";
  String o;
  for (int i = 0; i < (int)s.length(); i++) {
    char c = s[i];
    if (isalnum((unsigned char)c) || c == '.' || c == '-' || c == '_') o += c;
    else { o += '%'; o += hex[(c >> 4) & 0xF]; o += hex[c & 0xF]; }
  }
  return o;
}

// All .txt files in the current folder (shared by export, sync).
std::vector<String> listTxtFiles() {
  std::vector<String> out;
  File root = SD.open(dirOpenPath().c_str());
  if (!root) return out;
  for (File f = root.openNextFile(); f; f = root.openNextFile()) {
    if (f.isDirectory()) continue;
    String nm = baseName(String(f.name()));
    if (nm.length() == 0 || nm[0] == '.') continue;   // .DS_Store, ._AppleDouble...
    String low = nm; low.toLowerCase();
    if (low.endsWith(".txt")) out.push_back(nm);
  }
  root.close();
  return out;
}

void handleRoot() {
  String html = F("<!doctype html><html><head><meta charset=utf-8>"
                  "<meta name=viewport content=\"width=device-width,initial-scale=1\">"
                  "<title>BYOBYOK</title>"
                  "<style>body{font-family:sans-serif;max-width:40em;margin:2em auto;padding:0 1em}"
                  "h1{font-size:1.3em}li{margin:.4em 0}a{text-decoration:none}</style>"
                  "</head><body><h1>BYOBYOK files</h1>");
  html += "<p style=color:#888>Folder: " + g_cwd + "</p><ul>";
  std::vector<String> files = listTxtFiles();
  for (auto &nm : files) {
    File f = SD.open(fullPath(nm).c_str(), FILE_READ);
    int sz = f ? (int)f.size() : 0;
    if (f) f.close();
    html += "<li><a href=\"/dl?f=" + urlEncode(nm) + "\">" + nm + "</a> &middot; "
            + String(sz) + " bytes</li>";
  }
  if (files.empty()) html += F("<li><i>no .txt files yet</i></li>");
  html += F("</ul>"
            "<h2 style=font-size:1.1em>Upload a .txt file</h2>"
            "<form method=post action=/upload enctype=multipart/form-data>"
            "<input type=file name=f accept=\".txt,text/plain\"> "
            "<button>Upload</button></form>"
            "<p style=color:#888>Tap a file above to download. Uploads are saved to "
            "the SD card (same-name files are overwritten). Opening this page also "
            "sets the device clock from your browser. Press ESC on the device to "
            "turn WiFi back off.</p>"
            "<script>{const d=new Date();fetch('/clock?y='+d.getFullYear()+'&mo='+"
            "(d.getMonth()+1)+'&d='+d.getDate()+'&h='+d.getHours()+'&mi='+"
            "d.getMinutes()+'&s='+d.getSeconds());}</script></body></html>");
  server.send(200, "text/html", html);
}

// The export page reports the browser's local time - a free, exact RTC sync
// with no NTP or internet needed.
void handleClock() {
  if (!g_rtcOk || !server.hasArg("y")) { server.send(400, "text/plain", "no"); return; }
  int y  = server.arg("y").toInt(),  mo = server.arg("mo").toInt();
  int d  = server.arg("d").toInt(),  h  = server.arg("h").toInt();
  int mi = server.arg("mi").toInt(), s  = server.arg("s").toInt();
  if (y < 2020 || y > 2099 || mo < 1 || mo > 12 || d < 1 || d > 31 ||
      h < 0 || h > 23 || mi < 0 || mi > 59 || s < 0 || s > 59) {
    server.send(400, "text/plain", "bad");
    return;
  }
  m5::rtc_datetime_t set;
  set.date.year = y; set.date.month = mo; set.date.date = d; set.date.weekDay = 0;
  set.time.hours = h; set.time.minutes = mi; set.time.seconds = s;
  M5.Rtc.setDateTime(set);
  server.send(200, "text/plain", "ok");
}

String sanitizeName(String nm) {
  int s = nm.lastIndexOf('/');  if (s >= 0) nm = nm.substring(s + 1);
  s = nm.lastIndexOf('\\');     if (s >= 0) nm = nm.substring(s + 1);
  return nm;
}

void handleUpload() {
  HTTPUpload &up = server.upload();
  if (up.status == UPLOAD_FILE_START) {
    String fn = sanitizeName(up.filename);
    if (fn.length() == 0) fn = "upload.txt";
    String low = fn; low.toLowerCase();
    if (!low.endsWith(".txt")) fn += ".txt";
    g_upFile = SD.open(fullPath(fn).c_str(), FILE_WRITE, true);   // into current folder
  } else if (up.status == UPLOAD_FILE_WRITE) {
    if (g_upFile) g_upFile.write(up.buf, up.currentSize);
  } else if (up.status == UPLOAD_FILE_END) {
    if (g_upFile) g_upFile.close();
  }
}

void handleUploadDone() {
  server.sendHeader("Location", "/");      // back to the listing (now updated)
  server.send(303, "text/plain", "");
}

void handleDownload() {
  if (!server.hasArg("f")) { server.send(400, "text/plain", "missing f"); return; }
  String name = server.arg("f");
  if (name.indexOf('/') >= 0 || name.indexOf('\\') >= 0) {   // no path traversal
    server.send(400, "text/plain", "bad name");
    return;
  }
  File f = SD.open(fullPath(name).c_str(), FILE_READ);
  if (!f) { server.send(404, "text/plain", "not found"); return; }
  server.sendHeader("Content-Disposition", "attachment; filename=\"" + name + "\"");
  server.streamFile(f, "text/plain");
  f.close();
}

void drawExport() {
  M5.Display.setEpdMode(m5gfx::epd_quality);
  M5.Display.startWrite();
  M5.Display.fillScreen(TFT_WHITE);
  M5.Display.setTextColor(TFT_BLACK, TFT_WHITE);
  M5.Display.setTextDatum(m5gfx::top_left);

  M5.Display.setFont(&fonts::FreeMonoBold18pt7b);
  M5.Display.drawString("WiFi Export", MARGIN_X, 24);

  String ip = WiFi.softAPIP().toString();
  M5.Display.setFont(&fonts::FreeMono12pt7b);
  int y = 90, dy = 40;
  M5.Display.drawString("1. Join this WiFi network:", MARGIN_X, y);          y += dy;
  M5.Display.drawString(String("     network:  ") + AP_SSID,  MARGIN_X, y);  y += dy;
  M5.Display.drawString(String("     password:  ") + AP_PASS, MARGIN_X, y);  y += dy + 8;
  M5.Display.drawString("2. Open this address in a browser:", MARGIN_X, y);  y += dy;
  M5.Display.setFont(&fonts::FreeMonoBold18pt7b);
  M5.Display.drawString(String("     http://") + ip + "/", MARGIN_X, y);     y += dy + 14;

  M5.Display.setFont(&fonts::FreeMono9pt7b);
  M5.Display.drawString("The page lets you download or upload .txt files,", MARGIN_X, y); y += 26;
  M5.Display.drawString("and opening it sets this device's clock.", MARGIN_X, y); y += 26;
  M5.Display.drawString("WiFi is ON only on this screen.  ESC or tap = stop & turn WiFi off.",
                        MARGIN_X, y);
  M5.Display.endWrite();
}

void enterExport() {
  g_state = ST_EXPORT;

  // "starting" splash
  M5.Display.setEpdMode(m5gfx::epd_quality);
  M5.Display.startWrite();
  M5.Display.fillScreen(TFT_WHITE);
  M5.Display.setTextColor(TFT_BLACK, TFT_WHITE);
  M5.Display.setTextDatum(m5gfx::top_left);
  M5.Display.setFont(&fonts::FreeMonoBold18pt7b);
  M5.Display.drawString("Starting WiFi...", MARGIN_X, 40);
  M5.Display.endWrite();

  WiFi.mode(WIFI_AP);
  WiFi.softAP(AP_SSID, AP_PASS);
  delay(300);
  server.on("/", handleRoot);
  server.on("/dl", handleDownload);
  server.on("/clock", handleClock);
  server.on("/upload", HTTP_POST, handleUploadDone, handleUpload);
  server.begin();

  drawExport();
}

void stopExport() {
  server.stop();
  WiFi.softAPdisconnect(true);   // drop clients + stop the AP
  WiFi.mode(WIFI_OFF);           // radio off again -> back to low power
  gotoMenu();
}

void handleExportKey(uint8_t ascii, uint8_t keycode) {
  (void)ascii;
  if (keycode == KC_ESC) stopExport();
}

// =========================================================================
//  Cloud sync ('c' in the menu, or the Cloud sync button)
//  Joins a real WiFi network and HTTP-PUTs every .txt in the current folder
//  to a WebDAV-style URL. Configured by /sync.cfg on the SD card:
//      ssid=MyNetwork
//      pass=secret
//      url=https://example.com/dav/writing/
//      user=me            (optional, HTTP basic auth)
//      pw=alsosecret      (optional)
//  HTTPS is accepted without certificate checking (see README).
//  (struct SyncCfg is defined near the top, with the other signature types.)
// =========================================================================
bool readSyncCfg(SyncCfg &c) {
  File f = SD.open("/sync.cfg", FILE_READ);
  if (!f) return false;
  while (f.available()) {
    String line = f.readStringUntil('\n');
    line.trim();
    int eq = line.indexOf('=');
    if (eq <= 0) continue;
    String k = line.substring(0, eq), v = line.substring(eq + 1);
    k.trim(); v.trim();
    if (k == "ssid") c.ssid = v;
    else if (k == "pass") c.pass = v;
    else if (k == "url")  c.url  = v;
    else if (k == "user") c.user = v;
    else if (k == "pw")   c.pw   = v;
  }
  f.close();
  return c.ssid.length() > 0 && c.url.length() > 0;
}

int g_syncY = 0;
void syncLine(const String &s) {               // append one progress line
  M5.Display.setEpdMode(m5gfx::epd_fast);
  M5.Display.startWrite();
  M5.Display.setFont(&fonts::FreeMono12pt7b);
  M5.Display.setTextColor(TFT_BLACK, TFT_WHITE);
  M5.Display.setTextDatum(m5gfx::top_left);
  M5.Display.drawString(s, MARGIN_X, g_syncY);
  M5.Display.endWrite();
  g_syncY += 32;
}

int syncPut(const SyncCfg &c, const String &name, File &f) {
  HTTPClient http;
  String full = c.url + urlEncode(name);
  int code = -1;
  if (c.url.startsWith("https:")) {
    WiFiClientSecure cl;
    cl.setInsecure();                          // no certificate pinning
    if (!http.begin(cl, full)) return -1;
    if (c.user.length()) http.setAuthorization(c.user.c_str(), c.pw.c_str());
    http.addHeader("Content-Type", "text/plain");
    code = http.sendRequest("PUT", &f, f.size());
    http.end();
  } else {
    WiFiClient cl;
    if (!http.begin(cl, full)) return -1;
    if (c.user.length()) http.setAuthorization(c.user.c_str(), c.pw.c_str());
    http.addHeader("Content-Type", "text/plain");
    code = http.sendRequest("PUT", &f, f.size());
    http.end();
  }
  return code;
}

void enterSync() {
  g_state = ST_SYNC;
  M5.Display.setEpdMode(m5gfx::epd_quality);
  M5.Display.startWrite();
  M5.Display.fillScreen(TFT_WHITE);
  M5.Display.setTextColor(TFT_BLACK, TFT_WHITE);
  M5.Display.setTextDatum(m5gfx::top_left);
  M5.Display.setFont(&fonts::FreeMonoBold18pt7b);
  M5.Display.drawString("Cloud sync", MARGIN_X, 24);
  M5.Display.endWrite();
  g_syncY = 90;

  SyncCfg c;
  if (!readSyncCfg(c)) {
    syncLine("No /sync.cfg found on the SD card.");
    syncLine("Create it with lines: ssid= pass= url=");
    syncLine("(plus optional user= and pw= for basic auth)");
    syncLine("ESC or tap to close.");
    return;
  }
  syncLine("Joining \"" + c.ssid + "\"...");
  WiFi.mode(WIFI_STA);
  WiFi.begin(c.ssid.c_str(), c.pass.c_str());
  unsigned long t0 = millis();
  while (WiFi.status() != WL_CONNECTED && millis() - t0 < 15000) delay(200);
  if (WiFi.status() != WL_CONNECTED) {
    WiFi.mode(WIFI_OFF);
    syncLine("Could not join the network.");
    syncLine("WiFi is off again. ESC or tap to close.");
    return;
  }
  if (!c.url.endsWith("/")) c.url += "/";

  int okN = 0, failN = 0;
  std::vector<String> files = listTxtFiles();
  for (auto &nm : files) {
    File f = SD.open(fullPath(nm).c_str(), FILE_READ);
    if (!f) { failN++; continue; }
    int code = syncPut(c, nm, f);
    f.close();
    bool ok = (code >= 200 && code < 300);
    syncLine(nm + (ok ? "  ok" : ("  FAILED (" + String(code) + ")")));
    ok ? okN++ : failN++;
  }
  WiFi.mode(WIFI_OFF);                         // radio back off, always
  syncLine("Done: " + String(okN) + " uploaded, " + String(failN) + " failed.");
  syncLine("WiFi is off again. ESC or tap to close.");
  g_lastActivity = millis();                   // a long sync isn't idle time
}

void stopSync() {
  WiFi.mode(WIFI_OFF);                         // idempotent safety
  gotoMenu();
}

void handleSyncKey(uint8_t ascii, uint8_t keycode) {
  (void)ascii; (void)keycode;                  // any key (or tap) closes
  stopSync();
}

// =========================================================================
//  Help / controls screen ('?')
// =========================================================================
void drawHelp() {
  M5.Display.setEpdMode(m5gfx::epd_quality);
  M5.Display.startWrite();
  M5.Display.fillScreen(TFT_WHITE);
  M5.Display.setTextColor(TFT_BLACK, TFT_WHITE);
  M5.Display.setTextDatum(m5gfx::top_left);
  M5.Display.setFont(&fonts::FreeMonoBold18pt7b);
  M5.Display.drawString("Controls", MARGIN_X, 18);

  static const char *lines[] = {
    "MENU: Up/Down + Enter, or tap.  [ Continue ] = resume last file",
    "  r rename   m move   Del delete   j journal   arrows reach the buttons",
    "  Buttons/keys: layout, b BT kbd, font, e export, u USB, c sync, s stats",
    "READER: tap a file to open; your place is remembered per file",
    "  Tap sides = page, top = exit, bottom = bookmarks/go-to-page",
    "  e = edit   r = rotate   b = bookmarks",
    "EDITING  (Ctrl shortcuts follow your layout; Cmd works as Ctrl)",
    "  Ctrl+S save    Ctrl+W count   Ctrl+Z undo    Ctrl+K spell",
    "  Ctrl+F find    Ctrl+G goal    Ctrl+A/E paragraph start/end",
    "  Ctrl+R redraw the screen      Ctrl+Home/End top/bottom",
    "  Shift+arrows = word jump      Shift+Bksp/Del = delete word",
    "  Tap the page to place the cursor.  Enter auto-saves (5 s)",
    "  Option+u/e/i/n/b/` = accents (Option+i,g = gxx-style Esperanto)",
    "  ESC menu: Save / Discard / Focus / Sleep (keys shown on it)",
    "SLEEP: Sleep button, z in the menu, ESC menu, or 5 min idle",
    "  (the side button is a hardware restart on this board)",
    "RADIO off except during export / cloud sync / BT keyboard",
  };
  M5.Display.setFont(&fonts::FreeMono9pt7b);   // 9pt: 17 rows fit cleanly
  int y = 60, dy = 25;
  for (auto L : lines) { M5.Display.drawString(L, MARGIN_X, y); y += dy; }

  M5.Display.setFont(&fonts::FreeMono9pt7b);
  M5.Display.drawString("Press any key or tap to go back.", MARGIN_X, H - 28);
  M5.Display.endWrite();
}

void enterHelp() { g_state = ST_HELP; drawHelp(); }

void handleHelpKey(uint8_t ascii, uint8_t keycode) {
  (void)ascii; (void)keycode;                  // any key (or tap) goes back
  gotoMenu();
}

// =========================================================================
//  Standby (save + power off). Wakes with the power button (cold boot).
// =========================================================================
String autoName() {
  if (g_rtcOk) {
    auto dt = M5.Rtc.getDateTime();
    char b[32];
    snprintf(b, sizeof(b), "note-%02d%02d-%02d%02d%02d.txt",
             (int)dt.date.month, (int)dt.date.date,
             (int)dt.time.hours, (int)dt.time.minutes, (int)dt.time.seconds);
    return String(b);
  }
  return String("untitled.txt");
}

// Save the buffer if it holds unsaved work, auto-naming a brand-new file so
// nothing is ever lost. Shared by standby and the keyboard-unplug path.
void saveWorkIfAny() {
  if (modified && doc.length() > 0) {
    if (filename.length() == 0) filename = fullPath(autoName());
    saveFile();
  }
}

void goStandby() {
  g_lastActivity = millis();     // so an idle trigger can't immediately re-fire
  applyRotation(false);          // sleep screen is laid out for landscape
  saveWorkIfAny();
  sessionEnd();                    // log words + remember the resume point
  saveResume();
  // E-ink keeps this image while powered off, so leave a helpful message.
  M5.Display.setEpdMode(m5gfx::epd_quality);
  M5.Display.startWrite();
  M5.Display.fillScreen(TFT_WHITE);
  M5.Display.setTextColor(TFT_BLACK, TFT_WHITE);
  M5.Display.setTextDatum(m5gfx::middle_center);
  M5.Display.setFont(&fonts::FreeMonoBold18pt7b);
  M5.Display.drawString("Sleeping", W / 2, H / 2 - 18);
  M5.Display.setFont(&fonts::FreeMono12pt7b);
  M5.Display.drawString("Work saved.  Press the power button to wake.", W / 2, H / 2 + 26);
  M5.Display.setTextDatum(m5gfx::top_left);
  M5.Display.endWrite();
  delay(60);
  M5.Power.powerOff();           // ~9.6 uA; far lower than deep sleep on this board

  // We only get here if powerOff didn't take effect (e.g. running on USB power).
  // Recover gracefully to a clean menu rather than sitting on the sleep screen.
  g_lastActivity = millis();
  gotoMenu();
}

// =========================================================================
//  Reading positions & bookmarks (persisted to /.ptmarks.tsv on the SD card)
// =========================================================================
// Each file the Reader has opened gets a line "pos<TAB>bookmark<TAB>path":
// `pos` is the automatic where-you-left-off place (updated on every page
// turn, so even a hardware reset can't lose it), `bookmark` is the manually
// pinned page (-1 = none). Oldest entries fall off past MARKS_MAX.
// (struct ReadMark is defined near the top, with the other signature types.)
std::vector<ReadMark> g_readMarks;
bool g_marksLoaded = false;
const int MARKS_MAX = 48;

void marksLoad() {
  if (g_marksLoaded) return;
  g_marksLoaded = true;
  File f = SD.open("/.ptmarks.tsv", FILE_READ);
  if (!f) return;
  while (f.available() && (int)g_readMarks.size() < MARKS_MAX) {
    String line = f.readStringUntil('\n');
    line.trim();
    int t1 = line.indexOf('\t');
    int t2 = (t1 >= 0) ? line.indexOf('\t', t1 + 1) : -1;
    if (t1 <= 0 || t2 <= t1) continue;
    ReadMark m;
    m.pos  = line.substring(0, t1).toInt();
    m.bm   = line.substring(t1 + 1, t2).toInt();
    m.path = line.substring(t2 + 1);
    if (m.path.length()) g_readMarks.push_back(m);
  }
  f.close();
}

void marksSave() {
  File f = SD.open("/.ptmarks.tsv", FILE_WRITE, true);
  if (!f) return;
  for (auto &m : g_readMarks) {
    f.print(m.pos); f.print('\t'); f.print(m.bm); f.print('\t'); f.println(m.path);
  }
  f.close();
}

ReadMark *markFor(const String &path, bool create) {
  marksLoad();
  for (auto &m : g_readMarks) if (m.path == path) return &m;
  if (!create) return nullptr;
  if ((int)g_readMarks.size() >= MARKS_MAX) g_readMarks.erase(g_readMarks.begin());
  ReadMark m; m.path = path; m.pos = 0; m.bm = -1;
  g_readMarks.push_back(m);
  return &g_readMarks.back();
}

void markSetPos(const String &path, int pos) {
  ReadMark *m = markFor(path, true);
  if (m->pos == pos) return;               // no SD write when nothing changed
  m->pos = pos;
  marksSave();
}

// Remember the top of the current reader page as this file's reading place.
void readerSavePos() {
  if (filename.length() == 0 || g_lines.empty()) return;
  int r = g_readerTop;
  if (r >= (int)g_lines.size()) r = (int)g_lines.size() - 1;
  if (r < 0) r = 0;
  markSetPos(filename, g_lines[r].start);
}

// Open a file for reading at its saved place (or fallbackPos if never read).
void readerOpen(const String &path, int fallbackPos) {
  uint32_t sz;
  if (!docFits(path, sz)) {
    msgScreen("\"" + baseName(path) + "\" is too large to open here",
              "(" + String(sz / 1024) + " KB - not enough free memory).");
    return;
  }
  loadDoc(path);
  ReadMark *m = markFor(path, false);
  enterReaderAt((m && m->pos > 0) ? m->pos : fallbackPos);
}

// =========================================================================
//  Reader mode (read-only, paginated, touch-friendly)
// =========================================================================
// One Reader line with markdown styling: split into runs at '*' markers and
// switch the mono style per run. Markers stay visible (each occupies its
// cell), so wrap math and tap zones are untouched.
void drawStyledLine(int lineIdx, int y) {
  const Line &L = g_lines[lineIdx];
  int parStart;
  bool b, it, hd;
  mdStateAt(L.start, parStart, b, it, hd);
  int i = L.start, end = L.start + L.len, x = textX;
  while (i < end) {
    int runStart = i;
    while (i < end && doc[i] != '*') i++;
    if (i > runStart) {
      M5.Display.setFont(styleFont(b || hd, it));
      M5.Display.drawString(drawable(doc.substring(runStart, i)), x, y);
      x += (i - runStart) * charW;
    }
    if (i < end) {                                   // one or two stars
      bool dbl = (i + 1 < end && doc[i + 1] == '*');
      M5.Display.setFont(styleFont(b || hd, it));
      M5.Display.drawString(dbl ? "**" : "*", x, y);
      x += (dbl ? 2 : 1) * charW;
      if (dbl) {
        b = !b;
      } else {
        bool bullet = (i == parStart && i + 1 < (int)doc.length() &&
                       (doc[i + 1] == ' ' || doc[i + 1] == '\t'));
        if (!bullet) it = !it;
      }
      i += dbl ? 2 : 1;
    }
  }
}

int g_rdFastPages = 0;           // fast page turns since the last clean repaint

void drawReaderMode(bool allowFast) {
  // Page turns use the flash-free fast mode; every READER_QUALITY_EVERY-th
  // turn (and every entry/jump/rotate) gets a full-quality repaint to clear
  // the accumulated text ghosting.
  bool fast = allowFast && g_rdFastPages < READER_QUALITY_EVERY;
  g_rdFastPages = fast ? g_rdFastPages + 1 : 0;
  M5.Display.setEpdMode(fast ? m5gfx::epd_fast : m5gfx::epd_quality);
  M5.Display.startWrite();
  M5.Display.fillScreen(TFT_WHITE);

  int totalLines = (int)g_lines.size();
  int pages = (totalLines + g_rows - 1) / g_rows; if (pages < 1) pages = 1;
  int pg = g_readerTop / g_rows + 1;

  // header
  M5.Display.setFont(&fonts::FreeMono9pt7b);
  M5.Display.setTextColor(TFT_BLACK, TFT_WHITE);
  M5.Display.setTextDatum(m5gfx::top_left);
  M5.Display.drawString(baseName(filename), MARGIN_X, 5);
  M5.Display.setTextDatum(m5gfx::top_right);
  M5.Display.drawString(String("page ") + pg + "/" + pages, W - MARGIN_X, 5);
  M5.Display.setTextDatum(m5gfx::top_left);
  M5.Display.drawFastHLine(0, statusH - 1, W, TFT_BLACK);

  // body
  M5.Display.setFont(bodyFont());
  M5.Display.setTextColor(TFT_BLACK, TFT_WHITE);
  for (int r = 0; r < g_rows; r++) {
    int idx = g_readerTop + r;
    if (idx >= totalLines) break;
    drawStyledLine(idx, textY + r * lineH);   // markdown-aware, latin-1-aware
  }
  M5.Display.endWrite();
}

// entries, jumps and rotations always get the clean full-quality repaint
void drawReader() { drawReaderMode(false); }

void enterReaderAt(int pos) {
  g_state = ST_READER;
  applyRotation(g_portrait);       // the reader may run portrait
  M5.Display.setFont(bodyFont());
  layout();
  g_readerTop = 0;
  if (pos > 0 && pos <= (int)doc.length()) {   // open on the page holding pos
    int row, col;
    caretRowCol(pos, row, col);
    g_readerTop = (row / g_rows) * g_rows;
  }
  drawReader();
}
void enterReader() { enterReaderAt(0); }

void readerNext() {
  if (g_readerTop + g_rows < (int)g_lines.size()) {
    g_readerTop += g_rows;
    readerSavePos();               // every page turn persists the place
    drawReaderMode(true);          // flash-free page turn
  }
}
void readerPrev() {
  if (g_readerTop > 0) {
    g_readerTop -= g_rows;
    if (g_readerTop < 0) g_readerTop = 0;
    readerSavePos();
    drawReaderMode(true);
  }
}

// jump to an absolute position (bookmark / page picker) and persist it
void readerJumpPos(int pos) {
  int row, col;
  caretRowCol(pos, row, col);
  g_readerTop = (row / g_rows) * g_rows;
  readerSavePos();
  g_state = ST_READER;
  drawReader();
}

// =========================================================================
//  Reading menu (tap the bottom edge, or 'b') + go-to-page picker
// =========================================================================
int g_rmSel = 0;

int pageOfPos(int pos) {
  int row, col;
  caretRowCol(pos, row, col);
  return row / g_rows + 1;
}

String rmLabel(int i) {
  ReadMark *m = markFor(filename, false);
  bool has = (m && m->bm >= 0);
  switch (i) {
    case 0: return String("Go to page...");
    case 1: return String("Set bookmark on this page");
    case 2: return has ? "Go to bookmark   (page " + String(pageOfPos(m->bm)) + ")"
                       : String("Go to bookmark   (none set)");
    case 3: return has ? String("Clear bookmark") : String("Clear bookmark   (none set)");
    case 4: return String("Back to reading");
  }
  return String();
}

void drawReaderMenu() {
  int bw = (W - 24 < 560) ? W - 24 : 560;    // fits portrait too
  drawModalList("Reading", bw, 380, rmLabel, 5, g_rmSel);
}

void enterReaderMenu() { g_state = ST_RMENU; g_rmSel = 0; drawReaderMenu(); }
void backToReader()    { g_state = ST_READER; drawReader(); }

void doReaderMenu(int i) {
  ReadMark *m;
  switch (i) {
    case 0: enterGoPage(); return;
    case 1:                                  // pin the current page
      m = markFor(filename, true);
      m->bm = g_lines.empty() ? 0
            : g_lines[(g_readerTop < (int)g_lines.size()) ? g_readerTop : 0].start;
      marksSave();
      backToReader();
      return;
    case 2:
      m = markFor(filename, false);
      if (m && m->bm >= 0) readerJumpPos(m->bm);
      else drawReaderMenu();                 // nothing to jump to
      return;
    case 3:
      m = markFor(filename, false);
      if (m && m->bm >= 0) { m->bm = -1; marksSave(); }
      backToReader();
      return;
    case 4: backToReader(); return;
  }
}

void handleReaderMenuKey(uint8_t ascii, uint8_t keycode) {
  if (keycode == KC_ESC) { backToReader(); return; }
  if (keycode == KC_UP)   { if (g_rmSel > 0) { g_rmSel--; modalListMoveSel(g_rmSel + 1, g_rmSel); } return; }
  if (keycode == KC_DOWN) { if (g_rmSel < 4) { g_rmSel++; modalListMoveSel(g_rmSel - 1, g_rmSel); } return; }
  if (ascii == 10 || ascii == 13 || keycode == KC_ENTER) doReaderMenu(g_rmSel);
}

void readerMenuTap(int x, int y) {
  int r = modalListHit(x, y);
  if (r == -1) { backToReader(); return; }
  if (r >= 0) doReaderMenu(r);
}

// ---- go-to-page picker -----------------------------------------------------
int g_goPage = 1;
bool g_gpTyped = false;                      // first typed digit replaces
int g_gpBtnX[4], g_gpBtnW = 0, g_gpBtnY = 0;
int g_gpGoX[2], g_gpGoW = 0, g_gpGoY = 0;
int g_gpNumX = 0, g_gpNumY = 0;              // the "12 / 87" readout
const int GP_BTN_H = 44;

// Update just the page number (fast, no flash) as it's nudged or typed.
void gpUpdateNumber() {
  M5.Display.setEpdMode(m5gfx::epd_fast);
  M5.Display.startWrite();
  M5.Display.fillRect(g_gpNumX, g_gpNumY, 340, 42, TFT_WHITE);
  M5.Display.setFont(&fonts::FreeMonoBold18pt7b);
  M5.Display.setTextColor(TFT_BLACK, TFT_WHITE);
  M5.Display.setTextDatum(m5gfx::top_left);
  int pages = ((int)g_lines.size() + g_rows - 1) / g_rows;
  if (pages < 1) pages = 1;
  M5.Display.drawString(String(g_goPage) + " / " + String(pages), g_gpNumX, g_gpNumY);
  M5.Display.endWrite();
}

int readerPages() {
  int pages = ((int)g_lines.size() + g_rows - 1) / g_rows;
  return pages < 1 ? 1 : pages;
}

void drawGoPage() {
  int pages = readerPages();
  int bw = (W - 24 < 620) ? W - 24 : 620, bh = 330, bx, by;
  M5.Display.setEpdMode(m5gfx::epd_quality);
  M5.Display.startWrite();
  modalFrame(bw, bh, "Go to page", bx, by);
  g_gpNumX = bx + 30; g_gpNumY = by + 78;
  M5.Display.setFont(&fonts::FreeMonoBold18pt7b);
  M5.Display.drawString(String(g_goPage) + " / " + String(pages), g_gpNumX, g_gpNumY);

  M5.Display.setFont(&fonts::FreeMono12pt7b);
  static const char *lbl[4] = {"-10", "-1", "+1", "+10"};
  g_gpBtnW = (bw - 60 - 3 * 12) / 4;
  g_gpBtnY = by + 140;
  M5.Display.setTextDatum(m5gfx::middle_center);
  for (int i = 0; i < 4; i++) {
    g_gpBtnX[i] = bx + 30 + i * (g_gpBtnW + 12);
    M5.Display.drawRect(g_gpBtnX[i], g_gpBtnY, g_gpBtnW, GP_BTN_H, TFT_BLACK);
    M5.Display.drawString(lbl[i], g_gpBtnX[i] + g_gpBtnW / 2, g_gpBtnY + GP_BTN_H / 2);
  }
  g_gpGoW = (bw - 60 - 12) / 2;
  g_gpGoY = g_gpBtnY + GP_BTN_H + 20;
  static const char *lbl2[2] = {"Go", "Cancel"};
  for (int i = 0; i < 2; i++) {
    g_gpGoX[i] = bx + 30 + i * (g_gpGoW + 12);
    if (i == 0) {
      M5.Display.fillRect(g_gpGoX[i], g_gpGoY, g_gpGoW, GP_BTN_H, TFT_BLACK);
      M5.Display.setTextColor(TFT_WHITE, TFT_BLACK);
    } else {
      M5.Display.drawRect(g_gpGoX[i], g_gpGoY, g_gpGoW, GP_BTN_H, TFT_BLACK);
      M5.Display.setTextColor(TFT_BLACK, TFT_WHITE);
    }
    M5.Display.drawString(lbl2[i], g_gpGoX[i] + g_gpGoW / 2, g_gpGoY + GP_BTN_H / 2);
  }
  M5.Display.setTextColor(TFT_BLACK, TFT_WHITE);
  M5.Display.setTextDatum(m5gfx::top_left);
  M5.Display.setFont(&fonts::FreeMono9pt7b);
  M5.Display.drawString("arrows = +/-1   PgUp/Dn = +/-10   type a number   Enter = go",
                        bx + 30, by + bh - 32);
  M5.Display.endWrite();
}

void enterGoPage() {
  g_state = ST_GOPAGE;
  int r = (g_readerTop < (int)g_lines.size()) ? g_readerTop : 0;
  g_goPage = r / g_rows + 1;
  g_gpTyped = false;
  drawGoPage();
}

void goPageDelta(int d) {
  int pages = readerPages();
  g_goPage += d;
  if (g_goPage < 1) g_goPage = 1;
  if (g_goPage > pages) g_goPage = pages;
  g_gpTyped = false;
  gpUpdateNumber();
}

void goPageJump() {
  int pages = readerPages();
  if (g_goPage < 1) g_goPage = 1;
  if (g_goPage > pages) g_goPage = pages;
  int row = (g_goPage - 1) * g_rows;
  if (row >= (int)g_lines.size()) row = (int)g_lines.size() - 1;
  readerJumpPos(g_lines.empty() ? 0 : g_lines[row].start);
}

void handleGoPageKey(uint8_t ascii, uint8_t keycode) {
  if (keycode == KC_ESC) { backToReader(); return; }
  if (keycode == KC_LEFT  || keycode == KC_UP)   { goPageDelta(-1);  return; }
  if (keycode == KC_RIGHT || keycode == KC_DOWN) { goPageDelta(+1);  return; }
  if (keycode == KC_PGUP) { goPageDelta(-10); return; }
  if (keycode == KC_PGDN) { goPageDelta(+10); return; }
  if (keycode == KC_HOME) { g_goPage = 1; g_gpTyped = false; gpUpdateNumber(); return; }
  if (keycode == KC_END)  { g_goPage = readerPages(); g_gpTyped = false; gpUpdateNumber(); return; }
  if (ascii == 10 || ascii == 13 || keycode == KC_ENTER) { goPageJump(); return; }
  if (ascii >= '0' && ascii <= '9') {
    int d = ascii - '0';
    g_goPage = g_gpTyped ? g_goPage * 10 + d : d;
    int pages = readerPages();
    if (g_goPage > pages) g_goPage = pages;
    if (g_goPage < 1) g_goPage = 1;
    g_gpTyped = true;
    gpUpdateNumber();
  }
}

void goPageTap(int x, int y) {
  if (y >= g_gpBtnY && y <= g_gpBtnY + GP_BTN_H) {
    static const int d[4] = {-10, -1, +1, +10};
    for (int i = 0; i < 4; i++)
      if (x >= g_gpBtnX[i] && x <= g_gpBtnX[i] + g_gpBtnW) { goPageDelta(d[i]); return; }
    return;
  }
  if (y >= g_gpGoY && y <= g_gpGoY + GP_BTN_H) {
    if (x >= g_gpGoX[0] && x <= g_gpGoX[0] + g_gpGoW) { goPageJump(); return; }
    if (x >= g_gpGoX[1] && x <= g_gpGoX[1] + g_gpGoW) { backToReader(); return; }
  }
}

void handleReaderKey(uint8_t ascii, uint8_t keycode) {
  if (keycode == KC_ESC) { gotoMenu(); return; }
  if ((ascii == 'e' || ascii == 'E') && g_kbConnected) {   // read -> edit
    applyRotation(false);                                  // editor is landscape
    enterEditor();
    return;
  }
  if (ascii == 'b' || ascii == 'B') { enterReaderMenu(); return; }  // bookmarks
  if (ascii == 'r' || ascii == 'R') {                      // rotate the reader
    int anchor = 0;
    if (!g_lines.empty()) {
      int row = g_readerTop;
      if (row >= (int)g_lines.size()) row = (int)g_lines.size() - 1;
      anchor = g_lines[row].start;
    }
    g_portrait = !g_portrait;
    saveLayout();
    enterReaderAt(anchor);        // re-wrap for the new shape, keep the place
    return;
  }
  if (keycode == KC_LEFT || keycode == KC_UP || keycode == KC_PGUP) { readerPrev(); return; }
  if (keycode == KC_RIGHT || keycode == KC_DOWN || keycode == KC_PGDN ||
      ascii == ' ' || ascii == 10 || ascii == 13) { readerNext(); return; }
}

void readerTap(int x, int y) {
  if (y < statusH) { gotoMenu(); return; }      // top band exits
  if (y > H - 44)  { enterReaderMenu(); return; }   // bottom band: reading menu
  if (x < W / 3) readerPrev(); else readerNext();
}

// Route a touch tap to the current screen. Every screen accepts touch, so a
// sleeping (or absent) keyboard can never leave you stranded anywhere.
void handleTap(int x, int y) {
  switch (g_state) {
    case ST_MENU:     menuTap(x, y);     break;
    case ST_READER:   readerTap(x, y);   break;
    case ST_BTPAIR:   btPairTap(x, y);   break;
    case ST_COUNT:    dismissCount();    break;
    case ST_GOAL:     goalTap(x, y);     break;
    case ST_STATS:    gotoMenu();        break;
    case ST_HELP:     gotoMenu();        break;
    case ST_EDITMENU: editMenuTap(x, y); break;
    case ST_CONFIRM:  confirmTap(x, y);  break;
    case ST_PROMPT:   promptCancel();    break;
    case ST_EXPORT:   stopExport();      break;
    case ST_SPELL:    spellTap(x, y);      break;
    case ST_SYNC:     stopSync();          break;
    case ST_RMENU:    readerMenuTap(x, y); break;
    case ST_GOPAGE:   goPageTap(x, y);     break;
    case ST_KEYTEST:
      if (ENABLE_BLE_KEYBOARD) { g_state = ST_BTPAIR; drawBtPair(); }
      else gotoMenu();
      break;
    case ST_EDIT: {                        // tap the page: place the cursor
      if (g_focus || y < textY) break;
      int row = topLine + (y - textY) / lineH;
      int col = (x - textX + charW / 2) / charW;
      cursorPos = posFromRowCol(row, col < 0 ? 0 : col);
      desiredCol = -1;
      afterChange(false);
      break;
    }
  }
}

// =========================================================================
//  Settings persistence (keyboard layout) + toggle
// =========================================================================
void loadLayout() {
  g_prefs.begin("paper", true);            // read-only
  // migrate the old boolean "dvorak" pref to the layout index transparently
  g_layout = g_prefs.getInt("layout", g_prefs.getBool("dvorak", false) ? 1 : 0);
  if (g_layout < 0 || g_layout >= LAYOUT_COUNT) g_layout = 0;
  g_fontSize = g_prefs.getInt("fontsz", 1);
  if (g_fontSize < 0 || g_fontSize > 2) g_fontSize = 1;
  g_portrait = g_prefs.getBool("portrait", false);
  g_prefs.end();
}
void saveLayout() {
  g_prefs.begin("paper", false);
  g_prefs.putInt("layout", g_layout);
  g_prefs.putInt("fontsz", g_fontSize);
  g_prefs.putBool("portrait", g_portrait);
  g_prefs.end();
}
void toggleLayout() { g_layout = (g_layout + 1) % LAYOUT_COUNT; saveLayout(); drawMenu(); }
void toggleFont() {
  g_fontSize = (g_fontSize + 1) % 3;
  saveLayout();
  setupMetrics();                          // new column/row grid for the editor
  drawMenu();
}
void toggleReaderRot() { g_portrait = !g_portrait; saveLayout(); drawMenu(); }

// =========================================================================
//  Setup / loop
// =========================================================================
// Ctrl+R anywhere: repaint the current screen at full quality (de-ghost).
void redrawScreen() {
  switch (g_state) {
    case ST_MENU:     g_menuFastCount = 0; drawMenu(); break;
    case ST_EDIT:     needDeghost = true; renderEditor(true); break;
    case ST_EDITMENU: drawEditMenu(); break;
    case ST_PROMPT:   drawPrompt(); break;
    case ST_CONFIRM:  drawConfirm(); break;
    case ST_EXPORT:   drawExport(); break;
    case ST_HELP:     drawHelp(); break;
    case ST_READER:   drawReader(); break;
    case ST_BTPAIR:   drawBtPair(); break;
    case ST_COUNT:    drawCountPopup(); break;
    case ST_GOAL:     drawGoal(); break;
    case ST_STATS:    drawStats(); break;
    case ST_SPELL:    drawSpell(); break;
    case ST_RMENU:    drawReaderMenu(); break;
    case ST_GOPAGE:   drawGoPage(); break;
    default: break;
  }
}

void setupMetrics() {
  M5.Display.setFont(&fonts::FreeMono9pt7b);
  statusH = M5.Display.fontHeight() + 10;
  M5.Display.setFont(bodyFont());               // editor/reader body size (S/M/L)
  charW = M5.Display.textWidth("M"); if (charW < 1) charW = 14;
  lineH = M5.Display.fontHeight() + 6;
  textX = MARGIN_X;
  textY = statusH + 4;
  g_cols = (W - 2 * MARGIN_X) / charW; if (g_cols < 8) g_cols = 8;
  g_rows = (H - textY - 6) / lineH;    if (g_rows < 1) g_rows = 1;
  prevVisible.assign(g_rows, String("\x01"));
}

void setup() {
  // Only bring up the subsystems we actually use. Keep RTC (clock), display and
  // power management; skip the gyro, buzzer and mic to save a little current.
  auto cfg = M5.config();
  cfg.internal_imu = false;   // built-in gyroscope: unused
  cfg.internal_spk = false;   // built-in buzzer: unused
  cfg.internal_mic = false;   // no mic on PaperS3 anyway
  cfg.internal_rtc = true;    // keep the clock running
  M5.begin(cfg);

  setCpuFrequencyMhz(CPU_MHZ);   // lower clock = less power (USB host still needs >= 80)
  M5.Display.setRotation(1);
  M5.Display.setEpdMode(m5gfx::epd_quality);
  W = M5.Display.width();
  H = M5.Display.height();
  setupMetrics();

  WiFi.mode(WIFI_OFF);     // keep the radio powered down until an export starts
  setupRtc();

  SPI.begin(SD_SPI_SCK_PIN, SD_SPI_MISO_PIN, SD_SPI_MOSI_PIN, SD_SPI_CS_PIN);
  bool sdok = SD.begin(SD_SPI_CS_PIN, SPI, 25000000);

  if (usbDriveFlagged()) {       // one-shot: boot as a USB drive instead
    usbDriveBoot(sdok);
    return;                      // no keyboard host, no menu this boot
  }

  M5.Display.startWrite();
  M5.Display.fillScreen(TFT_WHITE);
  M5.Display.setTextColor(TFT_BLACK, TFT_WHITE);
  M5.Display.setTextDatum(m5gfx::top_left);
  M5.Display.setFont(&fonts::FreeMonoBold18pt7b);
  M5.Display.drawString("BYOBYOK", MARGIN_X, 40);
  M5.Display.setFont(&fonts::FreeMono9pt7b);
  M5.Display.drawString(sdok ? "microSD: OK"
                             : "microSD: NOT FOUND - insert a FAT32 card and reset",
                        MARGIN_X, 100);
  M5.Display.drawString("Plug a USB keyboard into the USB-C port (OTG adapter).",
                        MARGIN_X, 124);
  M5.Display.endWrite();
  delay(1200);

  g_keepLatin1 = (USE_LATIN1_FONTS != 0);   // fold vs. keep accents on load
  loadLayout();           // restore QWERTY/Dvorak + font size from NVS
  setupMetrics();         // re-measure in case the saved font size isn't medium
  loadResume();           // last file + caret, for the [ Continue ] entry

  // 64-deep: a large auto-save can stall the loop for ~1s on novel-sized
  // files, and fast typing must not drop keys while that happens.
  g_keyQueue = xQueueCreate(64, sizeof(KeyEvt));
  usbHost.onKeyboard(onKbEvent);                 // register before begin()
  usbHost.begin();        // USB host takes over USB-C; serial monitor is gone now
  g_kbConnected = (usbHost.deviceCount() > 0);   // may flip true shortly after enumeration
  bleBoot();              // BLE keyboard: re-arm if one was paired (no-op if compiled out)
  buildEntries();
  g_sel = 0; menuTop = 0;
  g_lastActivity = millis();
  drawMenu();
}

void loop() {
  if (g_usbDriveMode) { usbDriveLoopTick(); return; }   // MSC boot: minimal loop
  M5.update();

  // Process any queued keypresses on this (drawing) task.
  KeyEvt e;
  while (g_keyQueue && xQueueReceive(g_keyQueue, &e, 0) == pdTRUE) {
    dispatchKey(e.ascii, e.keycode, e.modifiers, e.caps);
  }

  if (M5.BtnPWR.wasClicked()) goStandby();   // power-button short press = standby
  if (g_state == ST_EXPORT) server.handleClient();
  bleLoopTick();                             // BLE keyboard housekeeping (main task)

  // Writing goal / sprint: announce completion with the count popup.
  if (g_state == ST_EDIT && g_goalMode) {
    bool done = (g_goalMode == 1)
                  ? (millis() - g_goalStartMs >= (unsigned long)g_goalTarget * 60000UL)
                  : (g_docWords - g_goalStartWords >= g_goalTarget);
    if (done) {
      g_goalHit = true;
      enterCount();                          // draws the "Goal reached!" popup
      g_goalMode = 0;
    }
  }

  // Track keyboard presence, USB or BLE (drives edit-vs-read behavior and
  // menu labels). Only a *USB unplug* with no BLE fallback forces the
  // save-and-exit path: a BLE keyboard that drops out is usually just sleeping
  // to save its battery and reconnects on its next keypress, so mid-edit we
  // stay put (idle auto-standby still protects the work).
  static bool s_usbKb = false;
  bool usb = (usbHost.deviceCount() > 0);
  bool usbPulled = (s_usbKb && !usb);
  s_usbKb = usb;
  bool kb = usb || bleConnected();
  if (kb != g_kbConnected) {
    g_kbConnected = kb;
    if (!kb && usbPulled &&
        (g_state == ST_EDIT || g_state == ST_EDITMENU || g_state == ST_PROMPT)) {
      // keyboard pulled mid-edit: save and drop back to the touch menu (don't get stuck)
      saveWorkIfAny();
      gotoMenu();
    } else if (g_state == ST_MENU) {
      // Keyboard came or went: the entry list itself changes ([ New file ]
      // and [ New folder ] exist only when there are keys to type a name).
      g_sel = 0; menuTop = 0; g_btnSel = -1;
      buildEntries();
      drawMenu();
    }
  }

  // Touchscreen taps (menu navigation + reader page turns).
  if (M5.Touch.isEnabled()) {
    auto &t = M5.Touch.getDetail(0);
    if (t.wasClicked()) { g_lastActivity = millis(); handleTap(t.x, t.y); }
  }

  // De-ghost during a natural pause instead of mid-typing: once enough
  // partial updates have accumulated, a quiet stretch triggers one clean
  // full-quality repaint (the flash lands while you're thinking).
  if (g_state == ST_EDIT && partialCount >= DEGHOST_IDLE_MIN &&
      millis() - g_lastActivity > DEGHOST_IDLE_MS) {
    needDeghost = true;
    renderEditor(true);
  }

  // Auto-standby after a stretch of no typing (never while exporting).
  if (IDLE_SLEEP_MS > 0 && g_state != ST_EXPORT &&
      millis() - g_lastActivity >= IDLE_SLEEP_MS) {
    goStandby();
  }

  // Periodic tick: auto-save named files and refresh the battery indicator.
  if (millis() - g_lastTick >= AUTOSAVE_MS) {
    g_lastTick = millis();
    if (g_state == ST_EDIT) {
      int oldPct = g_batPct;
      readBattery();                                  // updates g_batPct/g_charging
      int curMin = g_lastMin;
      if (g_rtcOk) { auto dt = M5.Rtc.getDateTime(); curMin = dt.time.hours * 60 + dt.time.minutes; }
      bool saved = false;
      if (modified && filename.length() > 0) { saveFile(); saveResume(); saved = true; }
      if (saved || g_batPct != oldPct || curMin != g_lastMin) {
        g_lastMin = curMin;
        refreshStatusBar();
        prevModified = modified;                      // keep incremental render in sync
      }
    }
  }
  delay(1);
}
